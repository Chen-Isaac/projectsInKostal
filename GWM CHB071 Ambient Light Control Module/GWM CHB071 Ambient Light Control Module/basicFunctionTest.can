/*@!Encoding:936*/
includes
{
  #include "D:\\Isaac\\Library\\KostalSoftwareTestLibrary.cin"
}

variables
{
  
}

export testcase powerOn (void) {
  stateMachine("powerOn",routeNum,noParaPick);
}

export testcase powerOff (void) {
  stateMachine("powerOff",routeNum,noParaPick);
}

export testcase initProduct (void) {
  stateMachine("initProduct",routeNum,noParaPick);
}

export testcase readSwVer (void) {
  stateMachine("readSwVer",routeNum,noParaPick);
}

export testcase chkDrivingModeReqSigImpWhenIgnOff (char doorSignal[],char drvModeReqVal[],char msWaitForTurnOn[]) {
  char paraPick[3][2][100]={{"doorSignal",""},{"drvModeReqVal",""},{"msWaitForTurnOn",""}};
  strncpy(paraPick[0][1],doorSignal,elCount(paraPick[0][1]));
  strncpy(paraPick[1][1],drvModeReqVal,elCount(paraPick[1][1]));
  strncpy(paraPick[2][1],msWaitForTurnOn,elCount(paraPick[2][1]));
  stateMachine("chkDrivingModeReqSigImpWhenIgnOff",routeNum,paraPick);
}

export testcase chkALCMLightLvlSetSigImpWhenIgnOff (char doorSignal[],char alcmLightLvlSetVal[],char msWaitForTurnOn[]) {
  char paraPick[3][2][100]={{"doorSignal",""},{"alcmLightLvlSetVal",""},{"msWaitForTurnOn",""}};
  strncpy(paraPick[0][1],doorSignal,elCount(paraPick[0][1]));
  strncpy(paraPick[1][1],alcmLightLvlSetVal,elCount(paraPick[1][1]));
  strncpy(paraPick[2][1],msWaitForTurnOn,elCount(paraPick[2][1]));
  stateMachine("chkALCMLightLvlSetSigImpWhenIgnOff",routeNum,paraPick);
}

export testcase chkPosLmpStslSigImpWhenIgnOff (char doorSignal[],char posLmpStsVal[],char sysPwrModeVal[]) {
  char paraPick[3][2][100]={{"doorSignal",""},{"posLmpStsVal",""},{"sysPwrModeVal",""}};
  strncpy(paraPick[0][1],doorSignal,elCount(paraPick[0][1]));
  strncpy(paraPick[1][1],posLmpStsVal,elCount(paraPick[1][1]));
  strncpy(paraPick[2][1],sysPwrModeVal,elCount(paraPick[2][1]));
  stateMachine("chkPosLmpStslSigImpWhenIgnOff",routeNum,paraPick);
}

export testcase chkDoorOpenSignalImpWhenMode0IgnOff (char doorSignal[],char msWaitForTurnOn[]) {
  char paraPick[2][2][100]={{"doorSignal",""},{"msWaitForTurnOn",""}};
  strncpy(paraPick[0][1],doorSignal,elCount(paraPick[0][1]));
  strncpy(paraPick[1][1],msWaitForTurnOn,elCount(paraPick[1][1]));
  stateMachine("chkDoorOpenSignalImpWhenMode0IgnOff",routeNum,paraPick);
}

export testcase chkRisingTimeAndMemoryFunctionOfDoorOpenSignalImpExceptMode0IgnOff (char doorSignal[],char msWaitForTurnOn[],char posLmpStsVal[],char Mode3_6[],char Mode2_5[]) {
  char paraPick[5][2][100]={{"doorSignal",""},{"msWaitForTurnOn",""},{"posLmpStsVal",""},{"Mode3_6",""},{"Mode2_5",""}};
  strncpy(paraPick[0][1],doorSignal,elCount(paraPick[0][1]));
  strncpy(paraPick[1][1],msWaitForTurnOn,elCount(paraPick[1][1]));
  strncpy(paraPick[2][1],posLmpStsVal,elCount(paraPick[2][1]));
  strncpy(paraPick[3][1],Mode3_6,elCount(paraPick[3][1]));
  strncpy(paraPick[4][1],Mode2_5,elCount(paraPick[4][1]));
  stateMachine("chkRisingTimeAndMemoryFunctionOfDoorOpenSignalImpExceptMode0IgnOff",routeNum,paraPick);
}

export testcase chkAlcmKeepTime (char doorSignal[],char Mode2[], char accOrOnMode[],char msWaitForTurnOn[]) {
  char paraPick[4][2][100]={{"doorSignal",""},{"Mode2",""},{"accOrOnMode",""},{"msWaitForTurnOn",""}};
  strncpy(paraPick[0][1],doorSignal,elCount(paraPick[0][1]));
  strncpy(paraPick[1][1],Mode2,elCount(paraPick[1][1]));
  strncpy(paraPick[2][1],accOrOnMode,elCount(paraPick[2][1]));
  strncpy(paraPick[3][1],msWaitForTurnOn,elCount(paraPick[3][1]));
  stateMachine("chkAlcmKeepTime",routeNum,paraPick);
}

export testcase chkDrivingModeReqSigImpWhenAccOn (char doorSignal[],char drvModeReqVal[],char msWaitForTurnOn[]) {
  char paraPick[3][2][100]={{"doorSignal",""},{"drvModeReqVal",""},{"msWaitForTurnOn",""}};
  strncpy(paraPick[0][1],doorSignal,elCount(paraPick[0][1]));
  strncpy(paraPick[1][1],drvModeReqVal,elCount(paraPick[1][1]));
  strncpy(paraPick[2][1],msWaitForTurnOn,elCount(paraPick[2][1]));
  stateMachine("chkDrivingModeReqSigImpWhenAccOn",routeNum,paraPick);
}

export testcase chkALCMLightLvlSetSigImpWhenAccOn (char doorSignal[],char alcmLightLvlSetVal[],char msWaitForTurnOn[]) {
  char paraPick[3][2][100]={{"doorSignal",""},{"alcmLightLvlSetVal",""},{"msWaitForTurnOn",""}};
  strncpy(paraPick[0][1],doorSignal,elCount(paraPick[0][1]));
  strncpy(paraPick[1][1],alcmLightLvlSetVal,elCount(paraPick[1][1]));
  strncpy(paraPick[2][1],msWaitForTurnOn,elCount(paraPick[2][1]));
  stateMachine("chkALCMLightLvlSetSigImpWhenAccOn",routeNum,paraPick);
}

export testcase chkALCMLightLvlSetSigImpWhenIgnOn (char doorSignal[],char alcmLightLvlSetVal[],char msWaitForTurnOn[],char freqG[],char dutyG[],char freqB[],char dutyB[]) {
  char paraPick[7][2][100]={{"doorSignal",""},{"alcmLightLvlSetVal",""},{"msWaitForTurnOn",""},{"freqG",""},{"dutyG",""},{"freqB",""},{"dutyB",""}};
  strncpy(paraPick[0][1],doorSignal,elCount(paraPick[0][1]));
  strncpy(paraPick[1][1],alcmLightLvlSetVal,elCount(paraPick[1][1]));
  strncpy(paraPick[2][1],msWaitForTurnOn,elCount(paraPick[2][1]));
  strncpy(paraPick[3][1],freqG,elCount(paraPick[3][1]));
  strncpy(paraPick[4][1],dutyG,elCount(paraPick[4][1]));
  strncpy(paraPick[5][1],freqB,elCount(paraPick[5][1]));
  strncpy(paraPick[6][1],dutyB,elCount(paraPick[6][1]));
  stateMachine("chkALCMLightLvlSetSigImpWhenIgnOn",routeNum,paraPick);
}

export testcase chkAccImpWhenMode0 (char doorSignal[],char msWaitForTurnOn[]) {
  char paraPick[2][2][100]={{"doorSignal",""},{"msWaitForTurnOn",""}};
  strncpy(paraPick[0][1],doorSignal,elCount(paraPick[0][1]));
  strncpy(paraPick[1][1],msWaitForTurnOn,elCount(paraPick[1][1]));
  stateMachine("chkAccImpWhenMode0",routeNum,paraPick);
}

export testcase chkRisingTimeAndMemoryFunctionOfAccImpExceptMode0SwitchOff (char doorSignal[],char msWaitForTurnOn[],char posLmpStsVal[],char Mode3_6[],char Mode2_5[],int step13RouteNum, int step28RouteNum) {
  char paraPick[5][2][100]={{"doorSignal",""},{"msWaitForTurnOn",""},{"posLmpStsVal",""},{"Mode3_6",""},{"Mode2_5",""}};
  strncpy(paraPick[0][1],doorSignal,elCount(paraPick[0][1]));
  strncpy(paraPick[1][1],msWaitForTurnOn,elCount(paraPick[1][1]));
  strncpy(paraPick[2][1],posLmpStsVal,elCount(paraPick[2][1]));
  strncpy(paraPick[3][1],Mode3_6,elCount(paraPick[3][1]));
  strncpy(paraPick[4][1],Mode2_5,elCount(paraPick[4][1]));
  routeNum[12] = step13RouteNum;
  routeNum[13] = step13RouteNum;
  routeNum[14] = step13RouteNum;
  routeNum[15] = step13RouteNum;
  routeNum[16] = step13RouteNum;
  routeNum[17] = step13RouteNum;
  routeNum[27] = step28RouteNum;
  routeNum[28] = step28RouteNum;
  routeNum[29] = step28RouteNum;
  routeNum[30] = step28RouteNum;
  routeNum[31] = step28RouteNum;
  routeNum[32] = step28RouteNum;
  stateMachine("chkRisingTimeAndMemoryFunctionOfAccImpExceptMode0SwitchOff",routeNum,paraPick);
  
}

export testcase try() {
  int64 t,t1;
  t = timeNowInt64();
  testWaitForTimeout(3000);
  t1 = timeNowInt64();
  testStep("","t=%f",_pow(10,-9)*(t1-t));
  
}
