/* !Encoding: 65001  */
// Generated with version 2.0.16.0
variables
{
  // global general purpose buffers
  char _ttg_B[2000];
  char _ttg_BC[2000];
  char _ttg_BR[2000];
  long _ttg_verdict;
  long _ttg_Re;
  long _ttg_TestActionFailCnt;
  long _ttg_TestStepInitOk;
  int64 _ttg_I64;
  double _ttg_Double;
  dword _ttg_gBusContextNew = 0;
  dword _ttg_gBusContextOld = 0;
  int64 _ttg_gBusContextOk = 0;
  // FlexRay configuration
  FRConfiguration _ttg_gFRConfiguration;
  long _ttg_gFRNumberOfStaticSlots[32];
  long _ttg_gFRPayloadLengthStatic[32];
  // globals for user defined variables
  // global declarations
}
void _fct_Wait(char step[], int64 timeInNs, int64 unitInNs, char valueSymbol[])
{
  char b[400];
  if(unitInNs == 1LL)
  {
    if(valueSymbol[0] == 0)
      snprintf(b, elcount(b), "%I64d ns", timeInNs);
    else
      snprintf(b, elcount(b), "%I64d (%s) ns", timeInNs, valueSymbol);
  }
  else if(unitInNs == 1000LL)
  {
    if(valueSymbol[0] == 0)
      snprintf(b, elcount(b), "%.3f us", (1.0 * timeInNs) / unitInNs);
    else
      snprintf(b, elcount(b), "%.3f (%s) us", (1.0 * timeInNs) / unitInNs, valueSymbol);
  }
  else if(unitInNs == 1000000LL)
  {
    if(valueSymbol[0] == 0)
      snprintf(b, elcount(b), "%.3f ms", (1.0 * timeInNs) / unitInNs);
    else
      snprintf(b, elcount(b), "%.3f (%s) ms", (1.0 * timeInNs) / unitInNs, valueSymbol);
  }
  else if(unitInNs == 1000000000LL)
  {
    if(valueSymbol[0] == 0)
      snprintf(b, elcount(b), "%.3f s", (1.0 * timeInNs) / unitInNs);
    else
      snprintf(b, elcount(b), "%.3f (%s) s", (1.0 * timeInNs) / unitInNs, valueSymbol);
  }
  if(timeInNs > 0)
  {
    if(0 == testWaitForTimeoutNS(timeInNs))
      testStepPass(2, step, "Waited for %s", b);
    else
      testStepFail(0, step, "Waited for %s", b);
  }
  else if(timeInNs  == 0)
  {
    // do not wait
    testStepPass(2, step, "Waited for %s", b);
  }
  else
  {
    testStepFail(0, step, "Unable to wait for %s. Please check input parameter.", b);
  }
}

void _fct_CommandVerdict(long verdict)
{
  if(_ttg_verdict == 1) // failed
    return; // setting verdict from 'failed' to 'pass' is not possible
  _ttg_verdict = verdict;
}

int _fct_TcDoBOF()
{
  return TestGetVerdictLastTestCase()==1 && !testIsBreakOnFailDeactivated();
}

int _fct_TsDoBOF()
{
  return TestGetVerdictLastTestSequence()==1 && !testIsBreakOnFailDeactivated();
}

int _fct_LoopIsBlocking()
{ 
  // works for nested loops, too
  dword timeLoopNow, timeLoopOld, cntTimeEqual;
  timeLoopNow = timeNow();
  if(timeLoopNow > timeLoopOld)
  {
    cntTimeEqual = 0;
  }
  else
  {
    ++cntTimeEqual;
    if(cntTimeEqual >= 1000)
    {
      // busy loop detected
      testStepFail(0, "", "Blocking loop detected. Aborted after 1000 cycles have been performed at the same time.");
      return 1;
    }
  }
  timeLoopOld = timeLoopNow;
  return 0;
}

void _fct_CallTsTc(char function[], dword fType, dword isExported, char title[])
{
  CreateTTEIFFunction(function, fType, isExported);
  CallInterfaceFunction(title);
}

void _fct_TestControlStructEnd(long count)
{
  // call TestControlStructEnd count times to close report scope in nested ifs
  long i;
  for(i = 0; i < count; ++i)
    TestControlStructEnd(_ttg_verdict);
}

void _fct_IfTableHead(char inCondition[], int bCondition)
{
  char localBuf[2048];

  snprintf(localBuf, elCount(localBuf), "Condition %s: ", inCondition);
  if(bCondition)
  {
    strncat(localBuf, "true", elCount(localBuf));
  }
  else
  {
    strncat(localBuf, "false", elCount(localBuf));
  }

  _fct_TiTableHeadExpectedEx(localBuf);
}

int _fct_DoElseIf(int bDone)
{
  if(bDone)
  {
    testStep(0, "", "Previous condition matched, skipping block.");
    return 0;
  }
  return 1;
}

int _fct_DoElse(int bDone)
{
  if(bDone)
  {
    testStep(0, "", "Previous condition matched, skipping block.");
    return 0;
  }
  else
  {
    testStep(0, "", "No condition matched, executing 'else' block.");
    return 1;
  }
}
void _fct_TiTableHeadInit()
{
  _ttg_TestActionFailCnt = 0;
}

void _fct_TiTableHeadAssignment()
{
  _fct_TiTableHeadInit();
  _ttg_Re = testInfoTable("Stimulation of values");
  testInfoHeadingBegin(_ttg_Re, 0);
  _fct_TiCell("Symbol");
  _fct_TiCell("Op.");
  _fct_TiCell("Assigned");
  testInfoHeadingEnd(_ttg_Re);
}


void _fct_TiTableFunctionCallReturnValue(char callSig[])
{
  char localBuf[256];
  _fct_TiTableHeadInit();
  snprintf(localBuf, elCount(localBuf), "Function call: %s", callSig);
  _ttg_Re = testInfoTable(localBuf);
  testInfoHeadingBegin(_ttg_Re, 0);
  _fct_TiCell("Symbol");
  _fct_TiCell("Op.");
  _fct_TiCell("Return Value");
  testInfoHeadingEnd(_ttg_Re);
}

void _fct_TiTableWaveformStimulus()
{
  _fct_TiTableHeadInit();
  _ttg_Re = testInfoTable("Stimulation of values with waveform curves");
   testInfoHeadingBegin(_ttg_Re, 0);
   _fct_TiCell("Symbol");
   _fct_TiCell("Stimulated with curve");
   testInfoHeadingEnd(_ttg_Re);
}

void _fct_TiTableHeadSetVariables()
{
  _fct_TiTableHeadInit();
  _ttg_Re = testInfoTable("Setting variable values");
  testInfoHeadingBegin(_ttg_Re, 0);
  _fct_TiCell("Variable");
  _fct_TiCell("Op.");
  _fct_TiCell("Assigned");
  testInfoHeadingEnd(_ttg_Re);
}
void _fct_TiTableHeadReport(char userText[])
{
  _fct_TiTableHeadInit();
  _ttg_Re = testInfoTable(userText);
  testInfoHeadingBegin(_ttg_Re, 0);
  _fct_TiCell("Symbol");
  _fct_TiCell("Value");
  testInfoHeadingEnd(_ttg_Re);
}
void _fct_TiTableHeadSend(char msgDesc[])
{
  char b[200];
  _fct_TiTableHeadInit();
  snprintf(b, elcount(b), "Send %s", msgDesc);
  _ttg_Re = testInfoTable(b);
  testInfoHeadingBegin(_ttg_Re, 0);
  _fct_TiCell("Signal/Byte");
  _fct_TiCell("Op.");
  _fct_TiCell("Assigned");
  testInfoHeadingEnd(_ttg_Re);
}

void _fct_TiTableHeadExpected()
{
  _fct_TiTableHeadExpectedEx("Check of expected values");
}

void _fct_TiTableHeadExpectedEx(char title[])
{
  _fct_TiTableHeadInit();
  _ttg_Re = testInfoTable(title);
  testInfoHeadingBegin(_ttg_Re, 0);
  _fct_TiCell("Symbol");
  _fct_TiCell("Op.");
  _fct_TiCell("Reference Value");
  _fct_TiCell("Actual");
  _fct_TiCell("Result");
  testInfoHeadingEnd(_ttg_Re);
}
void _fct_TiTableHeadResponse(char msgDesc[], int numReceived)
{
  char b[200];
  _fct_TiTableHeadInit();
  if (numReceived == -1)
    snprintf(b, elcount(b), "Response of %s", msgDesc); // maybe received after x MS?
  else
    snprintf(b, elcount(b), "Response of %s (received %d times)", msgDesc, numReceived);
  _ttg_Re = testInfoTable(b);
  testInfoHeadingBegin(_ttg_Re, 0);
  _fct_TiCell("Signal/Byte");
  _fct_TiCell("Op.");
  _fct_TiCell("Reference Value");
  if (numReceived == -1)
    _fct_TiCell("Actual");
  else
    _fct_TiCell("Last Received");
  _fct_TiCell("Result");
  testInfoHeadingEnd(_ttg_Re);
}

void _fct_TiCell(char text[])
{
  testInfoCell(_ttg_Re, text);
}

void _fct_TiCellResult(long condition)
{
  if(condition)
    _fct_TiCell("pass");
  else
  {
    _fct_TiCell("fail");
    ++_ttg_TestActionFailCnt;
  }
}

void _fct_TiCellResultTrueFalse(long condition)
{
  if(condition)
    _fct_TiCell("true");
  else
  {
    _fct_TiCell("false");
    ++_ttg_TestActionFailCnt;
  }
}

void _fct_TiCell(int64 value)
{
  _fct_TiIntCell(value);
}
void _fct_TiIntCell(int64 value)
{
  snprintf(_ttg_BR, elcount(_ttg_BR), "%I64d", value);
  _fct_TiCell(_ttg_BR);
}

void _fct_TiCell(double value)
{
  _fct_TiFloatCell(value);
}
void _fct_TiFloatCell(double value)
{
  snprintf(_ttg_BR, elcount(_ttg_BR), "%.15g", value);
  _fct_TiCell(_ttg_BR);
}

void _fct_TiRow(long indent, char firstCellContent[])
{
  testInfoRow(_ttg_Re, indent, firstCellContent);
}

void _fct_TiWriteByteX(int64 idx, char valueSymbol[], char nameOut[])
{
  if(valueSymbol[0] == 0)
    snprintf(nameOut, elcount(nameOut), "Byte[%I64d]", idx);
  else
    snprintf(nameOut, elcount(nameOut), "Byte[%I64d (%s)]", idx, valueSymbol);
}

void _fct_TiTableEvaluation(char stepIdentifier[])
{
  if(_ttg_TestActionFailCnt > 0)
  {
    testStepFail(0, stepIdentifier, _ttg_Re);
  }
  else
  {
    testStepPass(2, stepIdentifier, _ttg_Re);
  }
}

void _fct_TiTableEnd(char step[])
{
  testStep(2, step, _ttg_Re);
}


// report a byte stream
void _fct_TiCell_Bytes( long handle, BYTE rawBytes[], long count)
{
  char byteDigits[17];
  char byteDump[ 32 * 3 + 15]; // Only print up to 32 bytes in the first step -> also in "min..." below!
  long max;
  long i;
  long p;
  strncpy( byteDigits, "0123456789ABCDEF", 17); // Do explicit copy to prevent "initialized only once" warning

  p = snprintf( byteDump, elcount( byteDump), "[%d] ", count);
  max = _min( 32, count);
  for( i = 0; i < max; ++i)
  {
    byteDump[p++] = byteDigits[rawBytes[i] >> 4];
    byteDump[p++] = byteDigits[rawBytes[i] & 0xF];
    byteDump[p++] = ' ';
  }
  if( max < count)
  {
    byteDump[p++] = '.';
    byteDump[p++] = '.';
    byteDump[p++] = '.';
  }
  byteDump[--p] = 0;

  testInfoCell( handle, byteDump);
}

void _fct_SetBusContext(char bus[], int saveOldBusContext)
{
  _ttg_gBusContextOk = 1;
  _ttg_gBusContextNew = GetBusNameContext(bus);
  if(_ttg_gBusContextNew == 0)
  {
    _ttg_gBusContextOk = 0;
    testStepFail("", "Error: Cannot determine context for bus: %s", bus);
    _ttg_gBusContextOld = 0;
    return;
  }
  if(saveOldBusContext == 1)
  {
    _ttg_gBusContextOld = SetBusContext(_ttg_gBusContextNew);
  }
  else
  {
    SetBusContext(_ttg_gBusContextNew);
  }
}

void _fct_ResetBusContext()
{
  if(_ttg_gBusContextOld > 0)
  {
    SetBusContext(_ttg_gBusContextNew);
  }
}

int _fct_BusContextOk()
{
  return _ttg_gBusContextOk;
}

// _fct_EnsureSymbolName(SysVarFloat)
_fct_EnsureSymbolName(sysvarFloat * sym, char nameIn[], char nameOut[])
{
  if(strlen(nameIn) == 0)
  {
    snprintf(nameOut, elcount(nameOut), "System variable '%s'", sym.Name );
  }
  else { strncpy(nameOut, nameIn, elCount(nameOut)); }
}

// _fct_TiNameOpValue(Float)
_fct_TiNameOpValue(long indent, char nameIn[], char op[], float valueIn, char dstNameIn[])
{
  
  _fct_TiRow(indent, nameIn);
  _fct_TiCell(op);
  if (strlen(dstNameIn) == 0)
  {
    snprintf(_ttg_B, elCount(_ttg_B), "%.15g", valueIn);
  }
  else
  {
    snprintf(_ttg_B, elCount(_ttg_B), "%.15g (%s)", valueIn, dstNameIn);
  }
  _fct_TiCell(_ttg_B);

}

// _fct_TiValueCell(SysVarFloat)
_fct_TiValueCell(sysvarFloat * valueIn)
{
  _fct_TiCell(@valueIn);
}

// _fct_ChckRep(SysVarFloat,Float)
_fct_ChckRep(long indent, sysvarFloat * lSym, char lName[], char operator[], float rSym, char rName[])
{
  char symLNameBuf[256];
  _fct_EnsureSymbolName(lSym,lName,symLNameBuf);
  _fct_TiNameOpValue(indent, symLNameBuf, operator, rSym, rName);
  _fct_TiValueCell(lSym);
}

// _fct_TiNameOpValue(Int64)
_fct_TiNameOpValue(long indent, char nameIn[], char op[], int64 valueIn, char dstNameIn[])
{
  
  _fct_TiRow(indent, nameIn);
  _fct_TiCell(op);
  if (strlen(dstNameIn) == 0)
  {
    snprintf(_ttg_B, elCount(_ttg_B), "%I64d", valueIn);
  }
  else
  {
    snprintf(_ttg_B, elCount(_ttg_B), "%I64d (%s)", valueIn, dstNameIn);
  }
  _fct_TiCell(_ttg_B);

}

// _fct_ChckRep(SysVarFloat,Int64)
_fct_ChckRep(long indent, sysvarFloat * lSym, char lName[], char operator[], int64 rSym, char rName[])
{
  char symLNameBuf[256];
  _fct_EnsureSymbolName(lSym,lName,symLNameBuf);
  _fct_TiNameOpValue(indent, symLNameBuf, operator, rSym, rName);
  _fct_TiValueCell(lSym);
}

// _fct_EnsureSymbolName(Signal)
_fct_EnsureSymbolName(signal * sym, char nameIn[], char nameOut[])
{
  if(strlen(nameIn) == 0)
  {
    long i, len, pos;
    strncpy(nameOut, sym.name, elcount(nameOut));
    len = strlen(nameOut);
    // find last separator ':'
    pos = 0;
    for(i = len; i > 0; --i)
    {
	    if(nameOut[i] == ':')
	    {
	      pos = i;
        break;
      }
    }
    if(pos > 0 && pos != len)
    {
      char sigNameOnly[200];
      substr_cpy_off(sigNameOnly, 0, sym.name, pos+1, -1, elcount(sigNameOnly));
      snprintf(nameOut, elcount(nameOut), "Signal '%s'", sigNameOnly);
    }
  }
  else { strncpy(nameOut, nameIn, elCount(nameOut)); }
}

// _fct_Set(Signal,Int64)
_fct_Set(signal * dst, char dstName[], int64 src, char srcName[])
{
  char symDstBuf[256];
  _fct_EnsureSymbolName(dst,dstName,symDstBuf);
  $dst.phys = src;
  if(0 == getSignalTime(dst))
  {
    snprintf(_ttg_B, elcount(_ttg_B), "%s not online yet", symDstBuf);
    strncpy(symDstBuf, _ttg_B, elcount(symDstBuf));
  }
  _fct_TiNameOpValue(0, symDstBuf, "=", src, srcName);
}

// Test Tree
void _ttg_fct_tt_1_0()
{
  // Init FlexRay configuration
}
// _ttg_#_1_0
// Power supply initialization
void _ttg_fct_ts_1_0_0()
{
  _fct_CallTsTc("_ttg_ts_ts_1_0_0",3, 0,"Power supply initialization");
}
// _ttg_#_1_0_0
// 3.1 Color Definition
void _ttg_fct_ts_1_0_1()
{
  _fct_CallTsTc("_ttg_ts_ts_1_0_1",3, 0,"3.1 Color Definition");
}
// _ttg_#_1_0_1
// 3.2 Shut Down Status
void _ttg_fct_ts_1_0_2()
{
  _fct_CallTsTc("_ttg_ts_ts_1_0_2",3, 0,"3.2 Shut Down Status");
}
// _ttg_#_1_0_2
// Power supply initialization
testsequence _ttg_ts_ts_1_0_0()
{
  TestCommandBegin("CAPL Inline", "Initialize VT system,make VT internal power supply voltage output equals 12V");
  {
    _ttg_fct_caplinline_1_0_0_1();
  }
  // _ttg_!_1_0_0_1
  TestCommandEnd();
  if(_fct_TsDoBOF() || testIsStopRequested())
  {
    return;
  }
  TestCommandBegin("Wait", "Wait for power supply initialization complete");
  {
    _fct_Wait("1", (int64)(300LL * 1000000LL), 1000000, "");
  }
  // _ttg_!_1_0_0_2
  TestCommandEnd();
  if(_fct_TsDoBOF() || testIsStopRequested())
  {
    return;
  }
  TestCommandBegin("Check", "");
  {
    _fct_TiTableHeadExpected();
    _fct_ChckRep(0, sysvarFloat::VTS::M12_Out2::AvgVoltage, "System variable \'M12_Out2::AvgVoltage\'", "<=", 12.5, "");
    _fct_TiCellResult((CheckSignalMatch(sysvarFloat::VTS::M12_Out2::AvgVoltage, 12.5, "<=") == 1));
    _fct_ChckRep(0, sysvarFloat::VTS::M12_Out2::AvgVoltage, "System variable \'M12_Out2::AvgVoltage\'", ">=", 11.5, "");
    _fct_TiCellResult((CheckSignalMatch(sysvarFloat::VTS::M12_Out2::AvgVoltage, 11.5, ">=") == 1));
    _fct_ChckRep(0, sysvarFloat::VTS::M12_Out2::AvgCurrent, "System variable \'M12_Out2::AvgCurrent\'", ">=", 0.001, "");
    _fct_TiCellResult((CheckSignalMatch(sysvarFloat::VTS::M12_Out2::AvgCurrent, 0.001, ">=") == 1));
    _fct_ChckRep(0, sysvarFloat::VTS::M12_Out2::AvgCurrent, "System variable \'M12_Out2::AvgCurrent\'", "<=", 0.1, "");
    _fct_TiCellResult((CheckSignalMatch(sysvarFloat::VTS::M12_Out2::AvgCurrent, 0.1, "<=") == 1));
    _fct_TiTableEvaluation("1");
  }
  // _ttg_!_1_0_0_3
  TestCommandEnd();
  if(_fct_TsDoBOF() || testIsStopRequested())
  {
    return;
  }
}
// _ttg_#_1_0_0
// 3.1 Color Definition
testsequence _ttg_ts_ts_1_0_1()
{
  TestCommandBegin("CAPL Inline", "Set Pin4 input inactive at the beginning");
  {
    _ttg_fct_caplinline_1_0_1_1();
  }
  // _ttg_!_1_0_1_1
  TestCommandEnd();
  if(_fct_TsDoBOF() || testIsStopRequested())
  {
    return;
  }
  TestCommandBegin("Wait", "");
  {
    _fct_Wait("1", (int64)(1LL * 1000000000LL), 1000000000, "");
  }
  // _ttg_!_1_0_1_2
  TestCommandEnd();
  if(_fct_TsDoBOF() || testIsStopRequested())
  {
    return;
  }
  TestCommandBegin("CAPL Inline", "Long press on pin4 one time");
  {
    _ttg_fct_caplinline_1_0_1_3();
  }
  // _ttg_!_1_0_1_3
  TestCommandEnd();
  if(_fct_TsDoBOF() || testIsStopRequested())
  {
    return;
  }
  TestCommandBegin("CANoe Standard Service", "testValidateTesterConfirmation");
  {
    testStepPass(2, "", "Execute testValidateTesterConfirmation(\"breakpoint\", \"\", 1)");
    testValidateTesterConfirmation("breakpoint", "", 1LL);
  }
  // _ttg_!_1_0_1_4
  TestCommandEnd();
  if(_fct_TsDoBOF() || testIsStopRequested())
  {
    return;
  }
  TestCommandBegin("Wait", "");
  {
    _fct_Wait("1", (int64)(900LL * 1000000LL), 1000000, "");
  }
  // _ttg_!_1_0_1_5
  TestCommandEnd();
  if(_fct_TsDoBOF() || testIsStopRequested())
  {
    return;
  }
  TestCommandBegin("CAPL Inline", "Release pin4");
  {
    _ttg_fct_caplinline_1_0_1_6();
  }
  // _ttg_!_1_0_1_6
  TestCommandEnd();
  if(_fct_TsDoBOF() || testIsStopRequested())
  {
    return;
  }
  TestCommandBegin("Check", "Check if it's under Day mode Mode0");
  {
    _fct_TiTableHeadExpected();
    _fct_ChckRep(0, sysvarFloat::VTS::M9_Ch3::PWMFreq, "System variable \'M9_Ch3::PWMFreq\'", ">=", 190LL, "");
    _fct_TiCellResult((CheckSignalMatch(sysvarFloat::VTS::M9_Ch3::PWMFreq, 190LL, ">=") == 1));
    _fct_ChckRep(0, sysvarFloat::VTS::M9_Ch3::PWMFreq, "System variable \'M9_Ch3::PWMFreq\'", "<=", 210LL, "");
    _fct_TiCellResult((CheckSignalMatch(sysvarFloat::VTS::M9_Ch3::PWMFreq, 210LL, "<=") == 1));
    _fct_ChckRep(0, sysvarFloat::VTS::M9_Ch3::PWMDC, "System variable \'M9_Ch3::PWMDC\'", "<=", 3.06, "");
    _fct_TiCellResult((CheckSignalMatch(sysvarFloat::VTS::M9_Ch3::PWMDC, 3.06, "<=") == 1));
    _fct_ChckRep(0, sysvarFloat::VTS::M9_Ch3::PWMDC, "System variable \'M9_Ch3::PWMDC\'", ">=", 2.94, "");
    _fct_TiCellResult((CheckSignalMatch(sysvarFloat::VTS::M9_Ch3::PWMDC, 2.94, ">=") == 1));
    _fct_ChckRep(0, sysvarFloat::VTS::M9_Ch3::Avg, "System variable \'M9_Ch3::Avg\'", ">=", 9LL, "");
    _fct_TiCellResult((CheckSignalMatch(sysvarFloat::VTS::M9_Ch3::Avg, 9LL, ">=") == 1));
    _fct_ChckRep(0, sysvarFloat::VTS::M9_Ch2::PWMFreq, "System variable \'M9_Ch2::PWMFreq\'", ">=", 190LL, "");
    _fct_TiCellResult((CheckSignalMatch(sysvarFloat::VTS::M9_Ch2::PWMFreq, 190LL, ">=") == 1));
    _fct_ChckRep(0, sysvarFloat::VTS::M9_Ch2::PWMDC, "System variable \'M9_Ch2::PWMDC\'", "==", 50LL, "");
    _fct_TiCellResult((CheckSignalMatch(sysvarFloat::VTS::M9_Ch2::PWMDC, 50LL, "=") == 1));
    _fct_ChckRep(0, sysvarFloat::VTS::M9_Ch2::Avg, "System variable \'M9_Ch2::Avg\'", ">=", 9LL, "");
    _fct_TiCellResult((CheckSignalMatch(sysvarFloat::VTS::M9_Ch2::Avg, 9LL, ">=") == 1));
    _fct_ChckRep(0, sysvarFloat::VTS::M9_Ch1::PWMFreq, "System variable \'M9_Ch1::PWMFreq\'", ">=", 190LL, "");
    _fct_TiCellResult((CheckSignalMatch(sysvarFloat::VTS::M9_Ch1::PWMFreq, 190LL, ">=") == 1));
    _fct_ChckRep(0, sysvarFloat::VTS::M9_Ch1::PWMDC, "System variable \'M9_Ch1::PWMDC\'", "==", 50LL, "");
    _fct_TiCellResult((CheckSignalMatch(sysvarFloat::VTS::M9_Ch1::PWMDC, 50LL, "=") == 1));
    _fct_ChckRep(0, sysvarFloat::VTS::M9_Ch1::Avg, "System variable \'M9_Ch1::Avg\'", ">=", 9LL, "");
    _fct_TiCellResult((CheckSignalMatch(sysvarFloat::VTS::M9_Ch1::Avg, 9LL, ">=") == 1));
    _fct_TiTableEvaluation("1");
  }
  // _ttg_!_1_0_1_7
  TestCommandEnd();
  if(_fct_TsDoBOF() || testIsStopRequested())
  {
    return;
  }
  TestCommandBegin("Check", "Check if it's under Mode0");
  {
    _fct_TiTableHeadExpected();
    _fct_ChckRep(0, sysvarFloat::VTS::M9_Ch1::Avg, "System variable \'M9_Ch1::Avg\'", "<=", 0.5, "");
    _fct_TiCellResult((CheckSignalMatch(sysvarFloat::VTS::M9_Ch1::Avg, 0.5, "<=") == 1));
    _fct_ChckRep(0, sysvarFloat::VTS::M9_Ch2::Avg, "System variable \'M9_Ch2::Avg\'", "<=", 0.5, "");
    _fct_TiCellResult((CheckSignalMatch(sysvarFloat::VTS::M9_Ch2::Avg, 0.5, "<=") == 1));
    _fct_ChckRep(0, sysvarFloat::VTS::M9_Ch3::Avg, "System variable \'M9_Ch3::Avg\'", "<=", 0.5, "");
    _fct_TiCellResult((CheckSignalMatch(sysvarFloat::VTS::M9_Ch3::Avg, 0.5, "<=") == 1));
    _fct_TiTableEvaluation("1");
  }
  // _ttg_!_1_0_1_8
  TestCommandEnd();
  if(_fct_TsDoBOF() || testIsStopRequested())
  {
    return;
  }
  TestCommandBegin("Set", "PosLmpSts=0 @ Day Mode");
  {
    _fct_TiTableHeadAssignment();
    _fct_Set(CAN::dbNode::BCM::BCM1::PosLmpSts, "CAN signal \'PosLmpSts\'", 0LL, "");
    _fct_TiTableEnd("1");
  }
  // _ttg_!_1_0_1_9
  TestCommandEnd();
  if(_fct_TsDoBOF() || testIsStopRequested())
  {
    return;
  }
  TestCommandBegin("CAPL Inline", "Short press on pin4 one time");
  {
    _ttg_fct_caplinline_1_0_1_10();
  }
  // _ttg_!_1_0_1_10
  TestCommandEnd();
  if(_fct_TsDoBOF() || testIsStopRequested())
  {
    return;
  }
  TestCommandBegin("Wait", "press for 32 ms");
  {
    _fct_Wait("1", (int64)(32LL * 1000000LL), 1000000, "");
  }
  // _ttg_!_1_0_1_11
  TestCommandEnd();
  if(_fct_TsDoBOF() || testIsStopRequested())
  {
    return;
  }
  TestCommandBegin("CAPL Inline", "Release pin4");
  {
    _ttg_fct_caplinline_1_0_1_12();
  }
  // _ttg_!_1_0_1_12
  TestCommandEnd();
  if(_fct_TsDoBOF() || testIsStopRequested())
  {
    return;
  }
  TestCommandBegin("Check", "Check if it's under Day mode Mode1");
  {
    _fct_TiTableHeadExpected();
    _fct_ChckRep(0, sysvarFloat::VTS::M9_Ch3::PWMFreq, "System variable \'M9_Ch3::PWMFreq\'", ">=", 190LL, "");
    _fct_TiCellResult((CheckSignalMatch(sysvarFloat::VTS::M9_Ch3::PWMFreq, 190LL, ">=") == 1));
    _fct_ChckRep(0, sysvarFloat::VTS::M9_Ch3::PWMFreq, "System variable \'M9_Ch3::PWMFreq\'", "<=", 210LL, "");
    _fct_TiCellResult((CheckSignalMatch(sysvarFloat::VTS::M9_Ch3::PWMFreq, 210LL, "<=") == 1));
    _fct_ChckRep(0, sysvarFloat::VTS::M9_Ch3::PWMDC, "System variable \'M9_Ch3::PWMDC\'", "<=", 3.06, "");
    _fct_TiCellResult((CheckSignalMatch(sysvarFloat::VTS::M9_Ch3::PWMDC, 3.06, "<=") == 1));
    _fct_ChckRep(0, sysvarFloat::VTS::M9_Ch3::PWMDC, "System variable \'M9_Ch3::PWMDC\'", ">=", 2.94, "");
    _fct_TiCellResult((CheckSignalMatch(sysvarFloat::VTS::M9_Ch3::PWMDC, 2.94, ">=") == 1));
    _fct_ChckRep(0, sysvarFloat::VTS::M9_Ch3::Avg, "System variable \'M9_Ch3::Avg\'", ">=", 9LL, "");
    _fct_TiCellResult((CheckSignalMatch(sysvarFloat::VTS::M9_Ch3::Avg, 9LL, ">=") == 1));
    _fct_ChckRep(0, sysvarFloat::VTS::M9_Ch2::PWMFreq, "System variable \'M9_Ch2::PWMFreq\'", ">=", 190LL, "");
    _fct_TiCellResult((CheckSignalMatch(sysvarFloat::VTS::M9_Ch2::PWMFreq, 190LL, ">=") == 1));
    _fct_ChckRep(0, sysvarFloat::VTS::M9_Ch2::PWMDC, "System variable \'M9_Ch2::PWMDC\'", "==", 50LL, "");
    _fct_TiCellResult((CheckSignalMatch(sysvarFloat::VTS::M9_Ch2::PWMDC, 50LL, "=") == 1));
    _fct_ChckRep(0, sysvarFloat::VTS::M9_Ch2::Avg, "System variable \'M9_Ch2::Avg\'", ">=", 9LL, "");
    _fct_TiCellResult((CheckSignalMatch(sysvarFloat::VTS::M9_Ch2::Avg, 9LL, ">=") == 1));
    _fct_ChckRep(0, sysvarFloat::VTS::M9_Ch1::PWMFreq, "System variable \'M9_Ch1::PWMFreq\'", ">=", 190LL, "");
    _fct_TiCellResult((CheckSignalMatch(sysvarFloat::VTS::M9_Ch1::PWMFreq, 190LL, ">=") == 1));
    _fct_ChckRep(0, sysvarFloat::VTS::M9_Ch1::PWMDC, "System variable \'M9_Ch1::PWMDC\'", "==", 50LL, "");
    _fct_TiCellResult((CheckSignalMatch(sysvarFloat::VTS::M9_Ch1::PWMDC, 50LL, "=") == 1));
    _fct_ChckRep(0, sysvarFloat::VTS::M9_Ch1::Avg, "System variable \'M9_Ch1::Avg\'", ">=", 9LL, "");
    _fct_TiCellResult((CheckSignalMatch(sysvarFloat::VTS::M9_Ch1::Avg, 9LL, ">=") == 1));
    _fct_TiTableEvaluation("1");
  }
  // _ttg_!_1_0_1_13
  TestCommandEnd();
  if(_fct_TsDoBOF() || testIsStopRequested())
  {
    return;
  }
  TestCommandBegin("CAPL Inline", "Short press on pin4 one time");
  {
    _ttg_fct_caplinline_1_0_1_14();
  }
  // _ttg_!_1_0_1_14
  TestCommandEnd();
  if(_fct_TsDoBOF() || testIsStopRequested())
  {
    return;
  }
  TestCommandBegin("Wait", "press for 100 ms");
  {
    _fct_Wait("1", (int64)(100LL * 1000000LL), 1000000, "");
  }
  // _ttg_!_1_0_1_15
  TestCommandEnd();
  if(_fct_TsDoBOF() || testIsStopRequested())
  {
    return;
  }
  TestCommandBegin("CAPL Inline", "Release pin4");
  {
    _ttg_fct_caplinline_1_0_1_16();
  }
  // _ttg_!_1_0_1_16
  TestCommandEnd();
  if(_fct_TsDoBOF() || testIsStopRequested())
  {
    return;
  }
  TestCommandBegin("Check", "Check if it's under Day mode Mode2");
  {
    _fct_TiTableHeadExpected();
    _fct_ChckRep(0, sysvarFloat::VTS::M9_Ch3::PWMFreq, "System variable \'M9_Ch3::PWMFreq\'", ">=", 190LL, "");
    _fct_TiCellResult((CheckSignalMatch(sysvarFloat::VTS::M9_Ch3::PWMFreq, 190LL, ">=") == 1));
    _fct_ChckRep(0, sysvarFloat::VTS::M9_Ch3::PWMFreq, "System variable \'M9_Ch3::PWMFreq\'", "<=", 210LL, "");
    _fct_TiCellResult((CheckSignalMatch(sysvarFloat::VTS::M9_Ch3::PWMFreq, 210LL, "<=") == 1));
    _fct_ChckRep(0, sysvarFloat::VTS::M9_Ch3::PWMDC, "System variable \'M9_Ch3::PWMDC\'", "<=", 97.92, "");
    _fct_TiCellResult((CheckSignalMatch(sysvarFloat::VTS::M9_Ch3::PWMDC, 97.92, "<=") == 1));
    _fct_ChckRep(0, sysvarFloat::VTS::M9_Ch3::PWMDC, "System variable \'M9_Ch3::PWMDC\'", ">=", 94.08, "");
    _fct_TiCellResult((CheckSignalMatch(sysvarFloat::VTS::M9_Ch3::PWMDC, 94.08, ">=") == 1));
    _fct_ChckRep(0, sysvarFloat::VTS::M9_Ch2::PWMFreq, "System variable \'M9_Ch2::PWMFreq\'", ">=", 190LL, "");
    _fct_TiCellResult((CheckSignalMatch(sysvarFloat::VTS::M9_Ch2::PWMFreq, 190LL, ">=") == 1));
    _fct_ChckRep(0, sysvarFloat::VTS::M9_Ch2::PWMFreq, "System variable \'M9_Ch2::PWMFreq\'", "<=", 210LL, "");
    _fct_TiCellResult((CheckSignalMatch(sysvarFloat::VTS::M9_Ch2::PWMFreq, 210LL, "<=") == 1));
    _fct_ChckRep(0, sysvarFloat::VTS::M9_Ch2::PWMDC, "System variable \'M9_Ch2::PWMDC\'", "<=", 20.04, "");
    _fct_TiCellResult((CheckSignalMatch(sysvarFloat::VTS::M9_Ch2::PWMDC, 20.04, "<=") == 1));
    _fct_ChckRep(0, sysvarFloat::VTS::M9_Ch2::PWMDC, "System variable \'M9_Ch2::PWMDC\'", ">=", 19.6, "");
    _fct_TiCellResult((CheckSignalMatch(sysvarFloat::VTS::M9_Ch2::PWMDC, 19.6, ">=") == 1));
    _fct_ChckRep(0, sysvarFloat::VTS::M9_Ch1::Avg, "System variable \'M9_Ch1::Avg\'", "<=", 0.2, "");
    _fct_TiCellResult((CheckSignalMatch(sysvarFloat::VTS::M9_Ch1::Avg, 0.2, "<=") == 1));
    _fct_TiTableEvaluation("1");
  }
  // _ttg_!_1_0_1_17
  TestCommandEnd();
  if(_fct_TsDoBOF() || testIsStopRequested())
  {
    return;
  }
  TestCommandBegin("CAPL Inline", "Short press on pin4 one time");
  {
    _ttg_fct_caplinline_1_0_1_18();
  }
  // _ttg_!_1_0_1_18
  TestCommandEnd();
  if(_fct_TsDoBOF() || testIsStopRequested())
  {
    return;
  }
  TestCommandBegin("Wait", "press for 200 ms");
  {
    _fct_Wait("1", (int64)(200LL * 1000000LL), 1000000, "");
  }
  // _ttg_!_1_0_1_19
  TestCommandEnd();
  if(_fct_TsDoBOF() || testIsStopRequested())
  {
    return;
  }
  TestCommandBegin("CAPL Inline", "Release pin4");
  {
    _ttg_fct_caplinline_1_0_1_20();
  }
  // _ttg_!_1_0_1_20
  TestCommandEnd();
  if(_fct_TsDoBOF() || testIsStopRequested())
  {
    return;
  }
  TestCommandBegin("Check", "Check if it's under Day mode Mode3");
  {
    _fct_TiTableHeadExpected();
    _fct_ChckRep(0, sysvarFloat::VTS::M9_Ch3::Avg, "System variable \'M9_Ch3::Avg\'", "<=", 0.2, "");
    _fct_TiCellResult((CheckSignalMatch(sysvarFloat::VTS::M9_Ch3::Avg, 0.2, "<=") == 1));
    _fct_ChckRep(0, sysvarFloat::VTS::M9_Ch2::PWMFreq, "System variable \'M9_Ch2::PWMFreq\'", ">=", 190LL, "");
    _fct_TiCellResult((CheckSignalMatch(sysvarFloat::VTS::M9_Ch2::PWMFreq, 190LL, ">=") == 1));
    _fct_ChckRep(0, sysvarFloat::VTS::M9_Ch2::PWMFreq, "System variable \'M9_Ch2::PWMFreq\'", "<=", 210LL, "");
    _fct_TiCellResult((CheckSignalMatch(sysvarFloat::VTS::M9_Ch2::PWMFreq, 210LL, "<=") == 1));
    _fct_ChckRep(0, sysvarFloat::VTS::M9_Ch2::PWMDC, "System variable \'M9_Ch2::PWMDC\'", "<=", 32.64, "");
    _fct_TiCellResult((CheckSignalMatch(sysvarFloat::VTS::M9_Ch2::PWMDC, 32.64, "<=") == 1));
    _fct_ChckRep(0, sysvarFloat::VTS::M9_Ch2::PWMDC, "System variable \'M9_Ch2::PWMDC\'", ">=", 31.36, "");
    _fct_TiCellResult((CheckSignalMatch(sysvarFloat::VTS::M9_Ch2::PWMDC, 31.36, ">=") == 1));
    _fct_ChckRep(0, sysvarFloat::VTS::M9_Ch1::Avg, "System variable \'M9_Ch1::Avg\'", ">=", 10LL, "");
    _fct_TiCellResult((CheckSignalMatch(sysvarFloat::VTS::M9_Ch1::Avg, 10LL, ">=") == 1));
    _fct_TiTableEvaluation("1");
  }
  // _ttg_!_1_0_1_21
  TestCommandEnd();
  if(_fct_TsDoBOF() || testIsStopRequested())
  {
    return;
  }
  TestCommandBegin("CAPL Inline", "Short press on pin4 one time");
  {
    _ttg_fct_caplinline_1_0_1_22();
  }
  // _ttg_!_1_0_1_22
  TestCommandEnd();
  if(_fct_TsDoBOF() || testIsStopRequested())
  {
    return;
  }
  TestCommandBegin("Wait", "press for 300 ms");
  {
    _fct_Wait("1", (int64)(300LL * 1000000LL), 1000000, "");
  }
  // _ttg_!_1_0_1_23
  TestCommandEnd();
  if(_fct_TsDoBOF() || testIsStopRequested())
  {
    return;
  }
  TestCommandBegin("CAPL Inline", "Release pin4");
  {
    _ttg_fct_caplinline_1_0_1_24();
  }
  // _ttg_!_1_0_1_24
  TestCommandEnd();
  if(_fct_TsDoBOF() || testIsStopRequested())
  {
    return;
  }
  TestCommandBegin("Check", "Check if it's under Day mode Mode1");
  {
    _fct_TiTableHeadExpected();
    _fct_ChckRep(0, sysvarFloat::VTS::M9_Ch3::PWMFreq, "System variable \'M9_Ch3::PWMFreq\'", ">=", 190LL, "");
    _fct_TiCellResult((CheckSignalMatch(sysvarFloat::VTS::M9_Ch3::PWMFreq, 190LL, ">=") == 1));
    _fct_ChckRep(0, sysvarFloat::VTS::M9_Ch3::PWMFreq, "System variable \'M9_Ch3::PWMFreq\'", "<=", 210LL, "");
    _fct_TiCellResult((CheckSignalMatch(sysvarFloat::VTS::M9_Ch3::PWMFreq, 210LL, "<=") == 1));
    _fct_ChckRep(0, sysvarFloat::VTS::M9_Ch3::PWMDC, "System variable \'M9_Ch3::PWMDC\'", "<=", 3.06, "");
    _fct_TiCellResult((CheckSignalMatch(sysvarFloat::VTS::M9_Ch3::PWMDC, 3.06, "<=") == 1));
    _fct_ChckRep(0, sysvarFloat::VTS::M9_Ch3::PWMDC, "System variable \'M9_Ch3::PWMDC\'", ">=", 2.94, "");
    _fct_TiCellResult((CheckSignalMatch(sysvarFloat::VTS::M9_Ch3::PWMDC, 2.94, ">=") == 1));
    _fct_ChckRep(0, sysvarFloat::VTS::M9_Ch2::Avg, "System variable \'M9_Ch2::Avg\'", "<=", 0.2, "");
    _fct_TiCellResult((CheckSignalMatch(sysvarFloat::VTS::M9_Ch2::Avg, 0.2, "<=") == 1));
    _fct_ChckRep(0, sysvarFloat::VTS::M9_Ch1::Avg, "System variable \'M9_Ch1::Avg\'", ">=", 10LL, "");
    _fct_TiCellResult((CheckSignalMatch(sysvarFloat::VTS::M9_Ch1::Avg, 10LL, ">=") == 1));
    _fct_TiTableEvaluation("1");
  }
  // _ttg_!_1_0_1_25
  TestCommandEnd();
  if(_fct_TsDoBOF() || testIsStopRequested())
  {
    return;
  }
  TestCommandBegin("Set", "PosLmpSts=1 @ Night mode");
  {
    _fct_TiTableHeadAssignment();
    _fct_Set(CAN::dbNode::BCM::BCM1::PosLmpSts, "CAN signal \'PosLmpSts\'", 1LL, "");
    _fct_TiTableEnd("1");
  }
  // _ttg_!_1_0_1_26
  TestCommandEnd();
  if(_fct_TsDoBOF() || testIsStopRequested())
  {
    return;
  }
  TestCommandBegin("CAPL Inline", "Short press on pin4 one time");
  {
    _ttg_fct_caplinline_1_0_1_27();
  }
  // _ttg_!_1_0_1_27
  TestCommandEnd();
  if(_fct_TsDoBOF() || testIsStopRequested())
  {
    return;
  }
  TestCommandBegin("Wait", "press for 400 ms");
  {
    _fct_Wait("1", (int64)(400LL * 1000000LL), 1000000, "");
  }
  // _ttg_!_1_0_1_28
  TestCommandEnd();
  if(_fct_TsDoBOF() || testIsStopRequested())
  {
    return;
  }
  TestCommandBegin("CAPL Inline", "Release pin4");
  {
    _ttg_fct_caplinline_1_0_1_29();
  }
  // _ttg_!_1_0_1_29
  TestCommandEnd();
  if(_fct_TsDoBOF() || testIsStopRequested())
  {
    return;
  }
  TestCommandBegin("Check", "Check if it's under Night mode Mode4");
  {
    _fct_TiTableHeadExpected();
    _fct_ChckRep(0, sysvarFloat::VTS::M9_Ch3::PWMFreq, "System variable \'M9_Ch3::PWMFreq\'", ">=", 190LL, "");
    _fct_TiCellResult((CheckSignalMatch(sysvarFloat::VTS::M9_Ch3::PWMFreq, 190LL, ">=") == 1));
    _fct_ChckRep(0, sysvarFloat::VTS::M9_Ch3::PWMFreq, "System variable \'M9_Ch3::PWMFreq\'", "<=", 210LL, "");
    _fct_TiCellResult((CheckSignalMatch(sysvarFloat::VTS::M9_Ch3::PWMFreq, 210LL, "<=") == 1));
    _fct_ChckRep(0, sysvarFloat::VTS::M9_Ch3::PWMDC, "System variable \'M9_Ch3::PWMDC\'", "<=", 2.04, "");
    _fct_TiCellResult((CheckSignalMatch(sysvarFloat::VTS::M9_Ch3::PWMDC, 2.04, "<=") == 1));
    _fct_ChckRep(0, sysvarFloat::VTS::M9_Ch3::PWMDC, "System variable \'M9_Ch3::PWMDC\'", ">=", 1.96, "");
    _fct_TiCellResult((CheckSignalMatch(sysvarFloat::VTS::M9_Ch3::PWMDC, 1.96, ">=") == 1));
    _fct_ChckRep(0, sysvarFloat::VTS::M9_Ch2::Avg, "System variable \'M9_Ch2::Avg\'", "<=", 0.2, "");
    _fct_TiCellResult((CheckSignalMatch(sysvarFloat::VTS::M9_Ch2::Avg, 0.2, "<=") == 1));
    _fct_ChckRep(0, sysvarFloat::VTS::M9_Ch1::PWMFreq, "System variable \'M9_Ch1::PWMFreq\'", ">=", 190LL, "");
    _fct_TiCellResult((CheckSignalMatch(sysvarFloat::VTS::M9_Ch1::PWMFreq, 190LL, ">=") == 1));
    _fct_ChckRep(0, sysvarFloat::VTS::M9_Ch1::PWMFreq, "System variable \'M9_Ch1::PWMFreq\'", "<=", 210LL, "");
    _fct_TiCellResult((CheckSignalMatch(sysvarFloat::VTS::M9_Ch1::PWMFreq, 210LL, "<=") == 1));
    _fct_ChckRep(0, sysvarFloat::VTS::M9_Ch1::PWMDC, "System variable \'M9_Ch1::PWMDC\'", "<=", 76.5, "");
    _fct_TiCellResult((CheckSignalMatch(sysvarFloat::VTS::M9_Ch1::PWMDC, 76.5, "<=") == 1));
    _fct_ChckRep(0, sysvarFloat::VTS::M9_Ch1::PWMDC, "System variable \'M9_Ch1::PWMDC\'", ">=", 73.5, "");
    _fct_TiCellResult((CheckSignalMatch(sysvarFloat::VTS::M9_Ch1::PWMDC, 73.5, ">=") == 1));
    _fct_TiTableEvaluation("1");
  }
  // _ttg_!_1_0_1_30
  TestCommandEnd();
  if(_fct_TsDoBOF() || testIsStopRequested())
  {
    return;
  }
  TestCommandBegin("CAPL Inline", "Short press on pin4 one time");
  {
    _ttg_fct_caplinline_1_0_1_31();
  }
  // _ttg_!_1_0_1_31
  TestCommandEnd();
  if(_fct_TsDoBOF() || testIsStopRequested())
  {
    return;
  }
  TestCommandBegin("Wait", "press for 500 ms");
  {
    _fct_Wait("1", (int64)(500LL * 1000000LL), 1000000, "");
  }
  // _ttg_!_1_0_1_32
  TestCommandEnd();
  if(_fct_TsDoBOF() || testIsStopRequested())
  {
    return;
  }
  TestCommandBegin("CAPL Inline", "Release pin4");
  {
    _ttg_fct_caplinline_1_0_1_33();
  }
  // _ttg_!_1_0_1_33
  TestCommandEnd();
  if(_fct_TsDoBOF() || testIsStopRequested())
  {
    return;
  }
  TestCommandBegin("Check", "Check if it's under Night mode Mode5");
  {
    _fct_TiTableHeadExpected();
    _fct_ChckRep(0, sysvarFloat::VTS::M9_Ch3::PWMFreq, "System variable \'M9_Ch3::PWMFreq\'", ">=", 190LL, "");
    _fct_TiCellResult((CheckSignalMatch(sysvarFloat::VTS::M9_Ch3::PWMFreq, 190LL, ">=") == 1));
    _fct_ChckRep(0, sysvarFloat::VTS::M9_Ch3::PWMFreq, "System variable \'M9_Ch3::PWMFreq\'", "<=", 210LL, "");
    _fct_TiCellResult((CheckSignalMatch(sysvarFloat::VTS::M9_Ch3::PWMFreq, 210LL, "<=") == 1));
    _fct_ChckRep(0, sysvarFloat::VTS::M9_Ch3::PWMDC, "System variable \'M9_Ch3::PWMDC\'", "<=", 73.44, "");
    _fct_TiCellResult((CheckSignalMatch(sysvarFloat::VTS::M9_Ch3::PWMDC, 73.44, "<=") == 1));
    _fct_ChckRep(0, sysvarFloat::VTS::M9_Ch3::PWMDC, "System variable \'M9_Ch3::PWMDC\'", ">=", 70.56, "");
    _fct_TiCellResult((CheckSignalMatch(sysvarFloat::VTS::M9_Ch3::PWMDC, 70.56, ">=") == 1));
    _fct_ChckRep(0, sysvarFloat::VTS::M9_Ch2::PWMFreq, "System variable \'M9_Ch2::PWMFreq\'", ">=", 190LL, "");
    _fct_TiCellResult((CheckSignalMatch(sysvarFloat::VTS::M9_Ch2::PWMFreq, 190LL, ">=") == 1));
    _fct_ChckRep(0, sysvarFloat::VTS::M9_Ch2::PWMFreq, "System variable \'M9_Ch2::PWMFreq\'", "<=", 210LL, "");
    _fct_TiCellResult((CheckSignalMatch(sysvarFloat::VTS::M9_Ch2::PWMFreq, 210LL, "<=") == 1));
    _fct_ChckRep(0, sysvarFloat::VTS::M9_Ch2::PWMDC, "System variable \'M9_Ch2::PWMDC\'", "<=", 15.3, "");
    _fct_TiCellResult((CheckSignalMatch(sysvarFloat::VTS::M9_Ch2::PWMDC, 15.3, "<=") == 1));
    _fct_ChckRep(0, sysvarFloat::VTS::M9_Ch2::PWMDC, "System variable \'M9_Ch2::PWMDC\'", ">=", 14.7, "");
    _fct_TiCellResult((CheckSignalMatch(sysvarFloat::VTS::M9_Ch2::PWMDC, 14.7, ">=") == 1));
    _fct_ChckRep(0, sysvarFloat::VTS::M9_Ch1::Avg, "System variable \'M9_Ch1::Avg\'", "<=", 0.2, "");
    _fct_TiCellResult((CheckSignalMatch(sysvarFloat::VTS::M9_Ch1::Avg, 0.2, "<=") == 1));
    _fct_TiTableEvaluation("1");
  }
  // _ttg_!_1_0_1_34
  TestCommandEnd();
  if(_fct_TsDoBOF() || testIsStopRequested())
  {
    return;
  }
  TestCommandBegin("CAPL Inline", "Short press on pin4 one time");
  {
    _ttg_fct_caplinline_1_0_1_35();
  }
  // _ttg_!_1_0_1_35
  TestCommandEnd();
  if(_fct_TsDoBOF() || testIsStopRequested())
  {
    return;
  }
  TestCommandBegin("Wait", "press for 600 ms");
  {
    _fct_Wait("1", (int64)(600LL * 1000000LL), 1000000, "");
  }
  // _ttg_!_1_0_1_36
  TestCommandEnd();
  if(_fct_TsDoBOF() || testIsStopRequested())
  {
    return;
  }
  TestCommandBegin("CAPL Inline", "Release pin4");
  {
    _ttg_fct_caplinline_1_0_1_37();
  }
  // _ttg_!_1_0_1_37
  TestCommandEnd();
  if(_fct_TsDoBOF() || testIsStopRequested())
  {
    return;
  }
  TestCommandBegin("Check", "Check if it's under Night mode Mode6");
  {
    _fct_TiTableHeadExpected();
    _fct_ChckRep(0, sysvarFloat::VTS::M9_Ch3::Avg, "System variable \'M9_Ch3::Avg\'", "<=", 0.2, "");
    _fct_TiCellResult((CheckSignalMatch(sysvarFloat::VTS::M9_Ch3::Avg, 0.2, "<=") == 1));
    _fct_ChckRep(0, sysvarFloat::VTS::M9_Ch2::PWMFreq, "System variable \'M9_Ch2::PWMFreq\'", ">=", 190LL, "");
    _fct_TiCellResult((CheckSignalMatch(sysvarFloat::VTS::M9_Ch2::PWMFreq, 190LL, ">=") == 1));
    _fct_ChckRep(0, sysvarFloat::VTS::M9_Ch2::PWMFreq, "System variable \'M9_Ch2::PWMFreq\'", "<=", 210LL, "");
    _fct_TiCellResult((CheckSignalMatch(sysvarFloat::VTS::M9_Ch2::PWMFreq, 210LL, "<=") == 1));
    _fct_ChckRep(0, sysvarFloat::VTS::M9_Ch2::PWMDC, "System variable \'M9_Ch2::PWMDC\'", "<=", 24.48, "");
    _fct_TiCellResult((CheckSignalMatch(sysvarFloat::VTS::M9_Ch2::PWMDC, 24.48, "<=") == 1));
    _fct_ChckRep(0, sysvarFloat::VTS::M9_Ch2::PWMDC, "System variable \'M9_Ch2::PWMDC\'", ">=", 23.52, "");
    _fct_TiCellResult((CheckSignalMatch(sysvarFloat::VTS::M9_Ch2::PWMDC, 23.52, ">=") == 1));
    _fct_ChckRep(0, sysvarFloat::VTS::M9_Ch1::PWMFreq, "System variable \'M9_Ch1::PWMFreq\'", ">=", 190LL, "");
    _fct_TiCellResult((CheckSignalMatch(sysvarFloat::VTS::M9_Ch1::PWMFreq, 190LL, ">=") == 1));
    _fct_ChckRep(0, sysvarFloat::VTS::M9_Ch1::PWMFreq, "System variable \'M9_Ch1::PWMFreq\'", "<=", 210LL, "");
    _fct_TiCellResult((CheckSignalMatch(sysvarFloat::VTS::M9_Ch1::PWMFreq, 210LL, "<=") == 1));
    _fct_ChckRep(0, sysvarFloat::VTS::M9_Ch1::PWMDC, "System variable \'M9_Ch1::PWMDC\'", "<=", 76.5, "");
    _fct_TiCellResult((CheckSignalMatch(sysvarFloat::VTS::M9_Ch1::PWMDC, 76.5, "<=") == 1));
    _fct_ChckRep(0, sysvarFloat::VTS::M9_Ch1::PWMDC, "System variable \'M9_Ch1::PWMDC\'", ">=", 73.5, "");
    _fct_TiCellResult((CheckSignalMatch(sysvarFloat::VTS::M9_Ch1::PWMDC, 73.5, ">=") == 1));
    _fct_TiTableEvaluation("1");
  }
  // _ttg_!_1_0_1_38
  TestCommandEnd();
  if(_fct_TsDoBOF() || testIsStopRequested())
  {
    return;
  }
  TestCommandBegin("CAPL Inline", "Short press on pin4 one time");
  {
    _ttg_fct_caplinline_1_0_1_39();
  }
  // _ttg_!_1_0_1_39
  TestCommandEnd();
  if(_fct_TsDoBOF() || testIsStopRequested())
  {
    return;
  }
  TestCommandBegin("Wait", "press for 700 ms");
  {
    _fct_Wait("1", (int64)(700LL * 1000000LL), 1000000, "");
  }
  // _ttg_!_1_0_1_40
  TestCommandEnd();
  if(_fct_TsDoBOF() || testIsStopRequested())
  {
    return;
  }
  TestCommandBegin("CAPL Inline", "Release pin4");
  {
    _ttg_fct_caplinline_1_0_1_41();
  }
  // _ttg_!_1_0_1_41
  TestCommandEnd();
  if(_fct_TsDoBOF() || testIsStopRequested())
  {
    return;
  }
  TestCommandBegin("Check", "Check if it's under Night mode Mode4");
  {
    _fct_TiTableHeadExpected();
    _fct_ChckRep(0, sysvarFloat::VTS::M9_Ch3::PWMFreq, "System variable \'M9_Ch3::PWMFreq\'", ">=", 190LL, "");
    _fct_TiCellResult((CheckSignalMatch(sysvarFloat::VTS::M9_Ch3::PWMFreq, 190LL, ">=") == 1));
    _fct_ChckRep(0, sysvarFloat::VTS::M9_Ch3::PWMFreq, "System variable \'M9_Ch3::PWMFreq\'", "<=", 210LL, "");
    _fct_TiCellResult((CheckSignalMatch(sysvarFloat::VTS::M9_Ch3::PWMFreq, 210LL, "<=") == 1));
    _fct_ChckRep(0, sysvarFloat::VTS::M9_Ch3::PWMDC, "System variable \'M9_Ch3::PWMDC\'", "<=", 2.04, "");
    _fct_TiCellResult((CheckSignalMatch(sysvarFloat::VTS::M9_Ch3::PWMDC, 2.04, "<=") == 1));
    _fct_ChckRep(0, sysvarFloat::VTS::M9_Ch3::PWMDC, "System variable \'M9_Ch3::PWMDC\'", ">=", 1.96, "");
    _fct_TiCellResult((CheckSignalMatch(sysvarFloat::VTS::M9_Ch3::PWMDC, 1.96, ">=") == 1));
    _fct_ChckRep(0, sysvarFloat::VTS::M9_Ch2::Avg, "System variable \'M9_Ch2::Avg\'", "<=", 0.2, "");
    _fct_TiCellResult((CheckSignalMatch(sysvarFloat::VTS::M9_Ch2::Avg, 0.2, "<=") == 1));
    _fct_ChckRep(0, sysvarFloat::VTS::M9_Ch1::PWMFreq, "System variable \'M9_Ch1::PWMFreq\'", ">=", 190LL, "");
    _fct_TiCellResult((CheckSignalMatch(sysvarFloat::VTS::M9_Ch1::PWMFreq, 190LL, ">=") == 1));
    _fct_ChckRep(0, sysvarFloat::VTS::M9_Ch1::PWMFreq, "System variable \'M9_Ch1::PWMFreq\'", "<=", 210LL, "");
    _fct_TiCellResult((CheckSignalMatch(sysvarFloat::VTS::M9_Ch1::PWMFreq, 210LL, "<=") == 1));
    _fct_ChckRep(0, sysvarFloat::VTS::M9_Ch1::PWMDC, "System variable \'M9_Ch1::PWMDC\'", "<=", 76.5, "");
    _fct_TiCellResult((CheckSignalMatch(sysvarFloat::VTS::M9_Ch1::PWMDC, 76.5, "<=") == 1));
    _fct_ChckRep(0, sysvarFloat::VTS::M9_Ch1::PWMDC, "System variable \'M9_Ch1::PWMDC\'", ">=", 73.5, "");
    _fct_TiCellResult((CheckSignalMatch(sysvarFloat::VTS::M9_Ch1::PWMDC, 73.5, ">=") == 1));
    _fct_TiTableEvaluation("1");
  }
  // _ttg_!_1_0_1_42
  TestCommandEnd();
  if(_fct_TsDoBOF() || testIsStopRequested())
  {
    return;
  }
}
// _ttg_#_1_0_1
// 3.2 Shut Down Status
testsequence _ttg_ts_ts_1_0_2()
{
  TestCommandBegin("Report", "");
  {
    testStep(2, "", "Test the situation of switch off by time");
  }
  // _ttg_!_1_0_2_1
  TestCommandEnd();
  if(_fct_TsDoBOF() || testIsStopRequested())
  {
    return;
  }
  TestCommandBegin("Set", "");
  {
    _fct_TiTableHeadAssignment();
    _fct_Set(CAN::dbNode::PEPS::PEPS2::SystemPowerMode, "CAN signal \'SystemPowerMode\'", 0LL, "OFF");
    _fct_TiTableEnd("1");
  }
  // _ttg_!_1_0_2_2
  TestCommandEnd();
  if(_fct_TsDoBOF() || testIsStopRequested())
  {
    return;
  }
  TestCommandBegin("Set", "Close all the doors");
  {
    _fct_TiTableHeadAssignment();
    _fct_Set(CAN::dbNode::BCM::BCM1::RRDoorSts, "CAN signal \'RRDoorSts\'", 0LL, "Closed");
    _fct_Set(CAN::dbNode::BCM::BCM1::RLDoorSts, "CAN signal \'RLDoorSts\'", 0LL, "Closed");
    _fct_Set(CAN::dbNode::BCM::BCM1::PassengerDoorSts, "CAN signal \'PassengerDoorSts\'", 0LL, "Closed");
    _fct_Set(CAN::dbNode::BCM::BCM1::DriverDoorSts, "CAN signal \'DriverDoorSts\'", 0LL, "Closed");
    _fct_TiTableEnd("1");
  }
  // _ttg_!_1_0_2_3
  TestCommandEnd();
  if(_fct_TsDoBOF() || testIsStopRequested())
  {
    return;
  }
  TestCommandBegin("Wait", "Keep all doors closed for 1s");
  {
    _fct_Wait("1", (int64)(1LL * 1000000000LL), 1000000000, "");
  }
  // _ttg_!_1_0_2_4
  TestCommandEnd();
  if(_fct_TsDoBOF() || testIsStopRequested())
  {
    return;
  }
  TestCommandBegin("Set", "Open RRDoorSts");
  {
    _fct_TiTableHeadAssignment();
    _fct_Set(CAN::dbNode::BCM::BCM1::RRDoorSts, "CAN signal \'RRDoorSts\'", 1LL, "Open");
    _fct_TiTableEnd("1");
  }
  // _ttg_!_1_0_2_5
  TestCommandEnd();
  if(_fct_TsDoBOF() || testIsStopRequested())
  {
    return;
  }
  TestCommandBegin("Wait", "");
  {
    _fct_Wait("1", (int64)(20LL * 1000000000LL), 1000000000, "");
  }
  // _ttg_!_1_0_2_6
  TestCommandEnd();
  if(_fct_TsDoBOF() || testIsStopRequested())
  {
    return;
  }
  TestCommandBegin("Check", "Check if ambient light be off within 20s");
  {
    _fct_TiTableHeadExpected();
    _fct_ChckRep(0, sysvarFloat::VTS::M9_Ch1::Avg, "System variable \'M9_Ch1::Avg\'", "<=", 0.2, "");
    _fct_TiCellResult((CheckSignalMatch(sysvarFloat::VTS::M9_Ch1::Avg, 0.2, "<=") == 1));
    _fct_ChckRep(0, sysvarFloat::VTS::M9_Ch2::Avg, "System variable \'M9_Ch2::Avg\'", "<=", 0.2, "");
    _fct_TiCellResult((CheckSignalMatch(sysvarFloat::VTS::M9_Ch2::Avg, 0.2, "<=") == 1));
    _fct_ChckRep(0, sysvarFloat::VTS::M9_Ch3::Avg, "System variable \'M9_Ch3::Avg\'", "<=", 0.2, "");
    _fct_TiCellResult((CheckSignalMatch(sysvarFloat::VTS::M9_Ch3::Avg, 0.2, "<=") == 1));
    _fct_TiTableEvaluation("1");
  }
  // _ttg_!_1_0_2_7
  TestCommandEnd();
  if(_fct_TsDoBOF() || testIsStopRequested())
  {
    return;
  }
  TestCommandBegin("Set", "Close RRDoorSts");
  {
    _fct_TiTableHeadAssignment();
    _fct_Set(CAN::dbNode::BCM::BCM1::RRDoorSts, "CAN signal \'RRDoorSts\'", 0LL, "Closed");
    _fct_TiTableEnd("1");
  }
  // _ttg_!_1_0_2_8
  TestCommandEnd();
  if(_fct_TsDoBOF() || testIsStopRequested())
  {
    return;
  }
  TestCommandBegin("Report", "");
  {
    testStep(2, "", "Test the situation of switch off by lock signal");
  }
  // _ttg_!_1_0_2_9
  TestCommandEnd();
  if(_fct_TsDoBOF() || testIsStopRequested())
  {
    return;
  }
  TestCommandBegin("Set", "");
  {
    _fct_TiTableHeadAssignment();
    _fct_Set(CAN::dbNode::BCM::BCM1::PassengerDoorSts, "CAN signal \'PassengerDoorSts\'", 1LL, "Open");
    _fct_TiTableEnd("1");
  }
  // _ttg_!_1_0_2_10
  TestCommandEnd();
  if(_fct_TsDoBOF() || testIsStopRequested())
  {
    return;
  }
  TestCommandBegin("Wait", "wait for ambient light be lighten");
  {
    _fct_Wait("1", (int64)(300LL * 1000000LL), 1000000, "");
  }
  // _ttg_!_1_0_2_11
  TestCommandEnd();
  if(_fct_TsDoBOF() || testIsStopRequested())
  {
    return;
  }
  TestCommandBegin("Set", "");
  {
    _fct_TiTableHeadAssignment();
    _fct_Set(CAN::dbNode::PEPS::PEPS1::RKEDoorLockCmd, "CAN signal \'RKEDoorLockCmd\'", 1LL, "RKE door lock");
    _fct_Set(CAN::dbNode::PEPS::PEPS1::PKEDoorLockCmd, "CAN signal \'PKEDoorLockCmd\'", 0LL, "No Action");
    _fct_TiTableEnd("1");
  }
  // _ttg_!_1_0_2_12
  TestCommandEnd();
  if(_fct_TsDoBOF() || testIsStopRequested())
  {
    return;
  }
  TestCommandBegin("Wait", "");
  {
    _fct_Wait("1", (int64)(300LL * 1000000LL), 1000000, "");
  }
  // _ttg_!_1_0_2_13
  TestCommandEnd();
  if(_fct_TsDoBOF() || testIsStopRequested())
  {
    return;
  }
  TestCommandBegin("Check", "Check if ambient light be off");
  {
    _fct_TiTableHeadExpected();
    _fct_ChckRep(0, sysvarFloat::VTS::M9_Ch1::Avg, "System variable \'M9_Ch1::Avg\'", "<=", 0.2, "");
    _fct_TiCellResult((CheckSignalMatch(sysvarFloat::VTS::M9_Ch1::Avg, 0.2, "<=") == 1));
    _fct_ChckRep(0, sysvarFloat::VTS::M9_Ch2::Avg, "System variable \'M9_Ch2::Avg\'", "<=", 0.2, "");
    _fct_TiCellResult((CheckSignalMatch(sysvarFloat::VTS::M9_Ch2::Avg, 0.2, "<=") == 1));
    _fct_ChckRep(0, sysvarFloat::VTS::M9_Ch3::Avg, "System variable \'M9_Ch3::Avg\'", "<=", 0.2, "");
    _fct_TiCellResult((CheckSignalMatch(sysvarFloat::VTS::M9_Ch3::Avg, 0.2, "<=") == 1));
    _fct_TiTableEvaluation("1");
  }
  // _ttg_!_1_0_2_14
  TestCommandEnd();
  if(_fct_TsDoBOF() || testIsStopRequested())
  {
    return;
  }
  TestCommandBegin("Set", "");
  {
    _fct_TiTableHeadAssignment();
    _fct_Set(CAN::dbNode::BCM::BCM1::PassengerDoorSts, "CAN signal \'PassengerDoorSts\'", 0LL, "Closed");
    _fct_TiTableEnd("1");
  }
  // _ttg_!_1_0_2_15
  TestCommandEnd();
  if(_fct_TsDoBOF() || testIsStopRequested())
  {
    return;
  }
  TestCommandBegin("Set", "");
  {
    _fct_TiTableHeadAssignment();
    _fct_Set(CAN::dbNode::BCM::BCM1::DriverDoorSts, "CAN signal \'DriverDoorSts\'", 1LL, "Open");
    _fct_TiTableEnd("1");
  }
  // _ttg_!_1_0_2_16
  TestCommandEnd();
  if(_fct_TsDoBOF() || testIsStopRequested())
  {
    return;
  }
  TestCommandBegin("Wait", "wait for ambient light be lighten");
  {
    _fct_Wait("1", (int64)(300LL * 1000000LL), 1000000, "");
  }
  // _ttg_!_1_0_2_17
  TestCommandEnd();
  if(_fct_TsDoBOF() || testIsStopRequested())
  {
    return;
  }
  TestCommandBegin("Set", "");
  {
    _fct_TiTableHeadAssignment();
    _fct_Set(CAN::dbNode::PEPS::PEPS1::RKEDoorLockCmd, "CAN signal \'RKEDoorLockCmd\'", 0LL, "No Action");
    _fct_Set(CAN::dbNode::PEPS::PEPS1::PKEDoorLockCmd, "CAN signal \'PKEDoorLockCmd\'", 1LL, "PKE door Lock");
    _fct_TiTableEnd("1");
  }
  // _ttg_!_1_0_2_18
  TestCommandEnd();
  if(_fct_TsDoBOF() || testIsStopRequested())
  {
    return;
  }
  TestCommandBegin("Wait", "");
  {
    _fct_Wait("1", (int64)(300LL * 1000000LL), 1000000, "");
  }
  // _ttg_!_1_0_2_19
  TestCommandEnd();
  if(_fct_TsDoBOF() || testIsStopRequested())
  {
    return;
  }
  TestCommandBegin("Check", "Check if ambient light be off");
  {
    _fct_TiTableHeadExpected();
    _fct_ChckRep(0, sysvarFloat::VTS::M9_Ch1::Avg, "System variable \'M9_Ch1::Avg\'", "<=", 0.2, "");
    _fct_TiCellResult((CheckSignalMatch(sysvarFloat::VTS::M9_Ch1::Avg, 0.2, "<=") == 1));
    _fct_ChckRep(0, sysvarFloat::VTS::M9_Ch2::Avg, "System variable \'M9_Ch2::Avg\'", "<=", 0.2, "");
    _fct_TiCellResult((CheckSignalMatch(sysvarFloat::VTS::M9_Ch2::Avg, 0.2, "<=") == 1));
    _fct_ChckRep(0, sysvarFloat::VTS::M9_Ch3::Avg, "System variable \'M9_Ch3::Avg\'", "<=", 0.2, "");
    _fct_TiCellResult((CheckSignalMatch(sysvarFloat::VTS::M9_Ch3::Avg, 0.2, "<=") == 1));
    _fct_TiTableEvaluation("1");
  }
  // _ttg_!_1_0_2_20
  TestCommandEnd();
  if(_fct_TsDoBOF() || testIsStopRequested())
  {
    return;
  }
  TestCommandBegin("Set", "");
  {
    _fct_TiTableHeadAssignment();
    _fct_Set(CAN::dbNode::BCM::BCM1::DriverDoorSts, "CAN signal \'DriverDoorSts\'", 0LL, "Closed");
    _fct_TiTableEnd("1");
  }
  // _ttg_!_1_0_2_21
  TestCommandEnd();
  if(_fct_TsDoBOF() || testIsStopRequested())
  {
    return;
  }
  TestCommandBegin("Report", "");
  {
    testStep(2, "", "Test the situation of switch off by power shut down");
  }
  // _ttg_!_1_0_2_22
  TestCommandEnd();
  if(_fct_TsDoBOF() || testIsStopRequested())
  {
    return;
  }
  TestCommandBegin("Set", "");
  {
    _fct_TiTableHeadAssignment();
    _fct_Set(CAN::dbNode::BCM::BCM1::RLDoorSts, "CAN signal \'RLDoorSts\'", 1LL, "Open");
    _fct_TiTableEnd("1");
  }
  // _ttg_!_1_0_2_23
  TestCommandEnd();
  if(_fct_TsDoBOF() || testIsStopRequested())
  {
    return;
  }
  TestCommandBegin("Wait", "wait for ambient light be lighten");
  {
    _fct_Wait("1", (int64)(300LL * 1000000LL), 1000000, "");
  }
  // _ttg_!_1_0_2_24
  TestCommandEnd();
  if(_fct_TsDoBOF() || testIsStopRequested())
  {
    return;
  }
  TestCommandBegin("CAPL Inline", "Shut power supply down");
  {
    _ttg_fct_caplinline_1_0_2_25();
  }
  // _ttg_!_1_0_2_25
  TestCommandEnd();
  if(_fct_TsDoBOF() || testIsStopRequested())
  {
    return;
  }
  TestCommandBegin("Wait", "");
  {
    _fct_Wait("1", (int64)(300LL * 1000000LL), 1000000, "");
  }
  // _ttg_!_1_0_2_26
  TestCommandEnd();
  if(_fct_TsDoBOF() || testIsStopRequested())
  {
    return;
  }
  TestCommandBegin("Check", "Check if ambient light be off");
  {
    _fct_TiTableHeadExpected();
    _fct_ChckRep(0, sysvarFloat::VTS::M9_Ch1::Avg, "System variable \'M9_Ch1::Avg\'", "<=", 0.2, "");
    _fct_TiCellResult((CheckSignalMatch(sysvarFloat::VTS::M9_Ch1::Avg, 0.2, "<=") == 1));
    _fct_ChckRep(0, sysvarFloat::VTS::M9_Ch2::Avg, "System variable \'M9_Ch2::Avg\'", "<=", 0.2, "");
    _fct_TiCellResult((CheckSignalMatch(sysvarFloat::VTS::M9_Ch2::Avg, 0.2, "<=") == 1));
    _fct_ChckRep(0, sysvarFloat::VTS::M9_Ch3::Avg, "System variable \'M9_Ch3::Avg\'", "<=", 0.2, "");
    _fct_TiCellResult((CheckSignalMatch(sysvarFloat::VTS::M9_Ch3::Avg, 0.2, "<=") == 1));
    _fct_TiTableEvaluation("1");
  }
  // _ttg_!_1_0_2_27
  TestCommandEnd();
  if(_fct_TsDoBOF() || testIsStopRequested())
  {
    return;
  }
  TestCommandBegin("Set", "");
  {
    _fct_TiTableHeadAssignment();
    _fct_Set(CAN::dbNode::BCM::BCM1::RLDoorSts, "CAN signal \'RLDoorSts\'", 0LL, "Closed");
    _fct_TiTableEnd("1");
  }
  // _ttg_!_1_0_2_28
  TestCommandEnd();
  if(_fct_TsDoBOF() || testIsStopRequested())
  {
    return;
  }
  TestCommandBegin("Report", "");
  {
    testStep(2, "", "Test the situation of switch off by mode 0");
  }
  // _ttg_!_1_0_2_29
  TestCommandEnd();
  if(_fct_TsDoBOF() || testIsStopRequested())
  {
    return;
  }
  TestCommandBegin("Set", "");
  {
    _fct_TiTableHeadAssignment();
    _fct_Set(CAN::dbNode::BCM::BCM1::RRDoorSts, "CAN signal \'RRDoorSts\'", 1LL, "Open");
    _fct_TiTableEnd("1");
  }
  // _ttg_!_1_0_2_30
  TestCommandEnd();
  if(_fct_TsDoBOF() || testIsStopRequested())
  {
    return;
  }
  TestCommandBegin("Wait", "wait for ambient light be lighten");
  {
    _fct_Wait("1", (int64)(300LL * 1000000LL), 1000000, "");
  }
  // _ttg_!_1_0_2_31
  TestCommandEnd();
  if(_fct_TsDoBOF() || testIsStopRequested())
  {
    return;
  }
  TestCommandBegin("CAPL Inline", "Long press on pin4 one time");
  {
    _ttg_fct_caplinline_1_0_2_32();
  }
  // _ttg_!_1_0_2_32
  TestCommandEnd();
  if(_fct_TsDoBOF() || testIsStopRequested())
  {
    return;
  }
  TestCommandBegin("Wait", "press for 810 ms");
  {
    _fct_Wait("1", (int64)(810LL * 1000000LL), 1000000, "");
  }
  // _ttg_!_1_0_2_33
  TestCommandEnd();
  if(_fct_TsDoBOF() || testIsStopRequested())
  {
    return;
  }
  TestCommandBegin("CAPL Inline", "Release pin4");
  {
    _ttg_fct_caplinline_1_0_2_34();
  }
  // _ttg_!_1_0_2_34
  TestCommandEnd();
  if(_fct_TsDoBOF() || testIsStopRequested())
  {
    return;
  }
  TestCommandBegin("Check", "Check if ambient light be off");
  {
    _fct_TiTableHeadExpected();
    _fct_ChckRep(0, sysvarFloat::VTS::M9_Ch1::Avg, "System variable \'M9_Ch1::Avg\'", "<=", 0.2, "");
    _fct_TiCellResult((CheckSignalMatch(sysvarFloat::VTS::M9_Ch1::Avg, 0.2, "<=") == 1));
    _fct_ChckRep(0, sysvarFloat::VTS::M9_Ch2::Avg, "System variable \'M9_Ch2::Avg\'", "<=", 0.2, "");
    _fct_TiCellResult((CheckSignalMatch(sysvarFloat::VTS::M9_Ch2::Avg, 0.2, "<=") == 1));
    _fct_ChckRep(0, sysvarFloat::VTS::M9_Ch3::Avg, "System variable \'M9_Ch3::Avg\'", "<=", 0.2, "");
    _fct_TiCellResult((CheckSignalMatch(sysvarFloat::VTS::M9_Ch3::Avg, 0.2, "<=") == 1));
    _fct_TiTableEvaluation("1");
  }
  // _ttg_!_1_0_2_35
  TestCommandEnd();
  if(_fct_TsDoBOF() || testIsStopRequested())
  {
    return;
  }
  TestCommandBegin("Set", "");
  {
    _fct_TiTableHeadAssignment();
    _fct_Set(CAN::dbNode::BCM::BCM1::RRDoorSts, "CAN signal \'RRDoorSts\'", 0LL, "Closed");
    _fct_TiTableEnd("1");
  }
  // _ttg_!_1_0_2_36
  TestCommandEnd();
  if(_fct_TsDoBOF() || testIsStopRequested())
  {
    return;
  }
}
// _ttg_#_1_0_2
void _ttg_fct_caplinline_1_0_0_1()
{
  {
    sysvar::VTS::M12_VT7001.SetInterconnectionMode(0);
sysvar::VTS::M12_SupInt.SetRefVoltageMode(1);
@sysvar::VTS::M12_SupInt::RefVoltage = 12;
@sysvar::VTS::M12_Out2::Active = 1;


  }
}
// _ttg_#_1_0_0_1
void _ttg_fct_caplinline_1_0_1_1()
{
  {
    @sysvar::VTS::M9_Ch4::DigitalOutput = 1;
  }
}
// _ttg_#_1_0_1_1
void _ttg_fct_caplinline_1_0_1_3()
{
  {
    @sysvar::VTS::M9_Ch4::DigitalOutput = 0;
  }
}
// _ttg_#_1_0_1_3
void _ttg_fct_caplinline_1_0_1_6()
{
  {
    @sysvar::VTS::M9_Ch4::DigitalOutput = 1;
  }
}
// _ttg_#_1_0_1_6
void _ttg_fct_caplinline_1_0_1_10()
{
  {
    @sysvar::VTS::M9_Ch4::DigitalOutput = 0;

  }
}
// _ttg_#_1_0_1_10
void _ttg_fct_caplinline_1_0_1_12()
{
  {
    @sysvar::VTS::M9_Ch4::DigitalOutput = 1;
  }
}
// _ttg_#_1_0_1_12
void _ttg_fct_caplinline_1_0_1_14()
{
  {
    @sysvar::VTS::M9_Ch4::DigitalOutput = 0;
  }
}
// _ttg_#_1_0_1_14
void _ttg_fct_caplinline_1_0_1_16()
{
  {
    @sysvar::VTS::M9_Ch4::DigitalOutput = 1;
  }
}
// _ttg_#_1_0_1_16
void _ttg_fct_caplinline_1_0_1_18()
{
  {
    @sysvar::VTS::M9_Ch4::DigitalOutput = 0;
  }
}
// _ttg_#_1_0_1_18
void _ttg_fct_caplinline_1_0_1_20()
{
  {
    @sysvar::VTS::M9_Ch4::DigitalOutput = 1;
  }
}
// _ttg_#_1_0_1_20
void _ttg_fct_caplinline_1_0_1_22()
{
  {
    @sysvar::VTS::M9_Ch4::DigitalOutput = 0;
  }
}
// _ttg_#_1_0_1_22
void _ttg_fct_caplinline_1_0_1_24()
{
  {
    @sysvar::VTS::M9_Ch4::DigitalOutput = 1;
  }
}
// _ttg_#_1_0_1_24
void _ttg_fct_caplinline_1_0_1_27()
{
  {
    @sysvar::VTS::M9_Ch4::DigitalOutput = 0;
  }
}
// _ttg_#_1_0_1_27
void _ttg_fct_caplinline_1_0_1_29()
{
  {
    @sysvar::VTS::M9_Ch4::DigitalOutput = 1;
  }
}
// _ttg_#_1_0_1_29
void _ttg_fct_caplinline_1_0_1_31()
{
  {
    @sysvar::VTS::M9_Ch4::DigitalOutput = 0;
  }
}
// _ttg_#_1_0_1_31
void _ttg_fct_caplinline_1_0_1_33()
{
  {
    @sysvar::VTS::M9_Ch4::DigitalOutput = 1;
  }
}
// _ttg_#_1_0_1_33
void _ttg_fct_caplinline_1_0_1_35()
{
  {
    @sysvar::VTS::M9_Ch4::DigitalOutput = 0;
  }
}
// _ttg_#_1_0_1_35
void _ttg_fct_caplinline_1_0_1_37()
{
  {
    @sysvar::VTS::M9_Ch4::DigitalOutput = 1;
  }
}
// _ttg_#_1_0_1_37
void _ttg_fct_caplinline_1_0_1_39()
{
  {
    @sysvar::VTS::M9_Ch4::DigitalOutput = 0;
  }
}
// _ttg_#_1_0_1_39
void _ttg_fct_caplinline_1_0_1_41()
{
  {
    @sysvar::VTS::M9_Ch4::DigitalOutput = 1;
  }
}
// _ttg_#_1_0_1_41
void _ttg_fct_caplinline_1_0_2_25()
{
  {
    @sysvar::VTS::M12_Sup1::RefVoltage = 0;
  }
}
// _ttg_#_1_0_2_25
void _ttg_fct_caplinline_1_0_2_32()
{
  {
    @sysvar::VTS::M9_Ch4::DigitalOutput = 0;
  }
}
// _ttg_#_1_0_2_32
void _ttg_fct_caplinline_1_0_2_34()
{
  {
    @sysvar::VTS::M9_Ch4::DigitalOutput = 1;
  }
}
// _ttg_#_1_0_2_34
