/*@!Encoding:936*/
variables
{  
#if 1

byte xofy_NTC_Table[11][10]={																					
/* Normal test case: Cyclic send,value=0 means signal valid, value=1 means signal invalid */																					
      	/*	1		2		3		4		5		6		7		8		9		10	*/
/* x=0 */	{	0	,	0	,	0	,	0	,	0	,	0	,	0	,	0	,	0	,	0	},
/* x=1 */	{	1	,	0	,	0	,	0	,	0	,	0	,	0	,	0	,	0	,	0	},
/* x=2 */	{	1	,	0	,	0	,	0	,	0	,	1	,	0	,	0	,	0	,	0	},
/* x=3 */	{	1	,	0	,	0	,	0	,	1	,	0	,	0	,	0	,	1	,	0	},
/* x=4 */	{	1	,	0	,	0	,	1	,	0	,	0	,	1	,	0	,	0	,	1	},
/* x=5 */	{	1	,	0	,	1	,	0	,	1	,	0	,	1	,	0	,	1	,	0	},
/* x=6 */	{	1	,	1	,	1	,	1	,	1	,	1	,	0	,	0	,	0	,	0	},
/* x=7 */	{	1	,	1	,	0	,	0	,	0	,	1	,	1	,	1	,	1	,	1	},
/* x=8 */	{	1	,	1	,	1	,	0	,	0	,	1	,	1	,	1	,	1	,	1	},
/* x=9 */	{	1	,	0	,	1	,	1	,	1	,	1	,	1	,	1	,	1	,	1	},
/* x=10*/	{	1	,	1	,	1	,	1	,	1	,	1	,	1	,	1	,	1	,	1	} };

#endif
}
