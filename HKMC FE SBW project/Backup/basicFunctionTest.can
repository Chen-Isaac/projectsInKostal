includes
{
  #include "D:\\Isaac\\Library\\KostalSoftwareTestLibrary.cin"
}

variables
{

}

export testcase fromInitModeToSleepMode (char drvDrSwSigVal[],char msWaitTime[],int stepRouteNum10) {
  char paraPick[2][2][100] = {{"drvDrSwSigVal",""},{"msWaitTime",""}};
  strncpy(paraPick[0][1],drvDrSwSigVal,elCount(paraPick[0][1]));
  strncpy(paraPick[1][1],msWaitTime,elCount(paraPick[1][1]));
  routeNum[10] = stepRouteNum10;
  stateMachine("fromInitModeToSleepMode",routeNum,paraPick);
}

export testcase fromIgnOnModeToIgnOffModeToSilenceModeToSleepMode (char drvDrSwSigVal[],char accLev[],int stepRouteNum8) {
  char paraPick[2][2][100] = {{"drvDrSwSigVal",""},{"accLev",""}};
  strncpy(paraPick[0][1],drvDrSwSigVal,elCount(paraPick[0][1]));
  strncpy(paraPick[1][1],accLev,elCount(paraPick[1][1]));
  routeNum[8] = stepRouteNum8;
  stateMachine("fromIgnOnModeToIgnOffModeToSilenceModeToSleepMode",routeNum,paraPick);
}

export testcase fromIgnOnModeToNWashMode (void) {
  stateMachine("fromIgnOnModeToNWashMode",routeNum,noParaPick);
}

export testcase fromIgnOnModeToNParkMode (void) {
  stateMachine("fromIgnOnModeToNParkMode",routeNum,noParaPick);
}

export testcase powerOn (void) {
  stateMachine("powerOn",routeNum,noParaPick);
}

export testcase powerOff (void) {
  stateMachine("powerOff",routeNum,noParaPick);
}

export testcase initProduct (void) {
  stateMachine("initProduct",routeNum,noParaPick);
}

export testcase readSwVer (void) {
  stateMachine("readSwVer",routeNum,noParaPick);
}

export testcase buttonPressFunctionCheck (char ignValueLevel[],char button[]) {
  char paraPick[2][2][100] = {{"ignValueLevel",""},{"button",""}};
  strncpy(paraPick[0][1],ignValueLevel,elCount(paraPick[0][1]));
  strncpy(paraPick[1][1],button,elCount(paraPick[1][1]));
  stateMachine("buttonPressFunctionCheck",routeNum,paraPick);
}

export testcase testIndicatorControlFunctionStateChart (int stepRouteNum3,int stepRouteNum8) {

  routeNum[3] = stepRouteNum3;
  routeNum[8] = stepRouteNum8;
  stateMachine("testIndicatorControlFunctionStateChart",routeNum,noParaPick);
}

export testcase testRheostatLevelRow1_2 (char detentVal[],int stepRouteNum3,int stepRouteNum4) {
  char paraPick[1][2][100] = {{"detentVal",""}};
  strncpy(paraPick[0][1],detentVal,elCount(paraPick[0][1]));
  routeNum[3] = stepRouteNum3;
  routeNum[4] = stepRouteNum4;
  stateMachine("testRheostatLevelRow1_2",routeNum,paraPick);
}

export testcase testRheostatLevelRow3_4_5_6_12_13_14_15 (char ignValueLevel[],char detentVal[]) {
  char paraPick[2][2][100] = {{"ignValueLevel",""},{"detentVal",""}};
  strncpy(paraPick[0][1],ignValueLevel,elCount(paraPick[0][1]));
  strncpy(paraPick[1][1],detentVal,elCount(paraPick[1][1]));
  stateMachine("testRheostatLevelRow3_4_5_6_12_13_14_15",routeNum,paraPick);
}

export testcase x0_20 (void) {
  stateMachine("x0_20",routeNum,noParaPick);
}

export testcase testRheostatLevelRow7 (int stepRouteNum3) {

  routeNum[3] = stepRouteNum3;
  stateMachine("testRheostatLevelRow7",routeNum,noParaPick);
}

export testcase x0_200 (void) {
  stateMachine("x0_200",routeNum,noParaPick);
}

export testcase testRheostatLevelRow8_9_17_18 (char ignValueLevel[]) {
  char paraPick[1][2][100] = {{"ignValueLevel",""}};
  strncpy(paraPick[0][1],ignValueLevel,elCount(paraPick[0][1]));
  stateMachine("testRheostatLevelRow8_9_17_18",routeNum,paraPick);
}

export testcase x00_200 (void) {
  stateMachine("x00_200",routeNum,noParaPick);
}

export testcase testRheostatLevelRow10_11 (char detentVal[],int stepRouteNum3,int stepRouteNum4) {
  char paraPick[1][2][100] = {{"detentVal",""}};
  strncpy(paraPick[0][1],detentVal,elCount(paraPick[0][1]));
  routeNum[3] = stepRouteNum3;
  routeNum[4] = stepRouteNum4;
  stateMachine("testRheostatLevelRow10_11",routeNum,paraPick);
}

export testcase testRheostatLevelRow16 (int stepRouteNum3) {

  routeNum[3] = stepRouteNum3;
  stateMachine("testRheostatLevelRow16",routeNum,noParaPick);
}

