/* !Encoding: 65001  */
// Generated with version 2.0.49.1
variables
{
  // global general purpose buffers
  char _ttg_B[2000];
  char _ttg_Z[2000];
  char _ttg_BR[2000];
  long _ttg_verdict;
  long _ttg_Re;
  long _ttg_TestActionFailCnt;
  long _ttg_TestStepInitOk;
  int64 _ttg_I64;
  double _ttg_Double;
  dword _ttg_gBusContextNew = 0;
  dword _ttg_gBusContextOld = 0;
  int64 _ttg_gBusContextOk = 0;
  // enums
  enum EVerdBOF
  {
    EVerdBOF_None = 0,
    EVerdBOF_TC = 1,
    EVerdBOF_TS = 2
  }
  ;
  // FlexRay configuration
  FRConfiguration _ttg_gFRConfiguration;
  long _ttg_gFRNumberOfStaticSlots[32];
  long _ttg_gFRPayloadLengthStatic[32];
  // globals for user defined variables
  int64 _ttg_var_light_level_3_1_2_3_3_0;
  double _ttg_var_m9_ch3_pwmdc_high_3_1_2_3_3_1;
  double _ttg_var_m9_ch3_pwmdc_low_3_1_2_3_3_2;
  double _ttg_var_m9_ch2_pwmdc_high_3_1_2_3_3_3;
  double _ttg_var_m9_ch2_pwmdc_low_3_1_2_3_3_4;
  double _ttg_var_m9_ch1_pwmdc_high_3_1_2_3_3_5;
  double _ttg_var_m9_ch1_pwmdc_low_3_1_2_3_3_6;
  double _ttg_var_m9_ch3_pwmdc_high_3_1_2_4_3_0;
  double _ttg_var_m9_ch3_pwmdc_low_3_1_2_4_3_1;
  double _ttg_var_m9_ch2_pwmdc_high_3_1_2_4_3_2;
  double _ttg_var_m9_ch2_pwmdc_low_3_1_2_4_3_3;
  double _ttg_var_m9_ch1_pwmdc_high_3_1_2_4_3_4;
  double _ttg_var_m9_ch1_pwmdc_low_3_1_2_4_3_5;
  int64 _ttg_var_driving_mode_3_1_2_8_3_0;
  int64 _ttg_var_pos_lmp_sts_3_1_2_8_3_1;
  int64 _ttg_var_i_3_0_1_4_4;
  int64 _ttg_var_i_3_0_1_4_6;
  int64 _ttg_var_i_3_0_1_12_4;
  int64 _ttg_var_i_3_0_1_14_5;
  int64 _ttg_var_i_3_0_2_5_6;
  int64 _ttg_var_i_3_0_2_5_8;
  int64 _ttg_var_i_3_0_2_9_4;
  int64 _ttg_var_i_3_0_2_9_6;
  // global declarations
  message CAN::KostiaRspALCM _ttg_cb_frmPduVar4_3_0_4_2_2_4_0;
  long _ttg_cb_frameCntVar4_3_0_4_2_2_4_0;
  message CAN::KostiaRspALCM _ttg_cb_frmPduVar5_3_0_4_2_3_3_0;
  long _ttg_cb_frameCntVar5_3_0_4_2_3_3_0;
}
void _fct_Wait(char step[], int64 timeInNs, int64 unitInNs, char valueSymbol[])
{
  char b[400];
  double timeValueByUnit;

  timeValueByUnit = (double)timeInNs / (double)unitInNs;

  if(unitInNs == 1LL)
  {
    if(valueSymbol[0] == 0)
      snprintf(b, elcount(b), "%I64d ns", timeInNs);
    else
      snprintf(b, elcount(b), "%I64d (%s) ns", timeInNs, valueSymbol);
  }
  else if(unitInNs == 1000LL)
  {
    if(valueSymbol[0] == 0)
      snprintf(b, elcount(b), "%.3f us", timeValueByUnit);
    else
      snprintf(b, elcount(b), "%.3f (%s) us", timeValueByUnit, valueSymbol);
  }
  else if(unitInNs == 1000000LL)
  {
    if(valueSymbol[0] == 0)
      snprintf(b, elcount(b), "%.3f ms", timeValueByUnit);
    else
      snprintf(b, elcount(b), "%.3f (%s) ms", timeValueByUnit, valueSymbol);
  }
  else if(unitInNs == 1000000000LL)
  {
    if(valueSymbol[0] == 0)
      snprintf(b, elcount(b), "%.3f s", timeValueByUnit);
    else
      snprintf(b, elcount(b), "%.3f (%s) s", timeValueByUnit, valueSymbol);
  }
  else
    testStepErrorInTestSystem(0, step, "Internal error: invalid time unit: %I64d", unitInNs);

  if(timeInNs > 0)
  {
    if(0 == testWaitForTimeoutNS(timeInNs))
      testStep(2, step, "Waited for %s", b);
    else
      testStepErrorInTestSystem(0, step, "Waited for %s", b);
  }
  else if(timeInNs  == 0)
  {
    // do not wait
    testStep(2, step, "Waited for %s", b);
  }
  else
  {
    testStepErrorInTestSystem(0, step, "Unable to wait for %s. Please check input parameter.", b);
  }
}

void _fct_CommandVerdict(long verdict)
{
  if(_ttg_verdict == 1) // failed
    return; // setting verdict from 'failed' to 'pass' is not possible
  _ttg_verdict = verdict;
}

int _fct_DoStop(enum EVerdBOF verdictSource, int doBreakOnFail)
{
  long verdict;

  switch (verdictSource)
  {
    case EVerdBOF_TC: verdict = TestGetVerdictLastTestCase(); break;
    case EVerdBOF_TS: verdict = TestGetVerdictLastTestSequence(); break;
    default: verdict = 0; break; // Note: error in test system will only be checked inside TS/TC body
  }

  if (doBreakOnFail && verdict == 1 /*fail*/ && !testIsBreakOnFailDeactivated())
    return 1; // stop execution because current verdict is 'Fail'

  if (testIsStopRequested() /*user pressed stop button*/ || verdict == 4 /*error in testsystem*/)
    return 1; // stop execution

  return 0;
}

int _fct_LoopIsBlocking()
{ 
  // works for nested loops, too
  dword timeLoopNow, timeLoopOld, cntTimeEqual;
  timeLoopNow = timeNow();
  if(timeLoopNow > timeLoopOld)
  {
    cntTimeEqual = 0;
  }
  else
  {
    ++cntTimeEqual;
    if(cntTimeEqual >= 1000)
    {
      // busy loop detected
      testStepErrorInTestSystem(0, "", "Blocking loop detected. Aborted after 1000 cycles have been performed at the same time.");
      return 1;
    }
  }
  timeLoopOld = timeLoopNow;
  return 0;
}

void _fct_CallTsTc(char function[], dword fType, dword isExported, char title[])
{
  CreateTTEIFFunction(function, fType, isExported);
  CallInterfaceFunction(title);
}

void _fct_TestControlStructEnd(long count)
{
  // call TestControlStructEnd count times to close report scope in nested ifs
  long i;
  for(i = 0; i < count; ++i)
    TestControlStructEnd(_ttg_verdict);
}

void _fct_ConditionTableHead(char inCondition[], int bCondition)
{
  char localBuf[2048];

  snprintf(localBuf, elCount(localBuf), "%s: ", inCondition);
  if(bCondition)
    strncat(localBuf, "true", elCount(localBuf));
  else
    strncat(localBuf, "false", elCount(localBuf));

  _fct_TiTableHeadExpectedEx(localBuf);
}

int _fct_DoElseIf(int bDone)
{
  if(bDone)
  {
    testStep(0, "", "Previous condition matched, skipping block.");
    return 0;
  }
  return 1;
}

int _fct_DoElse(int bDone)
{
  if(bDone)
  {
    testStep(0, "", "Previous condition matched, skipping block.");
    return 0;
  }
  else
  {
    testStep(0, "", "No condition matched, executing 'else' block.");
    return 1;
  }
}

// compare byte sequences - returns:
// == 0 if byte sequences match 
// != 0 otherwise
long _fct_CompareBytes(byte leftSide[], long leftSideCnt, byte rightSide[], long rightSideCnt)
{
  DWORD i;

  if (leftSideCnt > elCount(leftSide) || rightSideCnt > elCount(rightSide))
  {
    testStepErrorInTestSystem("_fct_CompareBytes: The buffer itself is not large enough, this should not happen!");
    return -1;
  }

  if (leftSideCnt != rightSideCnt)
    return leftSideCnt - rightSideCnt;

  for (i = 0; i < leftSideCnt; i++)
  {
    if (leftSide[i] != rightSide[i])
      return leftSide[i] - rightSide[i];
  }

  return 0; // sequences match
}

long _fct_AssignBytes(byte destination[], long destCnt, byte source[], long sourceCnt)
{
  long count;
  count = _min(destCnt, sourceCnt);
  memcpy(destination, source, count);
  return count;
}

// Note EVAL00136179: convert 32 bit system variables to 64 bit values (value coherence for signed64/unsigned64 CAPL function overloads)
int64 _SVC(sysvarInt *svi)
{
  dword _32BitUs;
  
  // Note: if we have a unsigned 32 bit sysvar, we need to convert it to a unsigned 32 bit integer first,
  // before converting to 64 bit signed integer. Otherwise CAPL will interpret the SV value as signed and extend it to 64 bit,
  // which will result in wrong values (above 2^31).
  if (!IsSVSigned(svi))
  {
    _32BitUs = @svi;
    return (int64)_32BitUs;
  }
  
  return (int64)@svi;
}

void _fct_TiTableHeadInit()
{
  _ttg_TestActionFailCnt = 0;
}

void _fct_TiTableHeadAssignment()
{
  _fct_TiTableHeadInit();
  _ttg_Re = testInfoTable("Stimulation of values");
  testInfoHeadingBegin(_ttg_Re, 0);
  _fct_TiCell("Symbol");
  _fct_TiCell("Op.");
  _fct_TiCell("Assigned");
  testInfoHeadingEnd(_ttg_Re);
}


void _fct_TiTableFunctionCallReturnValue(char callSig[])
{
  char localBuf[256];
  _fct_TiTableHeadInit();
  snprintf(localBuf, elCount(localBuf), "Function call: %s", callSig);
  _ttg_Re = testInfoTable(localBuf);
  testInfoHeadingBegin(_ttg_Re, 0);
  _fct_TiCell("Symbol");
  _fct_TiCell("Op.");
  _fct_TiCell("Return Value");
  testInfoHeadingEnd(_ttg_Re);
}

void _fct_TiTableWaveformStimulus()
{
  _fct_TiTableHeadInit();
  _ttg_Re = testInfoTable("Stimulation of values with waveform curves");
   testInfoHeadingBegin(_ttg_Re, 0);
   _fct_TiCell("Symbol");
   _fct_TiCell("Stimulated with curve");
   testInfoHeadingEnd(_ttg_Re);
}

void _fct_TiTableHeadSetVariables()
{
  _fct_TiTableHeadInit();
  _ttg_Re = testInfoTable("Setting variable values");
  testInfoHeadingBegin(_ttg_Re, 0);
  _fct_TiCell("Variable");
  _fct_TiCell("Op.");
  _fct_TiCell("Assigned");
  testInfoHeadingEnd(_ttg_Re);
}
void _fct_TiTableHeadReport(char userText[])
{
  _fct_TiTableHeadInit();
  _ttg_Re = testInfoTable(userText);
  testInfoHeadingBegin(_ttg_Re, 0);
  _fct_TiCell("Symbol");
  _fct_TiCell("Value");
  testInfoHeadingEnd(_ttg_Re);
}
void _fct_TiTableHeadSend(char msgDesc[])
{
  char b[256];
  _fct_TiTableHeadInit();
  snprintf(b, elcount(b), "Send %s", msgDesc);
  _ttg_Re = testInfoTable(b);
  testInfoHeadingBegin(_ttg_Re, 0);
  _fct_TiCell("Signal/Byte");
  _fct_TiCell("Op.");
  _fct_TiCell("Assigned");
  testInfoHeadingEnd(_ttg_Re);
}
void _fct_TiTableHeadAwaitSigAv(char text[])
{
  _fct_TiTableHeadInit();
  _ttg_Re = testInfoTable(text);
  testInfoHeadingBegin(_ttg_Re, 0);
  _fct_TiCell("Signal/Node");
  _fct_TiCell("State");
  //_fct_TiCell("Last on Bus");
  _fct_TiCell("Result");
  testInfoHeadingEnd(_ttg_Re);
}
void _fct_TiSignalsAvRow(long indent, long eventId, char reportIdent[]/*, Signal *s*/)
{
  _fct_TiRow(indent, reportIdent);

  if (eventId >= 0)
  {
    if (eventId == 0) // already on bus
    {
      _fct_TiCell("already online");
      //_fct_TiCell(getSignalTime(s));
      _fct_TiCellResult(1);
    }
    else
    {
      int64 time;
      long occurred;
      occurred = testGetJoinedEventOccured(eventId, time);
      if (occurred)
        _fct_TiCell("online");
      else
        _fct_TiCell("not online yet");
      //_fct_TiCell(getSignalTime(s));
      _fct_TiCellResult(occurred);
    }
  }
  else
  { // note: this is a test environment error ...
    _fct_TiCell("-");
    //_fct_TiCell("-");
    _fct_TiCellResult(0);
  }
}

void _fct_TiTableHeadExpected()
{
  _fct_TiTableHeadExpectedEx("Check of expected values");
}

void _fct_TiTableHeadExpectedEx(char title[])
{
  _fct_TiTableHeadInit();
  _ttg_Re = testInfoTable(title);
  testInfoHeadingBegin(_ttg_Re, 0);
  _fct_TiCell("Symbol");
  _fct_TiCell("Op.");
  _fct_TiCell("Reference Value");
  _fct_TiCell("Actual");
  _fct_TiCell("Result");
  testInfoHeadingEnd(_ttg_Re);
}

void _fct_TiTableHeadResponse(char msgDesc[], int numReceived)
{
  char b[200];
  _fct_TiTableHeadInit();
  if (numReceived == -1)
    snprintf(b, elcount(b), "Response of %s", msgDesc); // maybe received after x MS?
  else
    snprintf(b, elcount(b), "Response of %s (received %d times)", msgDesc, numReceived);
  _ttg_Re = testInfoTable(b);
  testInfoHeadingBegin(_ttg_Re, 0);
  _fct_TiCell("Signal/Byte");
  _fct_TiCell("Op.");
  _fct_TiCell("Reference Value");
  if (numReceived == -1)
    _fct_TiCell("Actual");
  else
    _fct_TiCell("Last Received");
  _fct_TiCell("Result");
  testInfoHeadingEnd(_ttg_Re);
}

void _fct_TiCell(char text[])
{
  testInfoCell(_ttg_Re, text);
}

void _fct_TiCellResult(long condition)
{
  if(condition)
    _fct_TiCell("pass");
  else
  {
    _fct_TiCell("fail");
    ++_ttg_TestActionFailCnt;
  }
}

void _fct_TiCellResultTrueFalse(long condition)
{
  if(condition)
    _fct_TiCell("true");
  else
  {
    _fct_TiCell("false");
    ++_ttg_TestActionFailCnt;
  }
}

void _fct_TiCell(int64 value)
{
  _fct_TiIntCell(value);
}
void _fct_TiIntCell(int64 value)
{
  snprintf(_ttg_BR, elcount(_ttg_BR), "%I64d", value);
  _fct_TiCell(_ttg_BR);
}
void _fct_TiUIntCell(qword value)
{
  snprintf(_ttg_BR, elcount(_ttg_BR), "%I64u", value);
  _fct_TiCell(_ttg_BR);
}

void _fct_TiCell(double value)
{
  _fct_TiFloatCell(value);
}
void _fct_TiFloatCell(double value)
{
  snprintf(_ttg_BR, elcount(_ttg_BR), "%.15g", value);
  _fct_TiCell(_ttg_BR);
}

void _fct_TiRow(long indent, char firstCellContent[])
{
  testInfoRow(_ttg_Re, indent, firstCellContent);
}

void _fct_TiWriteByteX(int64 idx, char valueSymbol[], char nameOut[])
{
  if(valueSymbol[0] == 0)
    snprintf(nameOut, elcount(nameOut), "Byte[%I64d]", idx);
  else
    snprintf(nameOut, elcount(nameOut), "Byte[%I64d (%s)]", idx, valueSymbol);
}

void _fct_TiTableEvaluation(char stepIdentifier[])
{
  if(_ttg_TestActionFailCnt > 0)
  {
    testStepFail(0, stepIdentifier, _ttg_Re);
  }
  else
  {
    testStepPass(2, stepIdentifier, _ttg_Re);
  }
}

void _fct_TiTableEnd(char step[], long result, long restriction)
{
  testStep(2, step, _ttg_Re, result, restriction);
}

// write a byte stream as hex tuples into a given buffer ([size] 00 01 A0 ... )
void _fct_TiWriteHexDataToStrBuf(char strBuf[], byte data[], long dataCnt)
{
  char tmp[16];
  long limit, i;

  const long dataMaxDisplayCnt = 32;

  snprintf(strBuf, elcount(strBuf), "[%d] ", dataCnt);
  limit = _min(dataMaxDisplayCnt, dataCnt);

  // if we have more than 'maxCount' bytes ... print first 'maxCount-1' bytes, followed by "..." and the last byte of the sequence
  if (dataCnt > dataMaxDisplayCnt)
    limit--;

  for (i = 0; i < limit; i++)
  {
    if (i == 0)
      snprintf(tmp, elCount(tmp), "%02X", (int)data[i]);
    else
      snprintf(tmp, elCount(tmp), " %02X", (int)data[i]);

    strncat(strBuf, tmp, elCount(strBuf));
  }

  if (dataCnt > dataMaxDisplayCnt)
  {
    snprintf(tmp, elCount(tmp), "... %02X", (int)data[dataCnt - 1]);
    strncat(strBuf, tmp, elCount(strBuf));
  }
}

void _fct_TiCell(byte rawBytes[], long count)
{
  const long dataMaxDisplayCnt = 32; // see _fct_TiWriteHexDataToStrBuf()
  char byteDump[dataMaxDisplayCnt * 3 + 15]; // Only print up to 'maxCount' bytes in the first step -> also in "min..." below!

  _fct_TiWriteHexDataToStrBuf(byteDump, rawBytes, count);

  _fct_TiCell(byteDump);
}
void _fct_TiCellUpdateOccurred(dword updated)
{
  if (updated == 1)
    _fct_TiCell("");
  else
    _fct_TiCell("(no update)");
}
void _fct_TiTableHeadExpectedUpdateOccurred(char title[])
{
  _fct_TiTableHeadInit();
  _ttg_Re = testInfoTable(title);
  testInfoHeadingBegin(_ttg_Re, 0);
  _fct_TiCell("Symbol");
  _fct_TiCell("Op.");
  _fct_TiCell("Reference Value");
  _fct_TiCell("Actual");
  _fct_TiCell(""); // empty cell to report updates
  _fct_TiCell("Result");
  testInfoHeadingEnd(_ttg_Re);
}
void _fct_SetBusContext(char bus[], int saveOldBusContext)
{
  _ttg_gBusContextOk = 1;
  _ttg_gBusContextNew = GetBusNameContext(bus);
  if(_ttg_gBusContextNew == 0)
  {
    _ttg_gBusContextOk = 0;
    testStepErrorInTestSystem("", "Error: Cannot determine context for bus: %s", bus);
    _ttg_gBusContextOld = 0;
    return;
  }
  if(saveOldBusContext == 1)
  {
    _ttg_gBusContextOld = SetBusContext(_ttg_gBusContextNew);
  }
  else
  {
    SetBusContext(_ttg_gBusContextNew);
  }
}

void _fct_ResetBusContext()
{
  if(_ttg_gBusContextOld > 0)
  {
    SetBusContext(_ttg_gBusContextNew);
  }
}

int _fct_BusContextOk()
{
  return _ttg_gBusContextOk;
}


// _fct_EnsureSymbolName(Signal)
_fct_EnsureSymbolName(signal * sym, char nameIn[], char nameOut[])
{
  if(strlen(nameIn) == 0)
  {
    long i, len, pos;
    strncpy(nameOut, sym.name, elcount(nameOut));
    len = strlen(nameOut);
    // find last separator ':'
    pos = 0;
    for(i = len; i > 0; --i)
    {
      if(nameOut[i] == ':')
      {
        pos = i;
        break;
      }
    }
    if(pos > 0 && pos != len)
    {
      char sigNameOnly[200];
      substr_cpy_off(sigNameOnly, 0, sym.name, pos+1, -1, elcount(sigNameOnly));
      snprintf(nameOut, elcount(nameOut), "Signal '%s'", sigNameOnly);
    }
  }
  else { strncpy(nameOut, nameIn, elCount(nameOut)); }
}

// _fct_TiNameOpValue(Int64)
_fct_TiNameOpValue(long indent, char nameIn[], char op[], int64 valueIn, char dstNameIn[])
{
  
  _fct_TiRow(indent, nameIn);
  _fct_TiCell(op);
  if (strlen(dstNameIn) == 0)
  {
    snprintf(_ttg_BR, elCount(_ttg_BR), "%I64d", valueIn);
  }
  else
  {
    snprintf(_ttg_BR, elCount(_ttg_BR), "%I64d (%s)", valueIn, dstNameIn);
  }
  _fct_TiCell(_ttg_BR);
}
_fct_TiNameOpValue(long indent, char nameIn[], char op[], qword valueIn, char dstNameIn[])
{
  
  _fct_TiRow(indent, nameIn);
  _fct_TiCell(op);
  if (strlen(dstNameIn) == 0)
  {
    snprintf(_ttg_BR, elCount(_ttg_BR), "%I64u", valueIn);
  }
  else
  {
    snprintf(_ttg_BR, elCount(_ttg_BR), "%I64u (%s)", valueIn, dstNameIn);
  }
  _fct_TiCell(_ttg_BR);
}

// _fct_Set(Signal,Int64)
_fct_Set(signal * dst, char dstName[], int64 src, char srcName[])
{
  char symDstBuf[256];
  _fct_EnsureSymbolName(dst, dstName, symDstBuf);
  $dst.phys = src;
  if(0 == getSignalTime(dst))
  {
    snprintf(_ttg_BR, elcount(_ttg_BR), "%s not online yet", symDstBuf);
    strncpy(symDstBuf, _ttg_BR, elcount(symDstBuf));
  }
  _fct_TiNameOpValue(0, symDstBuf, "=", src, srcName);
}
_fct_Set(signal * dst, char dstName[], qword src, char srcName[])
{
  char symDstBuf[256];
  _fct_EnsureSymbolName(dst, dstName, symDstBuf);
  $dst.phys = src;
  if(0 == getSignalTime(dst))
  {
    snprintf(_ttg_BR, elcount(_ttg_BR), "%s not online yet", symDstBuf);
    strncpy(symDstBuf, _ttg_BR, elcount(symDstBuf));
  }
  _fct_TiNameOpValue(0, symDstBuf, "=", src, srcName);
}

// _fct_EnsureSymbolName(SysVarFloat)
_fct_EnsureSymbolName(sysvarFloat * sym, char nameIn[], char nameOut[])
{
  if(strlen(nameIn) == 0)
  {
    snprintf(nameOut, elcount(nameOut), "System variable '%s'", sym.Name );
  }
  else { strncpy(nameOut, nameIn, elCount(nameOut)); }
}

// _fct_TiValueCell(SysVarFloat)
_fct_TiValueCell(sysvarFloat * valueIn)
{
  _fct_TiCell(@valueIn);
}

// _fct_ChckRep(SysVarFloat,Int64,Unspecified)
_fct_ChckRep(long indent, sysvarFloat * lSym, char lName[], char operator[], int64 rSym, char rName[])
{
  char symLNameBuf[256];
  _fct_EnsureSymbolName(lSym, lName, symLNameBuf);
  _fct_TiNameOpValue(indent, symLNameBuf, operator, rSym, rName);
  _fct_TiValueCell(lSym);
}
_fct_ChckRep(long indent, sysvarFloat * lSym, char lName[], char operator[], qword rSym, char rName[])
{
  char symLNameBuf[256];
  _fct_EnsureSymbolName(lSym, lName, symLNameBuf);
  _fct_TiNameOpValue(indent, symLNameBuf, operator, rSym, rName);
  _fct_TiValueCell(lSym);
}

// _fct_TiNameOpValue(Float)
_fct_TiNameOpValue(long indent, char nameIn[], char op[], float valueIn, char dstNameIn[])
{
  
  _fct_TiRow(indent, nameIn);
  _fct_TiCell(op);
  if (strlen(dstNameIn) == 0)
  {
    snprintf(_ttg_BR, elCount(_ttg_BR), "%.15g", valueIn);
  }
  else
  {
    snprintf(_ttg_BR, elCount(_ttg_BR), "%.15g (%s)", valueIn, dstNameIn);
  }
  _fct_TiCell(_ttg_BR);
}

// _fct_ChckRep(SysVarFloat,Float,Unspecified)
_fct_ChckRep(long indent, sysvarFloat * lSym, char lName[], char operator[], float rSym, char rName[])
{
  char symLNameBuf[256];
  _fct_EnsureSymbolName(lSym, lName, symLNameBuf);
  _fct_TiNameOpValue(indent, symLNameBuf, operator, rSym, rName);
  _fct_TiValueCell(lSym);
}

// _fct_TiValueCell(Int64)
_fct_TiValueCell(int64 valueIn)
{
  _fct_TiCell(valueIn);
}
_fct_TiValueCell(qword valueIn)
{
  _fct_TiUIntCell(valueIn);
}

// _fct_ChckRep(Int64,Int64,Unspecified)
_fct_ChckRep(long indent, int64 lSym, char lName[], char operator[], int64 rSym, char rName[])
{
  _fct_TiNameOpValue(indent, lName, operator, rSym, rName);
  _fct_TiValueCell(lSym);
}
_fct_ChckRep(long indent, int64 lSym, char lName[], char operator[], qword rSym, char rName[])
{
  _fct_TiNameOpValue(indent, lName, operator, rSym, rName);
  _fct_TiValueCell(lSym);
}

// _fct_TiNameOpValue(String)
_fct_TiNameOpValue(long indent, char nameIn[], char op[], char valueIn[], char dstNameIn[])
{
  
  _fct_TiRow(indent, nameIn);
  _fct_TiCell(op);
  if (strlen(dstNameIn) == 0)
  {
    snprintf(_ttg_BR, elCount(_ttg_BR), "%s", valueIn);
  }
  else
  {
    snprintf(_ttg_BR, elCount(_ttg_BR), "%s (%s)", valueIn, dstNameIn);
  }
  _fct_TiCell(_ttg_BR);
}

// _fct_ChckRep(SysVarFloat,String,Unspecified)
_fct_ChckRep(long indent, sysvarFloat * lSym, char lName[], char operator[], char rSym[], char rName[])
{
  char symLNameBuf[256];
  _fct_EnsureSymbolName(lSym, lName, symLNameBuf);
  _fct_TiNameOpValue(indent, symLNameBuf, operator, rSym, rName);
  _fct_TiValueCell(lSym);
}

// _fct_ChckRep(Int64,String,Unspecified)
_fct_ChckRep(long indent, int64 lSym, char lName[], char operator[], char rSym[], char rName[])
{
  _fct_TiNameOpValue(indent, lName, operator, rSym, rName);
  _fct_TiValueCell(lSym);
}

// _fct_TiValueCell(String)
_fct_TiValueCell(char valueIn[])
{
  _fct_TiCell(valueIn);
}

// _fct_ChckRep(String,String,Unspecified)
_fct_ChckRep(long indent, char lSym[], char lName[], char operator[], char rSym[], char rName[])
{
  _fct_TiNameOpValue(indent, lName, operator, rSym, rName);
  _fct_TiValueCell(lSym);
}

// _fct_TiValueCell(Signal)
_fct_TiValueCell(signal * valueIn)
{
  if (0 == getSignalTime(valueIn))
    _fct_TiCell("not online yet");
  else
  _fct_TiCell($valueIn.phys);
}

// _fct_ChckRep(Signal,Int64,Unspecified)
_fct_ChckRep(long indent, signal * lSym, char lName[], char operator[], int64 rSym, char rName[])
{
  char symLNameBuf[256];
  _fct_EnsureSymbolName(lSym, lName, symLNameBuf);
  _fct_TiNameOpValue(indent, symLNameBuf, operator, rSym, rName);
  _fct_TiValueCell(lSym);
}
_fct_ChckRep(long indent, signal * lSym, char lName[], char operator[], qword rSym, char rName[])
{
  char symLNameBuf[256];
  _fct_EnsureSymbolName(lSym, lName, symLNameBuf);
  _fct_TiNameOpValue(indent, symLNameBuf, operator, rSym, rName);
  _fct_TiValueCell(lSym);
}

export void press_pin4_ms_wait_s_for_active(int64 _ttg_var_press_time_3_1_2_0_2_0, int64 _ttg_var_wait_for_active_s_3_1_2_0_2_1)
{
  TestCommandBegin("CAPL Inline", "Press on pin4 one time");
  {
    _ttg_fct_caplinline_3_1_2_0_4();
  }
  // _ttg_!_3_1_2_0_4
  TestCommandEnd();
  TestCommandBegin("Wait", "");
  {
    _fct_Wait("1", (int64)(_ttg_var_press_time_3_1_2_0_2_0 * 1000000LL), 1000000, "press_time");
  }
  // _ttg_!_3_1_2_0_5
  TestCommandEnd();
  TestCommandBegin("CAPL Inline", "Release pin4");
  {
    _ttg_fct_caplinline_3_1_2_0_6();
  }
  // _ttg_!_3_1_2_0_6
  TestCommandEnd();
  TestCommandBegin("Wait", "Wait for ambient light active");
  {
    _fct_Wait("1", (int64)(_ttg_var_wait_for_active_s_3_1_2_0_2_1 * 1000000000LL), 1000000000, "wait_for_active_s");
  }
  // _ttg_!_3_1_2_0_7
  TestCommandEnd();
}
// _ttg_#_3_1_2_0
export void switch_off_by_time_ms(int64 _ttg_var_wait_for_switch_off_3_1_2_1_2_0, int64 _ttg_var_need_close_door_or_not_3_1_2_1_2_1)
{
  TestCommandBegin("Set", "");
  {
    _fct_TiTableHeadAssignment();
    _fct_Set(CAN::dbNode::PEPS::PEPS2::SystemPowerMode, "CAN signal \'SystemPowerMode\'", 0LL, "OFF");
    _fct_TiTableEnd("1", 0, 0);
  }
  // _ttg_!_3_1_2_1_3
  TestCommandEnd();
  TestCommandBegin("Wait", "");
  {
    _fct_Wait("1", (int64)(_ttg_var_wait_for_switch_off_3_1_2_1_2_0 * 1000000LL), 1000000, "wait_for_switch_off");
  }
  // _ttg_!_3_1_2_1_4
  TestCommandEnd();
  TestCommandBegin("Check", "Check if it will switched off by time (20s)");
  {
    _fct_TiTableHeadExpected();
    _fct_ChckRep(0, sysvarFloat::VTS::M9_Ch3::PWMFreq, "System variable \'M9_Ch3::PWMFreq\'", "==", 0LL, "");
    _fct_TiCellResult((CheckSignalMatch(sysvarFloat::VTS::M9_Ch3::PWMFreq, 0LL, "=") == 1));
    _fct_ChckRep(0, sysvarFloat::VTS::M9_Ch3::Avg, "System variable \'M9_Ch3::Avg\'", "<=", 0.2, "");
    _fct_TiCellResult((CheckSignalMatch(sysvarFloat::VTS::M9_Ch3::Avg, 0.2, "<=") == 1));
    _fct_ChckRep(0, sysvarFloat::VTS::M9_Ch2::PWMFreq, "System variable \'M9_Ch2::PWMFreq\'", "==", 0LL, "");
    _fct_TiCellResult((CheckSignalMatch(sysvarFloat::VTS::M9_Ch2::PWMFreq, 0LL, "=") == 1));
    _fct_ChckRep(0, sysvarFloat::VTS::M9_Ch2::Avg, "System variable \'M9_Ch2::Avg\'", "<=", 0.2, "");
    _fct_TiCellResult((CheckSignalMatch(sysvarFloat::VTS::M9_Ch2::Avg, 0.2, "<=") == 1));
    _fct_ChckRep(0, sysvarFloat::VTS::M9_Ch1::PWMFreq, "System variable \'M9_Ch1::PWMFreq\'", "==", 0LL, "");
    _fct_TiCellResult((CheckSignalMatch(sysvarFloat::VTS::M9_Ch1::PWMFreq, 0LL, "=") == 1));
    _fct_ChckRep(0, sysvarFloat::VTS::M9_Ch1::Avg, "System variable \'M9_Ch1::Avg\'", "<=", 0.2, "");
    _fct_TiCellResult((CheckSignalMatch(sysvarFloat::VTS::M9_Ch1::Avg, 0.2, "<=") == 1));
    _fct_TiTableEvaluation("1");
  }
  // _ttg_!_3_1_2_1_5
  TestCommandEnd();
  _ttg_verdict = -1;
  TestControlStructBegin("If", "");
  {
    int bCondition, bDone;
    bDone = 0;
    {
      {
        bCondition = (_ttg_var_need_close_door_or_not_3_1_2_1_2_1!=0LL);
      }
      _fct_ConditionTableHead("If ( need_close_door_or_not!=0 )", bCondition);
      _fct_ChckRep(0, _ttg_var_need_close_door_or_not_3_1_2_1_2_1, "Variable \'need_close_door_or_not\'", "!=", 0LL, "");
      _fct_TiCellResultTrueFalse((_ttg_var_need_close_door_or_not_3_1_2_1_2_1!=0LL));
      _fct_TiTableEnd("", 0, 2);
      if(bCondition)
      {
        bDone = 1;
        TestCommandBegin("Set", "");
        {
          _fct_TiTableHeadAssignment();
          _fct_Set(CAN::dbNode::BCM::BCM1::DriverDoorSts, "CAN signal \'DriverDoorSts\'", 0LL, "Closed");
          _fct_Set(CAN::dbNode::BCM::BCM1::PassengerDoorSts, "CAN signal \'PassengerDoorSts\'", 0LL, "Closed");
          _fct_Set(CAN::dbNode::BCM::BCM1::RLDoorSts, "CAN signal \'RLDoorSts\'", 0LL, "Closed");
          _fct_Set(CAN::dbNode::BCM::BCM1::RRDoorSts, "CAN signal \'RRDoorSts\'", 0LL, "Closed");
          _fct_TiTableEnd("1", 0, 0);
        }
        // _ttg_!_3_1_2_1_6_2
        TestCommandEnd();
        TestCommandBegin("Wait", "");
        {
          _fct_Wait("1", (int64)(100LL * 1000000LL), 1000000, "");
        }
        // _ttg_!_3_1_2_1_6_3
        TestCommandEnd();
      }
    }
  }
  // _ttg_!_3_1_2_1_6
  _fct_TestControlStructEnd(1);
}
// _ttg_#_3_1_2_1
export void switch_on_by_door_open_signal_when_ign_off(int64 _ttg_var_PosLmpSts_value_3_1_2_2_2_0, signal * _ttg_var_door_open_signal_3_1_2_2_2_1, int64 _ttg_var_color_mode_3_1_2_2_2_2)
{
  TestCommandBegin("Set", "Set IGN OFF , PosLmpSts && Open one door");
  {
    _fct_TiTableHeadAssignment();
    _fct_Set(CAN::dbNode::PEPS::PEPS2::SystemPowerMode, "CAN signal \'SystemPowerMode\'", 0LL, "OFF");
    _fct_Set(CAN::dbNode::BCM::BCM1::PosLmpSts, "CAN signal \'PosLmpSts\'", _ttg_var_PosLmpSts_value_3_1_2_2_2_0, "PosLmpSts_value");
    _fct_Set(_ttg_var_door_open_signal_3_1_2_2_2_1, "", 1LL, "");
    _fct_TiTableEnd("1", 0, 0);
  }
  // _ttg_!_3_1_2_2_3
  TestCommandEnd();
  TestCommandBegin("Wait", "");
  {
    _fct_Wait("1", (int64)(2LL * 1000000000LL), 1000000000, "");
  }
  // _ttg_!_3_1_2_2_4
  TestCommandEnd();
  {
    CreateTTEIFFunction("check_color_mode_when_ALCMLightLvlSet_inactived", 0, 1);
    AddIFParameterInt64(_ttg_var_color_mode_3_1_2_2_2_2);
    CallInterfaceFunction("check_color_mode_when_ALCMLightLvlSet_inactived (color_mode=color_mode)");
  }
  TestCommandBegin("Wait", "");
  {
    _fct_Wait("1", (int64)(100LL * 1000000LL), 1000000, "");
  }
  // _ttg_!_3_1_2_2_6
  TestCommandEnd();
  TestCommandBegin("Set", "");
  {
    _fct_TiTableHeadAssignment();
    _fct_Set(_ttg_var_door_open_signal_3_1_2_2_2_1, "", 0LL, "");
    _fct_TiTableEnd("1", 0, 0);
  }
  // _ttg_!_3_1_2_2_7
  TestCommandEnd();
}
// _ttg_#_3_1_2_2
export void check_color_mode_when_ALCMLightLvlSet_actived(int64 _ttg_var_color_mode_3_1_2_3_2_0)
{
  {
    // Variables
    _ttg_var_light_level_3_1_2_3_3_0 = 0LL;
    snprintf(_ttg_B, 2000, "%I64d", 0LL);
    TestReportVariableDefinition("light_level", "int", _ttg_B);
    _ttg_var_m9_ch3_pwmdc_high_3_1_2_3_3_1 = 0LL;
    snprintf(_ttg_B, 2000, "%I64d", 0LL);
    TestReportVariableDefinition("m9_ch3_pwmdc_high", "float", _ttg_B);
    _ttg_var_m9_ch3_pwmdc_low_3_1_2_3_3_2 = 0LL;
    snprintf(_ttg_B, 2000, "%I64d", 0LL);
    TestReportVariableDefinition("m9_ch3_pwmdc_low", "float", _ttg_B);
    _ttg_var_m9_ch2_pwmdc_high_3_1_2_3_3_3 = 0LL;
    snprintf(_ttg_B, 2000, "%I64d", 0LL);
    TestReportVariableDefinition("m9_ch2_pwmdc_high", "float", _ttg_B);
    _ttg_var_m9_ch2_pwmdc_low_3_1_2_3_3_4 = 0LL;
    snprintf(_ttg_B, 2000, "%I64d", 0LL);
    TestReportVariableDefinition("m9_ch2_pwmdc_low", "float", _ttg_B);
    _ttg_var_m9_ch1_pwmdc_high_3_1_2_3_3_5 = 0LL;
    snprintf(_ttg_B, 2000, "%I64d", 0LL);
    TestReportVariableDefinition("m9_ch1_pwmdc_high", "float", _ttg_B);
    _ttg_var_m9_ch1_pwmdc_low_3_1_2_3_3_6 = 0LL;
    snprintf(_ttg_B, 2000, "%I64d", 0LL);
    TestReportVariableDefinition("m9_ch1_pwmdc_low", "float", _ttg_B);
  }
  TestCommandBegin("CAPL Inline", "get signal from ALCMLightLvlSet");
  {
    _ttg_fct_caplinline_3_1_2_3_4();
  }
  // _ttg_!_3_1_2_3_4
  TestCommandEnd();
  _ttg_verdict = -1;
  TestControlStructBegin("If", "");
  {
    int bCondition, bDone;
    bDone = 0;
    {
      {
        bCondition = ((_ttg_var_light_level_3_1_2_3_3_0!=0LL)&&(_ttg_var_light_level_3_1_2_3_3_0!=10LL));
      }
      _fct_ConditionTableHead("If ( ( light_level!=0 ) && ( light_level!=10 ) ) ", bCondition);
      _fct_ChckRep(0, _ttg_var_light_level_3_1_2_3_3_0, "Variable \'light_level\'", "!=", 0LL, "");
      _fct_TiCellResultTrueFalse((_ttg_var_light_level_3_1_2_3_3_0!=0LL));
      _fct_ChckRep(0, _ttg_var_light_level_3_1_2_3_3_0, "Variable \'light_level\'", "!=", 10LL, "");
      _fct_TiCellResultTrueFalse((_ttg_var_light_level_3_1_2_3_3_0!=10LL));
      _fct_TiTableEnd("", 0, 2);
      if(bCondition)
      {
        bDone = 1;
        _ttg_verdict = -1;
        TestControlStructBegin("If", "");
        {
          int bCondition, bDone;
          bDone = 0;
          {
            {
              bCondition = (_ttg_var_color_mode_3_1_2_3_2_0==1LL);
            }
            _fct_ConditionTableHead("If ( color_mode==1 )", bCondition);
            _fct_ChckRep(0, _ttg_var_color_mode_3_1_2_3_2_0, "Variable \'color_mode\'", "==", 1LL, "");
            _fct_TiCellResultTrueFalse((_ttg_var_color_mode_3_1_2_3_2_0==1LL));
            _fct_TiTableEnd("", 0, 2);
            if(bCondition)
            {
              bDone = 1;
              TestCommandBegin("CAPL Inline", "calculate duty cycle of all channels");
              {
                _ttg_fct_caplinline_3_1_2_3_5_2_2();
              }
              // _ttg_!_3_1_2_3_5_2_2
              TestCommandEnd();
              TestCommandBegin("Check", "Check if it's under Day mode Mode1");
              {
                _fct_TiTableHeadExpected();
                _fct_ChckRep(0, sysvarFloat::VTS::M9_Ch3::PWMFreq, "System variable \'M9_Ch3::PWMFreq\'", "Range", "190..210", "");
                _fct_TiCellResult(((@sysvarFloat::VTS::M9_Ch3::PWMFreq>=190LL) && (@sysvarFloat::VTS::M9_Ch3::PWMFreq<=210LL)));
                snprintf(_ttg_Z, elCount(_ttg_Z), "%.15g..%.15g (m9_ch3_pwmdc_low..m9_ch3_pwmdc_high)", _ttg_var_m9_ch3_pwmdc_low_3_1_2_3_3_2, _ttg_var_m9_ch3_pwmdc_high_3_1_2_3_3_1);
                _fct_ChckRep(0, sysvarFloat::VTS::M9_Ch3::PWMDC, "System variable \'M9_Ch3::PWMDC\'", "Range", _ttg_Z, "");
                _fct_TiCellResult(((@sysvarFloat::VTS::M9_Ch3::PWMDC>=_ttg_var_m9_ch3_pwmdc_low_3_1_2_3_3_2) && (@sysvarFloat::VTS::M9_Ch3::PWMDC<=_ttg_var_m9_ch3_pwmdc_high_3_1_2_3_3_1)));
                _fct_ChckRep(0, sysvarFloat::VTS::M9_Ch2::PWMFreq, "System variable \'M9_Ch2::PWMFreq\'", "==", 0LL, "");
                _fct_TiCellResult((CheckSignalMatch(sysvarFloat::VTS::M9_Ch2::PWMFreq, 0LL, "=") == 1));
                _fct_ChckRep(0, sysvarFloat::VTS::M9_Ch2::PWMDC, "System variable \'M9_Ch2::PWMDC\'", "==", 0LL, "");
                _fct_TiCellResult((CheckSignalMatch(sysvarFloat::VTS::M9_Ch2::PWMDC, 0LL, "=") == 1));
                _fct_ChckRep(0, sysvarFloat::VTS::M9_Ch2::Avg, "System variable \'M9_Ch2::Avg\'", "<=", 0.2, "");
                _fct_TiCellResult((CheckSignalMatch(sysvarFloat::VTS::M9_Ch2::Avg, 0.2, "<=") == 1));
                _fct_ChckRep(0, sysvarFloat::VTS::M9_Ch1::PWMFreq, "System variable \'M9_Ch1::PWMFreq\'", "Range", "190..210", "");
                _fct_TiCellResult(((@sysvarFloat::VTS::M9_Ch1::PWMFreq>=190LL) && (@sysvarFloat::VTS::M9_Ch1::PWMFreq<=210LL)));
                snprintf(_ttg_Z, elCount(_ttg_Z), "%.15g..%.15g (m9_ch1_pwmdc_low..m9_ch1_pwmdc_high)", _ttg_var_m9_ch1_pwmdc_low_3_1_2_3_3_6, _ttg_var_m9_ch1_pwmdc_high_3_1_2_3_3_5);
                _fct_ChckRep(0, sysvarFloat::VTS::M9_Ch1::PWMDC, "System variable \'M9_Ch1::PWMDC\'", "Range", _ttg_Z, "");
                _fct_TiCellResult(((@sysvarFloat::VTS::M9_Ch1::PWMDC>=_ttg_var_m9_ch1_pwmdc_low_3_1_2_3_3_6) && (@sysvarFloat::VTS::M9_Ch1::PWMDC<=_ttg_var_m9_ch1_pwmdc_high_3_1_2_3_3_5)));
                _fct_TiTableEvaluation("1");
              }
              // _ttg_!_3_1_2_3_5_2_3
              TestCommandEnd();
            }
          }
          // _ttg_!_3_1_2_3_5_2
          _fct_TestControlStructEnd(1);
          _ttg_verdict = -1;
          TestControlStructBegin("Else If", "");
          {
            if(_fct_DoElseIf(bDone))
            {
              {
                bCondition = (_ttg_var_color_mode_3_1_2_3_2_0==2LL);
              }
              _fct_ConditionTableHead("Else If ( color_mode==2 )", bCondition);
              _fct_ChckRep(0, _ttg_var_color_mode_3_1_2_3_2_0, "Variable \'color_mode\'", "==", 2LL, "");
              _fct_TiCellResultTrueFalse((_ttg_var_color_mode_3_1_2_3_2_0==2LL));
              _fct_TiTableEnd("", 0, 2);
              if(bCondition)
              {
                bDone = 1;
                TestCommandBegin("CAPL Inline", "calculate duty cycle of all channels");
                {
                  _ttg_fct_caplinline_3_1_2_3_5_3_2();
                }
                // _ttg_!_3_1_2_3_5_3_2
                TestCommandEnd();
                TestCommandBegin("Check", "Check if it's under Day mode Mode2");
                {
                  _fct_TiTableHeadExpected();
                  _fct_ChckRep(0, sysvarFloat::VTS::M9_Ch3::PWMFreq, "System variable \'M9_Ch3::PWMFreq\'", "Range", "190..210", "");
                  _fct_TiCellResult(((@sysvarFloat::VTS::M9_Ch3::PWMFreq>=190LL) && (@sysvarFloat::VTS::M9_Ch3::PWMFreq<=210LL)));
                  snprintf(_ttg_Z, elCount(_ttg_Z), "%.15g..%.15g (m9_ch3_pwmdc_low..m9_ch3_pwmdc_high)", _ttg_var_m9_ch3_pwmdc_low_3_1_2_3_3_2, _ttg_var_m9_ch3_pwmdc_high_3_1_2_3_3_1);
                  _fct_ChckRep(0, sysvarFloat::VTS::M9_Ch3::PWMDC, "System variable \'M9_Ch3::PWMDC\'", "Range", _ttg_Z, "");
                  _fct_TiCellResult(((@sysvarFloat::VTS::M9_Ch3::PWMDC>=_ttg_var_m9_ch3_pwmdc_low_3_1_2_3_3_2) && (@sysvarFloat::VTS::M9_Ch3::PWMDC<=_ttg_var_m9_ch3_pwmdc_high_3_1_2_3_3_1)));
                  _fct_ChckRep(0, sysvarFloat::VTS::M9_Ch2::PWMFreq, "System variable \'M9_Ch2::PWMFreq\'", "Range", "190..210", "");
                  _fct_TiCellResult(((@sysvarFloat::VTS::M9_Ch2::PWMFreq>=190LL) && (@sysvarFloat::VTS::M9_Ch2::PWMFreq<=210LL)));
                  snprintf(_ttg_Z, elCount(_ttg_Z), "%.15g..%.15g (m9_ch2_pwmdc_low..m9_ch2_pwmdc_high)", _ttg_var_m9_ch2_pwmdc_low_3_1_2_3_3_4, _ttg_var_m9_ch2_pwmdc_high_3_1_2_3_3_3);
                  _fct_ChckRep(0, sysvarFloat::VTS::M9_Ch2::PWMDC, "System variable \'M9_Ch2::PWMDC\'", "Range", _ttg_Z, "");
                  _fct_TiCellResult(((@sysvarFloat::VTS::M9_Ch2::PWMDC>=_ttg_var_m9_ch2_pwmdc_low_3_1_2_3_3_4) && (@sysvarFloat::VTS::M9_Ch2::PWMDC<=_ttg_var_m9_ch2_pwmdc_high_3_1_2_3_3_3)));
                  _fct_ChckRep(0, sysvarFloat::VTS::M9_Ch1::PWMFreq, "System variable \'M9_Ch1::PWMFreq\'", "==", 0LL, "");
                  _fct_TiCellResult((CheckSignalMatch(sysvarFloat::VTS::M9_Ch1::PWMFreq, 0LL, "=") == 1));
                  _fct_ChckRep(0, sysvarFloat::VTS::M9_Ch1::PWMDC, "System variable \'M9_Ch1::PWMDC\'", "==", 0LL, "");
                  _fct_TiCellResult((CheckSignalMatch(sysvarFloat::VTS::M9_Ch1::PWMDC, 0LL, "=") == 1));
                  _fct_ChckRep(0, sysvarFloat::VTS::M9_Ch1::Avg, "System variable \'M9_Ch1::Avg\'", "<=", 0.2, "");
                  _fct_TiCellResult((CheckSignalMatch(sysvarFloat::VTS::M9_Ch1::Avg, 0.2, "<=") == 1));
                  _fct_TiTableEvaluation("1");
                }
                // _ttg_!_3_1_2_3_5_3_3
                TestCommandEnd();
              }
            }
          }
          // _ttg_!_3_1_2_3_5_3
          _fct_TestControlStructEnd(1);
          _ttg_verdict = -1;
          TestControlStructBegin("Else If", "");
          {
            if(_fct_DoElseIf(bDone))
            {
              {
                bCondition = (_ttg_var_color_mode_3_1_2_3_2_0==3LL);
              }
              _fct_ConditionTableHead("Else If ( color_mode==3 )", bCondition);
              _fct_ChckRep(0, _ttg_var_color_mode_3_1_2_3_2_0, "Variable \'color_mode\'", "==", 3LL, "");
              _fct_TiCellResultTrueFalse((_ttg_var_color_mode_3_1_2_3_2_0==3LL));
              _fct_TiTableEnd("", 0, 2);
              if(bCondition)
              {
                bDone = 1;
                TestCommandBegin("CAPL Inline", "calculate duty cycle of all channels");
                {
                  _ttg_fct_caplinline_3_1_2_3_5_4_2();
                }
                // _ttg_!_3_1_2_3_5_4_2
                TestCommandEnd();
                TestCommandBegin("Check", "Check if it's under Day mode Mode3");
                {
                  _fct_TiTableHeadExpected();
                  _fct_ChckRep(0, sysvarFloat::VTS::M9_Ch3::PWMFreq, "System variable \'M9_Ch3::PWMFreq\'", "==", 0LL, "");
                  _fct_TiCellResult((CheckSignalMatch(sysvarFloat::VTS::M9_Ch3::PWMFreq, 0LL, "=") == 1));
                  _fct_ChckRep(0, sysvarFloat::VTS::M9_Ch3::PWMDC, "System variable \'M9_Ch3::PWMDC\'", "==", 0LL, "");
                  _fct_TiCellResult((CheckSignalMatch(sysvarFloat::VTS::M9_Ch3::PWMDC, 0LL, "=") == 1));
                  _fct_ChckRep(0, sysvarFloat::VTS::M9_Ch3::Avg, "System variable \'M9_Ch3::Avg\'", "<=", 0.2, "");
                  _fct_TiCellResult((CheckSignalMatch(sysvarFloat::VTS::M9_Ch3::Avg, 0.2, "<=") == 1));
                  _fct_ChckRep(0, sysvarFloat::VTS::M9_Ch2::PWMFreq, "System variable \'M9_Ch2::PWMFreq\'", "Range", "190..210", "");
                  _fct_TiCellResult(((@sysvarFloat::VTS::M9_Ch2::PWMFreq>=190LL) && (@sysvarFloat::VTS::M9_Ch2::PWMFreq<=210LL)));
                  snprintf(_ttg_Z, elCount(_ttg_Z), "%.15g..%.15g (m9_ch2_pwmdc_low..m9_ch2_pwmdc_high)", _ttg_var_m9_ch2_pwmdc_low_3_1_2_3_3_4, _ttg_var_m9_ch2_pwmdc_high_3_1_2_3_3_3);
                  _fct_ChckRep(0, sysvarFloat::VTS::M9_Ch2::PWMDC, "System variable \'M9_Ch2::PWMDC\'", "Range", _ttg_Z, "");
                  _fct_TiCellResult(((@sysvarFloat::VTS::M9_Ch2::PWMDC>=_ttg_var_m9_ch2_pwmdc_low_3_1_2_3_3_4) && (@sysvarFloat::VTS::M9_Ch2::PWMDC<=_ttg_var_m9_ch2_pwmdc_high_3_1_2_3_3_3)));
                  _fct_ChckRep(0, sysvarFloat::VTS::M9_Ch1::PWMFreq, "System variable \'M9_Ch1::PWMFreq\'", "Range", "190..210", "");
                  _fct_TiCellResult(((@sysvarFloat::VTS::M9_Ch1::PWMFreq>=190LL) && (@sysvarFloat::VTS::M9_Ch1::PWMFreq<=210LL)));
                  snprintf(_ttg_Z, elCount(_ttg_Z), "%.15g..%.15g (m9_ch1_pwmdc_low..m9_ch1_pwmdc_high)", _ttg_var_m9_ch1_pwmdc_low_3_1_2_3_3_6, _ttg_var_m9_ch1_pwmdc_high_3_1_2_3_3_5);
                  _fct_ChckRep(0, sysvarFloat::VTS::M9_Ch1::PWMDC, "System variable \'M9_Ch1::PWMDC\'", "Range", _ttg_Z, "");
                  _fct_TiCellResult(((@sysvarFloat::VTS::M9_Ch1::PWMDC>=_ttg_var_m9_ch1_pwmdc_low_3_1_2_3_3_6) && (@sysvarFloat::VTS::M9_Ch1::PWMDC<=_ttg_var_m9_ch1_pwmdc_high_3_1_2_3_3_5)));
                  _fct_TiTableEvaluation("1");
                }
                // _ttg_!_3_1_2_3_5_4_3
                TestCommandEnd();
              }
            }
          }
          // _ttg_!_3_1_2_3_5_4
          _fct_TestControlStructEnd(1);
          _ttg_verdict = -1;
          TestControlStructBegin("Else If", "");
          {
            if(_fct_DoElseIf(bDone))
            {
              {
                bCondition = (_ttg_var_color_mode_3_1_2_3_2_0==4LL);
              }
              _fct_ConditionTableHead("Else If ( color_mode==4 )", bCondition);
              _fct_ChckRep(0, _ttg_var_color_mode_3_1_2_3_2_0, "Variable \'color_mode\'", "==", 4LL, "");
              _fct_TiCellResultTrueFalse((_ttg_var_color_mode_3_1_2_3_2_0==4LL));
              _fct_TiTableEnd("", 0, 2);
              if(bCondition)
              {
                bDone = 1;
                TestCommandBegin("CAPL Inline", "calculate duty cycle of all channels");
                {
                  _ttg_fct_caplinline_3_1_2_3_5_5_2();
                }
                // _ttg_!_3_1_2_3_5_5_2
                TestCommandEnd();
                TestCommandBegin("Check", "Check if it's under Day mode Mode4");
                {
                  _fct_TiTableHeadExpected();
                  _fct_ChckRep(0, sysvarFloat::VTS::M9_Ch3::PWMFreq, "System variable \'M9_Ch3::PWMFreq\'", "Range", "190..210", "");
                  _fct_TiCellResult(((@sysvarFloat::VTS::M9_Ch3::PWMFreq>=190LL) && (@sysvarFloat::VTS::M9_Ch3::PWMFreq<=210LL)));
                  snprintf(_ttg_Z, elCount(_ttg_Z), "%.15g..%.15g (m9_ch3_pwmdc_low..m9_ch3_pwmdc_high)", _ttg_var_m9_ch3_pwmdc_low_3_1_2_3_3_2, _ttg_var_m9_ch3_pwmdc_high_3_1_2_3_3_1);
                  _fct_ChckRep(0, sysvarFloat::VTS::M9_Ch3::PWMDC, "System variable \'M9_Ch3::PWMDC\'", "Range", _ttg_Z, "");
                  _fct_TiCellResult(((@sysvarFloat::VTS::M9_Ch3::PWMDC>=_ttg_var_m9_ch3_pwmdc_low_3_1_2_3_3_2) && (@sysvarFloat::VTS::M9_Ch3::PWMDC<=_ttg_var_m9_ch3_pwmdc_high_3_1_2_3_3_1)));
                  _fct_ChckRep(0, sysvarFloat::VTS::M9_Ch2::PWMFreq, "System variable \'M9_Ch2::PWMFreq\'", "==", 0LL, "");
                  _fct_TiCellResult((CheckSignalMatch(sysvarFloat::VTS::M9_Ch2::PWMFreq, 0LL, "=") == 1));
                  _fct_ChckRep(0, sysvarFloat::VTS::M9_Ch2::PWMDC, "System variable \'M9_Ch2::PWMDC\'", "==", 0LL, "");
                  _fct_TiCellResult((CheckSignalMatch(sysvarFloat::VTS::M9_Ch2::PWMDC, 0LL, "=") == 1));
                  _fct_ChckRep(0, sysvarFloat::VTS::M9_Ch2::Avg, "System variable \'M9_Ch2::Avg\'", "<=", 0.2, "");
                  _fct_TiCellResult((CheckSignalMatch(sysvarFloat::VTS::M9_Ch2::Avg, 0.2, "<=") == 1));
                  _fct_ChckRep(0, sysvarFloat::VTS::M9_Ch1::PWMFreq, "System variable \'M9_Ch1::PWMFreq\'", "Range", "190..210", "");
                  _fct_TiCellResult(((@sysvarFloat::VTS::M9_Ch1::PWMFreq>=190LL) && (@sysvarFloat::VTS::M9_Ch1::PWMFreq<=210LL)));
                  snprintf(_ttg_Z, elCount(_ttg_Z), "%.15g..%.15g (m9_ch1_pwmdc_low..m9_ch1_pwmdc_high)", _ttg_var_m9_ch1_pwmdc_low_3_1_2_3_3_6, _ttg_var_m9_ch1_pwmdc_high_3_1_2_3_3_5);
                  _fct_ChckRep(0, sysvarFloat::VTS::M9_Ch1::PWMDC, "System variable \'M9_Ch1::PWMDC\'", "Range", _ttg_Z, "");
                  _fct_TiCellResult(((@sysvarFloat::VTS::M9_Ch1::PWMDC>=_ttg_var_m9_ch1_pwmdc_low_3_1_2_3_3_6) && (@sysvarFloat::VTS::M9_Ch1::PWMDC<=_ttg_var_m9_ch1_pwmdc_high_3_1_2_3_3_5)));
                  _fct_TiTableEvaluation("1");
                }
                // _ttg_!_3_1_2_3_5_5_3
                TestCommandEnd();
              }
            }
          }
          // _ttg_!_3_1_2_3_5_5
          _fct_TestControlStructEnd(1);
          _ttg_verdict = -1;
          TestControlStructBegin("Else If", "");
          {
            if(_fct_DoElseIf(bDone))
            {
              {
                bCondition = (_ttg_var_color_mode_3_1_2_3_2_0==5LL);
              }
              _fct_ConditionTableHead("Else If ( color_mode==5 )", bCondition);
              _fct_ChckRep(0, _ttg_var_color_mode_3_1_2_3_2_0, "Variable \'color_mode\'", "==", 5LL, "");
              _fct_TiCellResultTrueFalse((_ttg_var_color_mode_3_1_2_3_2_0==5LL));
              _fct_TiTableEnd("", 0, 2);
              if(bCondition)
              {
                bDone = 1;
                TestCommandBegin("CAPL Inline", "calculate duty cycle of all channels");
                {
                  _ttg_fct_caplinline_3_1_2_3_5_6_2();
                }
                // _ttg_!_3_1_2_3_5_6_2
                TestCommandEnd();
                TestCommandBegin("Check", "Check if it's under Day mode Mode5");
                {
                  _fct_TiTableHeadExpected();
                  _fct_ChckRep(0, sysvarFloat::VTS::M9_Ch3::PWMFreq, "System variable \'M9_Ch3::PWMFreq\'", "Range", "190..210", "");
                  _fct_TiCellResult(((@sysvarFloat::VTS::M9_Ch3::PWMFreq>=190LL) && (@sysvarFloat::VTS::M9_Ch3::PWMFreq<=210LL)));
                  snprintf(_ttg_Z, elCount(_ttg_Z), "%.15g..%.15g (m9_ch3_pwmdc_low..m9_ch3_pwmdc_high)", _ttg_var_m9_ch3_pwmdc_low_3_1_2_3_3_2, _ttg_var_m9_ch3_pwmdc_high_3_1_2_3_3_1);
                  _fct_ChckRep(0, sysvarFloat::VTS::M9_Ch3::PWMDC, "System variable \'M9_Ch3::PWMDC\'", "Range", _ttg_Z, "");
                  _fct_TiCellResult(((@sysvarFloat::VTS::M9_Ch3::PWMDC>=_ttg_var_m9_ch3_pwmdc_low_3_1_2_3_3_2) && (@sysvarFloat::VTS::M9_Ch3::PWMDC<=_ttg_var_m9_ch3_pwmdc_high_3_1_2_3_3_1)));
                  _fct_ChckRep(0, sysvarFloat::VTS::M9_Ch2::PWMFreq, "System variable \'M9_Ch2::PWMFreq\'", "Range", "190..210", "");
                  _fct_TiCellResult(((@sysvarFloat::VTS::M9_Ch2::PWMFreq>=190LL) && (@sysvarFloat::VTS::M9_Ch2::PWMFreq<=210LL)));
                  snprintf(_ttg_Z, elCount(_ttg_Z), "%.15g..%.15g (m9_ch2_pwmdc_low..m9_ch2_pwmdc_high)", _ttg_var_m9_ch2_pwmdc_low_3_1_2_3_3_4, _ttg_var_m9_ch2_pwmdc_high_3_1_2_3_3_3);
                  _fct_ChckRep(0, sysvarFloat::VTS::M9_Ch2::PWMDC, "System variable \'M9_Ch2::PWMDC\'", "Range", _ttg_Z, "");
                  _fct_TiCellResult(((@sysvarFloat::VTS::M9_Ch2::PWMDC>=_ttg_var_m9_ch2_pwmdc_low_3_1_2_3_3_4) && (@sysvarFloat::VTS::M9_Ch2::PWMDC<=_ttg_var_m9_ch2_pwmdc_high_3_1_2_3_3_3)));
                  _fct_ChckRep(0, sysvarFloat::VTS::M9_Ch1::PWMFreq, "System variable \'M9_Ch1::PWMFreq\'", "==", 0LL, "");
                  _fct_TiCellResult((CheckSignalMatch(sysvarFloat::VTS::M9_Ch1::PWMFreq, 0LL, "=") == 1));
                  _fct_ChckRep(0, sysvarFloat::VTS::M9_Ch1::PWMDC, "System variable \'M9_Ch1::PWMDC\'", "==", 0LL, "");
                  _fct_TiCellResult((CheckSignalMatch(sysvarFloat::VTS::M9_Ch1::PWMDC, 0LL, "=") == 1));
                  _fct_ChckRep(0, sysvarFloat::VTS::M9_Ch1::Avg, "System variable \'M9_Ch1::Avg\'", "<=", 0.2, "");
                  _fct_TiCellResult((CheckSignalMatch(sysvarFloat::VTS::M9_Ch1::Avg, 0.2, "<=") == 1));
                  _fct_TiTableEvaluation("1");
                }
                // _ttg_!_3_1_2_3_5_6_3
                TestCommandEnd();
              }
            }
          }
          // _ttg_!_3_1_2_3_5_6
          _fct_TestControlStructEnd(1);
          _ttg_verdict = -1;
          TestControlStructBegin("Else If", "");
          {
            if(_fct_DoElseIf(bDone))
            {
              {
                bCondition = (_ttg_var_color_mode_3_1_2_3_2_0==6LL);
              }
              _fct_ConditionTableHead("Else If ( color_mode==6 )", bCondition);
              _fct_ChckRep(0, _ttg_var_color_mode_3_1_2_3_2_0, "Variable \'color_mode\'", "==", 6LL, "");
              _fct_TiCellResultTrueFalse((_ttg_var_color_mode_3_1_2_3_2_0==6LL));
              _fct_TiTableEnd("", 0, 2);
              if(bCondition)
              {
                bDone = 1;
                TestCommandBegin("CAPL Inline", "calculate duty cycle of all channels");
                {
                  _ttg_fct_caplinline_3_1_2_3_5_7_2();
                }
                // _ttg_!_3_1_2_3_5_7_2
                TestCommandEnd();
                TestCommandBegin("Check", "Check if it's under Day mode Mode6");
                {
                  _fct_TiTableHeadExpected();
                  _fct_ChckRep(0, sysvarFloat::VTS::M9_Ch3::PWMFreq, "System variable \'M9_Ch3::PWMFreq\'", "==", 0LL, "");
                  _fct_TiCellResult((CheckSignalMatch(sysvarFloat::VTS::M9_Ch3::PWMFreq, 0LL, "=") == 1));
                  _fct_ChckRep(0, sysvarFloat::VTS::M9_Ch3::PWMDC, "System variable \'M9_Ch3::PWMDC\'", "==", 0LL, "");
                  _fct_TiCellResult((CheckSignalMatch(sysvarFloat::VTS::M9_Ch3::PWMDC, 0LL, "=") == 1));
                  _fct_ChckRep(0, sysvarFloat::VTS::M9_Ch3::Avg, "System variable \'M9_Ch3::Avg\'", "<=", 0.2, "");
                  _fct_TiCellResult((CheckSignalMatch(sysvarFloat::VTS::M9_Ch3::Avg, 0.2, "<=") == 1));
                  _fct_ChckRep(0, sysvarFloat::VTS::M9_Ch2::PWMFreq, "System variable \'M9_Ch2::PWMFreq\'", "Range", "190..210", "");
                  _fct_TiCellResult(((@sysvarFloat::VTS::M9_Ch2::PWMFreq>=190LL) && (@sysvarFloat::VTS::M9_Ch2::PWMFreq<=210LL)));
                  snprintf(_ttg_Z, elCount(_ttg_Z), "%.15g..%.15g (m9_ch2_pwmdc_low..m9_ch2_pwmdc_high)", _ttg_var_m9_ch2_pwmdc_low_3_1_2_3_3_4, _ttg_var_m9_ch2_pwmdc_high_3_1_2_3_3_3);
                  _fct_ChckRep(0, sysvarFloat::VTS::M9_Ch2::PWMDC, "System variable \'M9_Ch2::PWMDC\'", "Range", _ttg_Z, "");
                  _fct_TiCellResult(((@sysvarFloat::VTS::M9_Ch2::PWMDC>=_ttg_var_m9_ch2_pwmdc_low_3_1_2_3_3_4) && (@sysvarFloat::VTS::M9_Ch2::PWMDC<=_ttg_var_m9_ch2_pwmdc_high_3_1_2_3_3_3)));
                  _fct_ChckRep(0, sysvarFloat::VTS::M9_Ch1::PWMFreq, "System variable \'M9_Ch1::PWMFreq\'", "Range", "190..210", "");
                  _fct_TiCellResult(((@sysvarFloat::VTS::M9_Ch1::PWMFreq>=190LL) && (@sysvarFloat::VTS::M9_Ch1::PWMFreq<=210LL)));
                  snprintf(_ttg_Z, elCount(_ttg_Z), "%.15g..%.15g (m9_ch1_pwmdc_low..m9_ch1_pwmdc_high)", _ttg_var_m9_ch1_pwmdc_low_3_1_2_3_3_6, _ttg_var_m9_ch1_pwmdc_high_3_1_2_3_3_5);
                  _fct_ChckRep(0, sysvarFloat::VTS::M9_Ch1::PWMDC, "System variable \'M9_Ch1::PWMDC\'", "Range", _ttg_Z, "");
                  _fct_TiCellResult(((@sysvarFloat::VTS::M9_Ch1::PWMDC>=_ttg_var_m9_ch1_pwmdc_low_3_1_2_3_3_6) && (@sysvarFloat::VTS::M9_Ch1::PWMDC<=_ttg_var_m9_ch1_pwmdc_high_3_1_2_3_3_5)));
                  _fct_TiTableEvaluation("1");
                }
                // _ttg_!_3_1_2_3_5_7_3
                TestCommandEnd();
              }
            }
          }
        }
        // _ttg_!_3_1_2_3_5_7
        _fct_TestControlStructEnd(1);
      }
    }
    // _ttg_!_3_1_2_3_5
    _fct_TestControlStructEnd(1);
    _ttg_verdict = -1;
    TestControlStructBegin("Else If", "");
    {
      if(_fct_DoElseIf(bDone))
      {
        {
          bCondition = (_ttg_var_light_level_3_1_2_3_3_0==10LL);
        }
        _fct_ConditionTableHead("Else If ( light_level==10 )", bCondition);
        _fct_ChckRep(0, _ttg_var_light_level_3_1_2_3_3_0, "Variable \'light_level\'", "==", 10LL, "");
        _fct_TiCellResultTrueFalse((_ttg_var_light_level_3_1_2_3_3_0==10LL));
        _fct_TiTableEnd("", 0, 2);
        if(bCondition)
        {
          bDone = 1;
          _ttg_verdict = -1;
          TestControlStructBegin("If", "");
          {
            int bCondition, bDone;
            bDone = 0;
            {
              {
                bCondition = (_ttg_var_color_mode_3_1_2_3_2_0==1LL);
              }
              _fct_ConditionTableHead("If ( color_mode==1 )", bCondition);
              _fct_ChckRep(0, _ttg_var_color_mode_3_1_2_3_2_0, "Variable \'color_mode\'", "==", 1LL, "");
              _fct_TiCellResultTrueFalse((_ttg_var_color_mode_3_1_2_3_2_0==1LL));
              _fct_TiTableEnd("", 0, 2);
              if(bCondition)
              {
                bDone = 1;
                TestCommandBegin("CAPL Inline", "calculate duty cycle of all channels");
                {
                  _ttg_fct_caplinline_3_1_2_3_6_2_2();
                }
                // _ttg_!_3_1_2_3_6_2_2
                TestCommandEnd();
                TestCommandBegin("Check", "Check if it's under Day mode Mode1");
                {
                  _fct_TiTableHeadExpected();
                  _fct_ChckRep(0, sysvarFloat::VTS::M9_Ch3::PWMFreq, "System variable \'M9_Ch3::PWMFreq\'", "Range", "190..210", "");
                  _fct_TiCellResult(((@sysvarFloat::VTS::M9_Ch3::PWMFreq>=190LL) && (@sysvarFloat::VTS::M9_Ch3::PWMFreq<=210LL)));
                  snprintf(_ttg_Z, elCount(_ttg_Z), "%.15g..%.15g (m9_ch3_pwmdc_low..m9_ch3_pwmdc_high)", _ttg_var_m9_ch3_pwmdc_low_3_1_2_3_3_2, _ttg_var_m9_ch3_pwmdc_high_3_1_2_3_3_1);
                  _fct_ChckRep(0, sysvarFloat::VTS::M9_Ch3::PWMDC, "System variable \'M9_Ch3::PWMDC\'", "Range", _ttg_Z, "");
                  _fct_TiCellResult(((@sysvarFloat::VTS::M9_Ch3::PWMDC>=_ttg_var_m9_ch3_pwmdc_low_3_1_2_3_3_2) && (@sysvarFloat::VTS::M9_Ch3::PWMDC<=_ttg_var_m9_ch3_pwmdc_high_3_1_2_3_3_1)));
                  _fct_ChckRep(0, sysvarFloat::VTS::M9_Ch2::PWMFreq, "System variable \'M9_Ch2::PWMFreq\'", "==", 0LL, "");
                  _fct_TiCellResult((CheckSignalMatch(sysvarFloat::VTS::M9_Ch2::PWMFreq, 0LL, "=") == 1));
                  _fct_ChckRep(0, sysvarFloat::VTS::M9_Ch2::PWMDC, "System variable \'M9_Ch2::PWMDC\'", "==", 0LL, "");
                  _fct_TiCellResult((CheckSignalMatch(sysvarFloat::VTS::M9_Ch2::PWMDC, 0LL, "=") == 1));
                  _fct_ChckRep(0, sysvarFloat::VTS::M9_Ch2::Avg, "System variable \'M9_Ch2::Avg\'", "<=", 0.2, "");
                  _fct_TiCellResult((CheckSignalMatch(sysvarFloat::VTS::M9_Ch2::Avg, 0.2, "<=") == 1));
                  _fct_ChckRep(0, sysvarFloat::VTS::M9_Ch1::PWMFreq, "System variable \'M9_Ch1::PWMFreq\'", "==", 0LL, "");
                  _fct_TiCellResult((CheckSignalMatch(sysvarFloat::VTS::M9_Ch1::PWMFreq, 0LL, "=") == 1));
                  _fct_ChckRep(0, sysvarFloat::VTS::M9_Ch1::PWMDC, "System variable \'M9_Ch1::PWMDC\'", "==", 100LL, "");
                  _fct_TiCellResult((CheckSignalMatch(sysvarFloat::VTS::M9_Ch1::PWMDC, 100LL, "=") == 1));
                  _fct_ChckRep(0, sysvarFloat::VTS::M9_Ch1::Avg, "System variable \'M9_Ch1::Avg\'", ">=", 11LL, "");
                  _fct_TiCellResult((CheckSignalMatch(sysvarFloat::VTS::M9_Ch1::Avg, 11LL, ">=") == 1));
                  _fct_TiTableEvaluation("1");
                }
                // _ttg_!_3_1_2_3_6_2_3
                TestCommandEnd();
              }
            }
            // _ttg_!_3_1_2_3_6_2
            _fct_TestControlStructEnd(1);
            _ttg_verdict = -1;
            TestControlStructBegin("Else If", "");
            {
              if(_fct_DoElseIf(bDone))
              {
                {
                  bCondition = (_ttg_var_color_mode_3_1_2_3_2_0==2LL);
                }
                _fct_ConditionTableHead("Else If ( color_mode==2 )", bCondition);
                _fct_ChckRep(0, _ttg_var_color_mode_3_1_2_3_2_0, "Variable \'color_mode\'", "==", 2LL, "");
                _fct_TiCellResultTrueFalse((_ttg_var_color_mode_3_1_2_3_2_0==2LL));
                _fct_TiTableEnd("", 0, 2);
                if(bCondition)
                {
                  bDone = 1;
                  TestCommandBegin("CAPL Inline", "calculate duty cycle of all channels");
                  {
                    _ttg_fct_caplinline_3_1_2_3_6_3_2();
                  }
                  // _ttg_!_3_1_2_3_6_3_2
                  TestCommandEnd();
                  TestCommandBegin("Check", "Check if it's under Day mode Mode2");
                  {
                    _fct_TiTableHeadExpected();
                    _fct_ChckRep(0, sysvarFloat::VTS::M9_Ch3::PWMFreq, "System variable \'M9_Ch3::PWMFreq\'", "Range", "190..210", "");
                    _fct_TiCellResult(((@sysvarFloat::VTS::M9_Ch3::PWMFreq>=190LL) && (@sysvarFloat::VTS::M9_Ch3::PWMFreq<=210LL)));
                    snprintf(_ttg_Z, elCount(_ttg_Z), "%.15g..%.15g (m9_ch3_pwmdc_low..m9_ch3_pwmdc_high)", _ttg_var_m9_ch3_pwmdc_low_3_1_2_3_3_2, _ttg_var_m9_ch3_pwmdc_high_3_1_2_3_3_1);
                    _fct_ChckRep(0, sysvarFloat::VTS::M9_Ch3::PWMDC, "System variable \'M9_Ch3::PWMDC\'", "Range", _ttg_Z, "");
                    _fct_TiCellResult(((@sysvarFloat::VTS::M9_Ch3::PWMDC>=_ttg_var_m9_ch3_pwmdc_low_3_1_2_3_3_2) && (@sysvarFloat::VTS::M9_Ch3::PWMDC<=_ttg_var_m9_ch3_pwmdc_high_3_1_2_3_3_1)));
                    _fct_ChckRep(0, sysvarFloat::VTS::M9_Ch2::PWMFreq, "System variable \'M9_Ch2::PWMFreq\'", "Range", "190..210", "");
                    _fct_TiCellResult(((@sysvarFloat::VTS::M9_Ch2::PWMFreq>=190LL) && (@sysvarFloat::VTS::M9_Ch2::PWMFreq<=210LL)));
                    snprintf(_ttg_Z, elCount(_ttg_Z), "%.15g..%.15g (m9_ch2_pwmdc_low..m9_ch2_pwmdc_high)", _ttg_var_m9_ch2_pwmdc_low_3_1_2_3_3_4, _ttg_var_m9_ch2_pwmdc_high_3_1_2_3_3_3);
                    _fct_ChckRep(0, sysvarFloat::VTS::M9_Ch2::PWMDC, "System variable \'M9_Ch2::PWMDC\'", "Range", _ttg_Z, "");
                    _fct_TiCellResult(((@sysvarFloat::VTS::M9_Ch2::PWMDC>=_ttg_var_m9_ch2_pwmdc_low_3_1_2_3_3_4) && (@sysvarFloat::VTS::M9_Ch2::PWMDC<=_ttg_var_m9_ch2_pwmdc_high_3_1_2_3_3_3)));
                    _fct_ChckRep(0, sysvarFloat::VTS::M9_Ch1::PWMFreq, "System variable \'M9_Ch1::PWMFreq\'", "==", 0LL, "");
                    _fct_TiCellResult((CheckSignalMatch(sysvarFloat::VTS::M9_Ch1::PWMFreq, 0LL, "=") == 1));
                    _fct_ChckRep(0, sysvarFloat::VTS::M9_Ch1::PWMDC, "System variable \'M9_Ch1::PWMDC\'", "==", 0LL, "");
                    _fct_TiCellResult((CheckSignalMatch(sysvarFloat::VTS::M9_Ch1::PWMDC, 0LL, "=") == 1));
                    _fct_ChckRep(0, sysvarFloat::VTS::M9_Ch1::Avg, "System variable \'M9_Ch1::Avg\'", "<=", 0.2, "");
                    _fct_TiCellResult((CheckSignalMatch(sysvarFloat::VTS::M9_Ch1::Avg, 0.2, "<=") == 1));
                    _fct_TiTableEvaluation("1");
                  }
                  // _ttg_!_3_1_2_3_6_3_3
                  TestCommandEnd();
                }
              }
            }
            // _ttg_!_3_1_2_3_6_3
            _fct_TestControlStructEnd(1);
            _ttg_verdict = -1;
            TestControlStructBegin("Else If", "");
            {
              if(_fct_DoElseIf(bDone))
              {
                {
                  bCondition = (_ttg_var_color_mode_3_1_2_3_2_0==3LL);
                }
                _fct_ConditionTableHead("Else If ( color_mode==3 )", bCondition);
                _fct_ChckRep(0, _ttg_var_color_mode_3_1_2_3_2_0, "Variable \'color_mode\'", "==", 3LL, "");
                _fct_TiCellResultTrueFalse((_ttg_var_color_mode_3_1_2_3_2_0==3LL));
                _fct_TiTableEnd("", 0, 2);
                if(bCondition)
                {
                  bDone = 1;
                  TestCommandBegin("CAPL Inline", "calculate duty cycle of all channels");
                  {
                    _ttg_fct_caplinline_3_1_2_3_6_4_2();
                  }
                  // _ttg_!_3_1_2_3_6_4_2
                  TestCommandEnd();
                  TestCommandBegin("Check", "Check if it's under Day mode Mode3");
                  {
                    _fct_TiTableHeadExpected();
                    _fct_ChckRep(0, sysvarFloat::VTS::M9_Ch3::PWMFreq, "System variable \'M9_Ch3::PWMFreq\'", "==", 0LL, "");
                    _fct_TiCellResult((CheckSignalMatch(sysvarFloat::VTS::M9_Ch3::PWMFreq, 0LL, "=") == 1));
                    _fct_ChckRep(0, sysvarFloat::VTS::M9_Ch3::PWMDC, "System variable \'M9_Ch3::PWMDC\'", "==", 0LL, "");
                    _fct_TiCellResult((CheckSignalMatch(sysvarFloat::VTS::M9_Ch3::PWMDC, 0LL, "=") == 1));
                    _fct_ChckRep(0, sysvarFloat::VTS::M9_Ch3::Avg, "System variable \'M9_Ch3::Avg\'", "<=", 0.2, "");
                    _fct_TiCellResult((CheckSignalMatch(sysvarFloat::VTS::M9_Ch3::Avg, 0.2, "<=") == 1));
                    _fct_ChckRep(0, sysvarFloat::VTS::M9_Ch2::PWMFreq, "System variable \'M9_Ch2::PWMFreq\'", "Range", "190..210", "");
                    _fct_TiCellResult(((@sysvarFloat::VTS::M9_Ch2::PWMFreq>=190LL) && (@sysvarFloat::VTS::M9_Ch2::PWMFreq<=210LL)));
                    snprintf(_ttg_Z, elCount(_ttg_Z), "%.15g..%.15g (m9_ch2_pwmdc_low..m9_ch2_pwmdc_high)", _ttg_var_m9_ch2_pwmdc_low_3_1_2_3_3_4, _ttg_var_m9_ch2_pwmdc_high_3_1_2_3_3_3);
                    _fct_ChckRep(0, sysvarFloat::VTS::M9_Ch2::PWMDC, "System variable \'M9_Ch2::PWMDC\'", "Range", _ttg_Z, "");
                    _fct_TiCellResult(((@sysvarFloat::VTS::M9_Ch2::PWMDC>=_ttg_var_m9_ch2_pwmdc_low_3_1_2_3_3_4) && (@sysvarFloat::VTS::M9_Ch2::PWMDC<=_ttg_var_m9_ch2_pwmdc_high_3_1_2_3_3_3)));
                    _fct_ChckRep(0, sysvarFloat::VTS::M9_Ch1::PWMFreq, "System variable \'M9_Ch1::PWMFreq\'", "==", 0LL, "");
                    _fct_TiCellResult((CheckSignalMatch(sysvarFloat::VTS::M9_Ch1::PWMFreq, 0LL, "=") == 1));
                    _fct_ChckRep(0, sysvarFloat::VTS::M9_Ch1::PWMDC, "System variable \'M9_Ch1::PWMDC\'", "==", 100LL, "");
                    _fct_TiCellResult((CheckSignalMatch(sysvarFloat::VTS::M9_Ch1::PWMDC, 100LL, "=") == 1));
                    _fct_ChckRep(0, sysvarFloat::VTS::M9_Ch1::Avg, "System variable \'M9_Ch1::Avg\'", ">=", 11LL, "");
                    _fct_TiCellResult((CheckSignalMatch(sysvarFloat::VTS::M9_Ch1::Avg, 11LL, ">=") == 1));
                    _fct_TiTableEvaluation("1");
                  }
                  // _ttg_!_3_1_2_3_6_4_3
                  TestCommandEnd();
                }
              }
            }
            // _ttg_!_3_1_2_3_6_4
            _fct_TestControlStructEnd(1);
            _ttg_verdict = -1;
            TestControlStructBegin("Else If", "");
            {
              if(_fct_DoElseIf(bDone))
              {
                {
                  bCondition = (_ttg_var_color_mode_3_1_2_3_2_0==4LL);
                }
                _fct_ConditionTableHead("Else If ( color_mode==4 )", bCondition);
                _fct_ChckRep(0, _ttg_var_color_mode_3_1_2_3_2_0, "Variable \'color_mode\'", "==", 4LL, "");
                _fct_TiCellResultTrueFalse((_ttg_var_color_mode_3_1_2_3_2_0==4LL));
                _fct_TiTableEnd("", 0, 2);
                if(bCondition)
                {
                  bDone = 1;
                  TestCommandBegin("CAPL Inline", "calculate duty cycle of all channels");
                  {
                    _ttg_fct_caplinline_3_1_2_3_6_5_2();
                  }
                  // _ttg_!_3_1_2_3_6_5_2
                  TestCommandEnd();
                  TestCommandBegin("Check", "Check if it's under Day mode Mode4");
                  {
                    _fct_TiTableHeadExpected();
                    _fct_ChckRep(0, sysvarFloat::VTS::M9_Ch3::PWMFreq, "System variable \'M9_Ch3::PWMFreq\'", "Range", "190..210", "");
                    _fct_TiCellResult(((@sysvarFloat::VTS::M9_Ch3::PWMFreq>=190LL) && (@sysvarFloat::VTS::M9_Ch3::PWMFreq<=210LL)));
                    snprintf(_ttg_Z, elCount(_ttg_Z), "%.15g..%.15g (m9_ch3_pwmdc_low..m9_ch3_pwmdc_high)", _ttg_var_m9_ch3_pwmdc_low_3_1_2_3_3_2, _ttg_var_m9_ch3_pwmdc_high_3_1_2_3_3_1);
                    _fct_ChckRep(0, sysvarFloat::VTS::M9_Ch3::PWMDC, "System variable \'M9_Ch3::PWMDC\'", "Range", _ttg_Z, "");
                    _fct_TiCellResult(((@sysvarFloat::VTS::M9_Ch3::PWMDC>=_ttg_var_m9_ch3_pwmdc_low_3_1_2_3_3_2) && (@sysvarFloat::VTS::M9_Ch3::PWMDC<=_ttg_var_m9_ch3_pwmdc_high_3_1_2_3_3_1)));
                    _fct_ChckRep(0, sysvarFloat::VTS::M9_Ch2::PWMFreq, "System variable \'M9_Ch2::PWMFreq\'", "==", 0LL, "");
                    _fct_TiCellResult((CheckSignalMatch(sysvarFloat::VTS::M9_Ch2::PWMFreq, 0LL, "=") == 1));
                    _fct_ChckRep(0, sysvarFloat::VTS::M9_Ch2::PWMDC, "System variable \'M9_Ch2::PWMDC\'", "==", 0LL, "");
                    _fct_TiCellResult((CheckSignalMatch(sysvarFloat::VTS::M9_Ch2::PWMDC, 0LL, "=") == 1));
                    _fct_ChckRep(0, sysvarFloat::VTS::M9_Ch2::Avg, "System variable \'M9_Ch2::Avg\'", "<=", 0.2, "");
                    _fct_TiCellResult((CheckSignalMatch(sysvarFloat::VTS::M9_Ch2::Avg, 0.2, "<=") == 1));
                    _fct_ChckRep(0, sysvarFloat::VTS::M9_Ch1::PWMFreq, "System variable \'M9_Ch1::PWMFreq\'", "Range", "190..210", "");
                    _fct_TiCellResult(((@sysvarFloat::VTS::M9_Ch1::PWMFreq>=190LL) && (@sysvarFloat::VTS::M9_Ch1::PWMFreq<=210LL)));
                    snprintf(_ttg_Z, elCount(_ttg_Z), "%.15g..%.15g (m9_ch1_pwmdc_low..m9_ch1_pwmdc_high)", _ttg_var_m9_ch1_pwmdc_low_3_1_2_3_3_6, _ttg_var_m9_ch1_pwmdc_high_3_1_2_3_3_5);
                    _fct_ChckRep(0, sysvarFloat::VTS::M9_Ch1::PWMDC, "System variable \'M9_Ch1::PWMDC\'", "Range", _ttg_Z, "");
                    _fct_TiCellResult(((@sysvarFloat::VTS::M9_Ch1::PWMDC>=_ttg_var_m9_ch1_pwmdc_low_3_1_2_3_3_6) && (@sysvarFloat::VTS::M9_Ch1::PWMDC<=_ttg_var_m9_ch1_pwmdc_high_3_1_2_3_3_5)));
                    _fct_TiTableEvaluation("1");
                  }
                  // _ttg_!_3_1_2_3_6_5_3
                  TestCommandEnd();
                }
              }
            }
            // _ttg_!_3_1_2_3_6_5
            _fct_TestControlStructEnd(1);
            _ttg_verdict = -1;
            TestControlStructBegin("Else If", "");
            {
              if(_fct_DoElseIf(bDone))
              {
                {
                  bCondition = (_ttg_var_color_mode_3_1_2_3_2_0==5LL);
                }
                _fct_ConditionTableHead("Else If ( color_mode==5 )", bCondition);
                _fct_ChckRep(0, _ttg_var_color_mode_3_1_2_3_2_0, "Variable \'color_mode\'", "==", 5LL, "");
                _fct_TiCellResultTrueFalse((_ttg_var_color_mode_3_1_2_3_2_0==5LL));
                _fct_TiTableEnd("", 0, 2);
                if(bCondition)
                {
                  bDone = 1;
                  TestCommandBegin("CAPL Inline", "calculate duty cycle of all channels");
                  {
                    _ttg_fct_caplinline_3_1_2_3_6_6_2();
                  }
                  // _ttg_!_3_1_2_3_6_6_2
                  TestCommandEnd();
                  TestCommandBegin("Check", "Check if it's under Day mode Mode5");
                  {
                    _fct_TiTableHeadExpected();
                    _fct_ChckRep(0, sysvarFloat::VTS::M9_Ch3::PWMFreq, "System variable \'M9_Ch3::PWMFreq\'", "Range", "190..210", "");
                    _fct_TiCellResult(((@sysvarFloat::VTS::M9_Ch3::PWMFreq>=190LL) && (@sysvarFloat::VTS::M9_Ch3::PWMFreq<=210LL)));
                    snprintf(_ttg_Z, elCount(_ttg_Z), "%.15g..%.15g (m9_ch3_pwmdc_low..m9_ch3_pwmdc_high)", _ttg_var_m9_ch3_pwmdc_low_3_1_2_3_3_2, _ttg_var_m9_ch3_pwmdc_high_3_1_2_3_3_1);
                    _fct_ChckRep(0, sysvarFloat::VTS::M9_Ch3::PWMDC, "System variable \'M9_Ch3::PWMDC\'", "Range", _ttg_Z, "");
                    _fct_TiCellResult(((@sysvarFloat::VTS::M9_Ch3::PWMDC>=_ttg_var_m9_ch3_pwmdc_low_3_1_2_3_3_2) && (@sysvarFloat::VTS::M9_Ch3::PWMDC<=_ttg_var_m9_ch3_pwmdc_high_3_1_2_3_3_1)));
                    _fct_ChckRep(0, sysvarFloat::VTS::M9_Ch2::PWMFreq, "System variable \'M9_Ch2::PWMFreq\'", "Range", "190..210", "");
                    _fct_TiCellResult(((@sysvarFloat::VTS::M9_Ch2::PWMFreq>=190LL) && (@sysvarFloat::VTS::M9_Ch2::PWMFreq<=210LL)));
                    snprintf(_ttg_Z, elCount(_ttg_Z), "%.15g..%.15g (m9_ch2_pwmdc_low..m9_ch2_pwmdc_high)", _ttg_var_m9_ch2_pwmdc_low_3_1_2_3_3_4, _ttg_var_m9_ch2_pwmdc_high_3_1_2_3_3_3);
                    _fct_ChckRep(0, sysvarFloat::VTS::M9_Ch2::PWMDC, "System variable \'M9_Ch2::PWMDC\'", "Range", _ttg_Z, "");
                    _fct_TiCellResult(((@sysvarFloat::VTS::M9_Ch2::PWMDC>=_ttg_var_m9_ch2_pwmdc_low_3_1_2_3_3_4) && (@sysvarFloat::VTS::M9_Ch2::PWMDC<=_ttg_var_m9_ch2_pwmdc_high_3_1_2_3_3_3)));
                    _fct_ChckRep(0, sysvarFloat::VTS::M9_Ch1::PWMFreq, "System variable \'M9_Ch1::PWMFreq\'", "==", 0LL, "");
                    _fct_TiCellResult((CheckSignalMatch(sysvarFloat::VTS::M9_Ch1::PWMFreq, 0LL, "=") == 1));
                    _fct_ChckRep(0, sysvarFloat::VTS::M9_Ch1::PWMDC, "System variable \'M9_Ch1::PWMDC\'", "==", 0LL, "");
                    _fct_TiCellResult((CheckSignalMatch(sysvarFloat::VTS::M9_Ch1::PWMDC, 0LL, "=") == 1));
                    _fct_ChckRep(0, sysvarFloat::VTS::M9_Ch1::Avg, "System variable \'M9_Ch1::Avg\'", "<=", 0.2, "");
                    _fct_TiCellResult((CheckSignalMatch(sysvarFloat::VTS::M9_Ch1::Avg, 0.2, "<=") == 1));
                    _fct_TiTableEvaluation("1");
                  }
                  // _ttg_!_3_1_2_3_6_6_3
                  TestCommandEnd();
                }
              }
            }
            // _ttg_!_3_1_2_3_6_6
            _fct_TestControlStructEnd(1);
            _ttg_verdict = -1;
            TestControlStructBegin("Else If", "");
            {
              if(_fct_DoElseIf(bDone))
              {
                {
                  bCondition = (_ttg_var_color_mode_3_1_2_3_2_0==6LL);
                }
                _fct_ConditionTableHead("Else If ( color_mode==6 )", bCondition);
                _fct_ChckRep(0, _ttg_var_color_mode_3_1_2_3_2_0, "Variable \'color_mode\'", "==", 6LL, "");
                _fct_TiCellResultTrueFalse((_ttg_var_color_mode_3_1_2_3_2_0==6LL));
                _fct_TiTableEnd("", 0, 2);
                if(bCondition)
                {
                  bDone = 1;
                  TestCommandBegin("CAPL Inline", "calculate duty cycle of all channels");
                  {
                    _ttg_fct_caplinline_3_1_2_3_6_7_2();
                  }
                  // _ttg_!_3_1_2_3_6_7_2
                  TestCommandEnd();
                  TestCommandBegin("Check", "Check if it's under Day mode Mode6");
                  {
                    _fct_TiTableHeadExpected();
                    _fct_ChckRep(0, sysvarFloat::VTS::M9_Ch3::PWMFreq, "System variable \'M9_Ch3::PWMFreq\'", "==", 0LL, "");
                    _fct_TiCellResult((CheckSignalMatch(sysvarFloat::VTS::M9_Ch3::PWMFreq, 0LL, "=") == 1));
                    _fct_ChckRep(0, sysvarFloat::VTS::M9_Ch3::PWMDC, "System variable \'M9_Ch3::PWMDC\'", "==", 0LL, "");
                    _fct_TiCellResult((CheckSignalMatch(sysvarFloat::VTS::M9_Ch3::PWMDC, 0LL, "=") == 1));
                    _fct_ChckRep(0, sysvarFloat::VTS::M9_Ch3::Avg, "System variable \'M9_Ch3::Avg\'", "<=", 0.2, "");
                    _fct_TiCellResult((CheckSignalMatch(sysvarFloat::VTS::M9_Ch3::Avg, 0.2, "<=") == 1));
                    _fct_ChckRep(0, sysvarFloat::VTS::M9_Ch2::PWMFreq, "System variable \'M9_Ch2::PWMFreq\'", "Range", "190..210", "");
                    _fct_TiCellResult(((@sysvarFloat::VTS::M9_Ch2::PWMFreq>=190LL) && (@sysvarFloat::VTS::M9_Ch2::PWMFreq<=210LL)));
                    snprintf(_ttg_Z, elCount(_ttg_Z), "%.15g..%.15g (m9_ch2_pwmdc_low..m9_ch2_pwmdc_high)", _ttg_var_m9_ch2_pwmdc_low_3_1_2_3_3_4, _ttg_var_m9_ch2_pwmdc_high_3_1_2_3_3_3);
                    _fct_ChckRep(0, sysvarFloat::VTS::M9_Ch2::PWMDC, "System variable \'M9_Ch2::PWMDC\'", "Range", _ttg_Z, "");
                    _fct_TiCellResult(((@sysvarFloat::VTS::M9_Ch2::PWMDC>=_ttg_var_m9_ch2_pwmdc_low_3_1_2_3_3_4) && (@sysvarFloat::VTS::M9_Ch2::PWMDC<=_ttg_var_m9_ch2_pwmdc_high_3_1_2_3_3_3)));
                    _fct_ChckRep(0, sysvarFloat::VTS::M9_Ch1::PWMFreq, "System variable \'M9_Ch1::PWMFreq\'", "Range", "190..210", "");
                    _fct_TiCellResult(((@sysvarFloat::VTS::M9_Ch1::PWMFreq>=190LL) && (@sysvarFloat::VTS::M9_Ch1::PWMFreq<=210LL)));
                    snprintf(_ttg_Z, elCount(_ttg_Z), "%.15g..%.15g (m9_ch1_pwmdc_low..m9_ch1_pwmdc_high)", _ttg_var_m9_ch1_pwmdc_low_3_1_2_3_3_6, _ttg_var_m9_ch1_pwmdc_high_3_1_2_3_3_5);
                    _fct_ChckRep(0, sysvarFloat::VTS::M9_Ch1::PWMDC, "System variable \'M9_Ch1::PWMDC\'", "Range", _ttg_Z, "");
                    _fct_TiCellResult(((@sysvarFloat::VTS::M9_Ch1::PWMDC>=_ttg_var_m9_ch1_pwmdc_low_3_1_2_3_3_6) && (@sysvarFloat::VTS::M9_Ch1::PWMDC<=_ttg_var_m9_ch1_pwmdc_high_3_1_2_3_3_5)));
                    _fct_TiTableEvaluation("1");
                  }
                  // _ttg_!_3_1_2_3_6_7_3
                  TestCommandEnd();
                }
              }
            }
          }
          // _ttg_!_3_1_2_3_6_7
          _fct_TestControlStructEnd(1);
        }
      }
    }
    // _ttg_!_3_1_2_3_6
    _fct_TestControlStructEnd(1);
    _ttg_verdict = -1;
    TestControlStructBegin("Else", "");
    {
      if(_fct_DoElse(bDone))
      {
        bDone = 1;
        TestCommandBegin("Check", "Check if it's switched off");
        {
          _fct_TiTableHeadExpected();
          _fct_ChckRep(0, sysvarFloat::VTS::M9_Ch3::PWMFreq, "System variable \'M9_Ch3::PWMFreq\'", "==", 0LL, "");
          _fct_TiCellResult((CheckSignalMatch(sysvarFloat::VTS::M9_Ch3::PWMFreq, 0LL, "=") == 1));
          _fct_ChckRep(0, sysvarFloat::VTS::M9_Ch3::PWMDC, "System variable \'M9_Ch3::PWMDC\'", "==", 0LL, "");
          _fct_TiCellResult((CheckSignalMatch(sysvarFloat::VTS::M9_Ch3::PWMDC, 0LL, "=") == 1));
          _fct_ChckRep(0, sysvarFloat::VTS::M9_Ch3::Avg, "System variable \'M9_Ch3::Avg\'", "<=", 0.2, "");
          _fct_TiCellResult((CheckSignalMatch(sysvarFloat::VTS::M9_Ch3::Avg, 0.2, "<=") == 1));
          _fct_ChckRep(0, sysvarFloat::VTS::M9_Ch2::PWMFreq, "System variable \'M9_Ch2::PWMFreq\'", "==", 0LL, "");
          _fct_TiCellResult((CheckSignalMatch(sysvarFloat::VTS::M9_Ch2::PWMFreq, 0LL, "=") == 1));
          _fct_ChckRep(0, sysvarFloat::VTS::M9_Ch2::PWMDC, "System variable \'M9_Ch2::PWMDC\'", "==", 0LL, "");
          _fct_TiCellResult((CheckSignalMatch(sysvarFloat::VTS::M9_Ch2::PWMDC, 0LL, "=") == 1));
          _fct_ChckRep(0, sysvarFloat::VTS::M9_Ch2::Avg, "System variable \'M9_Ch2::Avg\'", "<=", 0.2, "");
          _fct_TiCellResult((CheckSignalMatch(sysvarFloat::VTS::M9_Ch2::Avg, 0.2, "<=") == 1));
          _fct_ChckRep(0, sysvarFloat::VTS::M9_Ch1::PWMFreq, "System variable \'M9_Ch1::PWMFreq\'", "==", 0LL, "");
          _fct_TiCellResult((CheckSignalMatch(sysvarFloat::VTS::M9_Ch1::PWMFreq, 0LL, "=") == 1));
          _fct_ChckRep(0, sysvarFloat::VTS::M9_Ch1::PWMDC, "System variable \'M9_Ch1::PWMDC\'", "==", 0LL, "");
          _fct_TiCellResult((CheckSignalMatch(sysvarFloat::VTS::M9_Ch1::PWMDC, 0LL, "=") == 1));
          _fct_ChckRep(0, sysvarFloat::VTS::M9_Ch1::Avg, "System variable \'M9_Ch1::Avg\'", "<=", 0.2, "");
          _fct_TiCellResult((CheckSignalMatch(sysvarFloat::VTS::M9_Ch1::Avg, 0.2, "<=") == 1));
          _fct_TiTableEvaluation("1");
        }
        // _ttg_!_3_1_2_3_7_1
        TestCommandEnd();
      }
    }
  }
  // _ttg_!_3_1_2_3_7
  _fct_TestControlStructEnd(1);
}
// _ttg_#_3_1_2_3
export void check_color_mode_when_ALCMLightLvlSet_inactived(int64 _ttg_var_color_mode_3_1_2_4_2_0)
{
  {
    // Variables
    _ttg_var_m9_ch3_pwmdc_high_3_1_2_4_3_0 = 0LL;
    snprintf(_ttg_B, 2000, "%I64d", 0LL);
    TestReportVariableDefinition("m9_ch3_pwmdc_high", "float", _ttg_B);
    _ttg_var_m9_ch3_pwmdc_low_3_1_2_4_3_1 = 0LL;
    snprintf(_ttg_B, 2000, "%I64d", 0LL);
    TestReportVariableDefinition("m9_ch3_pwmdc_low", "float", _ttg_B);
    _ttg_var_m9_ch2_pwmdc_high_3_1_2_4_3_2 = 0LL;
    snprintf(_ttg_B, 2000, "%I64d", 0LL);
    TestReportVariableDefinition("m9_ch2_pwmdc_high", "float", _ttg_B);
    _ttg_var_m9_ch2_pwmdc_low_3_1_2_4_3_3 = 0LL;
    snprintf(_ttg_B, 2000, "%I64d", 0LL);
    TestReportVariableDefinition("m9_ch2_pwmdc_low", "float", _ttg_B);
    _ttg_var_m9_ch1_pwmdc_high_3_1_2_4_3_4 = 0LL;
    snprintf(_ttg_B, 2000, "%I64d", 0LL);
    TestReportVariableDefinition("m9_ch1_pwmdc_high", "float", _ttg_B);
    _ttg_var_m9_ch1_pwmdc_low_3_1_2_4_3_5 = 0LL;
    snprintf(_ttg_B, 2000, "%I64d", 0LL);
    TestReportVariableDefinition("m9_ch1_pwmdc_low", "float", _ttg_B);
  }
  _ttg_verdict = -1;
  TestControlStructBegin("If", "");
  {
    int bCondition, bDone;
    bDone = 0;
    {
      {
        bCondition = (_ttg_var_color_mode_3_1_2_4_2_0==1LL);
      }
      _fct_ConditionTableHead("If ( color_mode==1 )", bCondition);
      _fct_ChckRep(0, _ttg_var_color_mode_3_1_2_4_2_0, "Variable \'color_mode\'", "==", 1LL, "");
      _fct_TiCellResultTrueFalse((_ttg_var_color_mode_3_1_2_4_2_0==1LL));
      _fct_TiTableEnd("", 0, 2);
      if(bCondition)
      {
        bDone = 1;
        TestCommandBegin("CAPL Inline", "calculate duty cycle of all channels");
        {
          _ttg_fct_caplinline_3_1_2_4_4_2();
        }
        // _ttg_!_3_1_2_4_4_2
        TestCommandEnd();
        TestCommandBegin("Check", "Check if it's under Day mode Mode1");
        {
          _fct_TiTableHeadExpected();
          _fct_ChckRep(0, sysvarFloat::VTS::M9_Ch3::PWMFreq, "System variable \'M9_Ch3::PWMFreq\'", "Range", "190..210", "");
          _fct_TiCellResult(((@sysvarFloat::VTS::M9_Ch3::PWMFreq>=190LL) && (@sysvarFloat::VTS::M9_Ch3::PWMFreq<=210LL)));
          snprintf(_ttg_Z, elCount(_ttg_Z), "%.15g..%.15g (m9_ch3_pwmdc_low..m9_ch3_pwmdc_high)", _ttg_var_m9_ch3_pwmdc_low_3_1_2_4_3_1, _ttg_var_m9_ch3_pwmdc_high_3_1_2_4_3_0);
          _fct_ChckRep(0, sysvarFloat::VTS::M9_Ch3::PWMDC, "System variable \'M9_Ch3::PWMDC\'", "Range", _ttg_Z, "");
          _fct_TiCellResult(((@sysvarFloat::VTS::M9_Ch3::PWMDC>=_ttg_var_m9_ch3_pwmdc_low_3_1_2_4_3_1) && (@sysvarFloat::VTS::M9_Ch3::PWMDC<=_ttg_var_m9_ch3_pwmdc_high_3_1_2_4_3_0)));
          _fct_ChckRep(0, sysvarFloat::VTS::M9_Ch2::PWMFreq, "System variable \'M9_Ch2::PWMFreq\'", "==", 0LL, "");
          _fct_TiCellResult((CheckSignalMatch(sysvarFloat::VTS::M9_Ch2::PWMFreq, 0LL, "=") == 1));
          _fct_ChckRep(0, sysvarFloat::VTS::M9_Ch2::PWMDC, "System variable \'M9_Ch2::PWMDC\'", "==", 0LL, "");
          _fct_TiCellResult((CheckSignalMatch(sysvarFloat::VTS::M9_Ch2::PWMDC, 0LL, "=") == 1));
          _fct_ChckRep(0, sysvarFloat::VTS::M9_Ch2::Avg, "System variable \'M9_Ch2::Avg\'", "<=", 0.2, "");
          _fct_TiCellResult((CheckSignalMatch(sysvarFloat::VTS::M9_Ch2::Avg, 0.2, "<=") == 1));
          _fct_ChckRep(0, sysvarFloat::VTS::M9_Ch1::PWMFreq, "System variable \'M9_Ch1::PWMFreq\'", "==", 0LL, "");
          _fct_TiCellResult((CheckSignalMatch(sysvarFloat::VTS::M9_Ch1::PWMFreq, 0LL, "=") == 1));
          _fct_ChckRep(0, sysvarFloat::VTS::M9_Ch1::PWMDC, "System variable \'M9_Ch1::PWMDC\'", "==", 100LL, "");
          _fct_TiCellResult((CheckSignalMatch(sysvarFloat::VTS::M9_Ch1::PWMDC, 100LL, "=") == 1));
          _fct_ChckRep(0, sysvarFloat::VTS::M9_Ch1::Avg, "System variable \'M9_Ch1::Avg\'", ">=", 11LL, "");
          _fct_TiCellResult((CheckSignalMatch(sysvarFloat::VTS::M9_Ch1::Avg, 11LL, ">=") == 1));
          _fct_TiTableEvaluation("1");
        }
        // _ttg_!_3_1_2_4_4_3
        TestCommandEnd();
      }
    }
    // _ttg_!_3_1_2_4_4
    _fct_TestControlStructEnd(1);
    _ttg_verdict = -1;
    TestControlStructBegin("Else If", "");
    {
      if(_fct_DoElseIf(bDone))
      {
        {
          bCondition = (_ttg_var_color_mode_3_1_2_4_2_0==2LL);
        }
        _fct_ConditionTableHead("Else If ( color_mode==2 )", bCondition);
        _fct_ChckRep(0, _ttg_var_color_mode_3_1_2_4_2_0, "Variable \'color_mode\'", "==", 2LL, "");
        _fct_TiCellResultTrueFalse((_ttg_var_color_mode_3_1_2_4_2_0==2LL));
        _fct_TiTableEnd("", 0, 2);
        if(bCondition)
        {
          bDone = 1;
          TestCommandBegin("CAPL Inline", "calculate duty cycle of all channels");
          {
            _ttg_fct_caplinline_3_1_2_4_5_2();
          }
          // _ttg_!_3_1_2_4_5_2
          TestCommandEnd();
          TestCommandBegin("Check", "Check if it's under Day mode Mode2");
          {
            _fct_TiTableHeadExpected();
            _fct_ChckRep(0, sysvarFloat::VTS::M9_Ch3::PWMFreq, "System variable \'M9_Ch3::PWMFreq\'", "Range", "190..210", "");
            _fct_TiCellResult(((@sysvarFloat::VTS::M9_Ch3::PWMFreq>=190LL) && (@sysvarFloat::VTS::M9_Ch3::PWMFreq<=210LL)));
            snprintf(_ttg_Z, elCount(_ttg_Z), "%.15g..%.15g (m9_ch3_pwmdc_low..m9_ch3_pwmdc_high)", _ttg_var_m9_ch3_pwmdc_low_3_1_2_4_3_1, _ttg_var_m9_ch3_pwmdc_high_3_1_2_4_3_0);
            _fct_ChckRep(0, sysvarFloat::VTS::M9_Ch3::PWMDC, "System variable \'M9_Ch3::PWMDC\'", "Range", _ttg_Z, "");
            _fct_TiCellResult(((@sysvarFloat::VTS::M9_Ch3::PWMDC>=_ttg_var_m9_ch3_pwmdc_low_3_1_2_4_3_1) && (@sysvarFloat::VTS::M9_Ch3::PWMDC<=_ttg_var_m9_ch3_pwmdc_high_3_1_2_4_3_0)));
            _fct_ChckRep(0, sysvarFloat::VTS::M9_Ch2::PWMFreq, "System variable \'M9_Ch2::PWMFreq\'", "Range", "190..210", "");
            _fct_TiCellResult(((@sysvarFloat::VTS::M9_Ch2::PWMFreq>=190LL) && (@sysvarFloat::VTS::M9_Ch2::PWMFreq<=210LL)));
            snprintf(_ttg_Z, elCount(_ttg_Z), "%.15g..%.15g (m9_ch2_pwmdc_low..m9_ch2_pwmdc_high)", _ttg_var_m9_ch2_pwmdc_low_3_1_2_4_3_3, _ttg_var_m9_ch2_pwmdc_high_3_1_2_4_3_2);
            _fct_ChckRep(0, sysvarFloat::VTS::M9_Ch2::PWMDC, "System variable \'M9_Ch2::PWMDC\'", "Range", _ttg_Z, "");
            _fct_TiCellResult(((@sysvarFloat::VTS::M9_Ch2::PWMDC>=_ttg_var_m9_ch2_pwmdc_low_3_1_2_4_3_3) && (@sysvarFloat::VTS::M9_Ch2::PWMDC<=_ttg_var_m9_ch2_pwmdc_high_3_1_2_4_3_2)));
            _fct_ChckRep(0, sysvarFloat::VTS::M9_Ch1::PWMFreq, "System variable \'M9_Ch1::PWMFreq\'", "==", 0LL, "");
            _fct_TiCellResult((CheckSignalMatch(sysvarFloat::VTS::M9_Ch1::PWMFreq, 0LL, "=") == 1));
            _fct_ChckRep(0, sysvarFloat::VTS::M9_Ch1::PWMDC, "System variable \'M9_Ch1::PWMDC\'", "==", 0LL, "");
            _fct_TiCellResult((CheckSignalMatch(sysvarFloat::VTS::M9_Ch1::PWMDC, 0LL, "=") == 1));
            _fct_ChckRep(0, sysvarFloat::VTS::M9_Ch1::Avg, "System variable \'M9_Ch1::Avg\'", "<=", 0.2, "");
            _fct_TiCellResult((CheckSignalMatch(sysvarFloat::VTS::M9_Ch1::Avg, 0.2, "<=") == 1));
            _fct_TiTableEvaluation("1");
          }
          // _ttg_!_3_1_2_4_5_3
          TestCommandEnd();
        }
      }
    }
    // _ttg_!_3_1_2_4_5
    _fct_TestControlStructEnd(1);
    _ttg_verdict = -1;
    TestControlStructBegin("Else If", "");
    {
      if(_fct_DoElseIf(bDone))
      {
        {
          bCondition = (_ttg_var_color_mode_3_1_2_4_2_0==3LL);
        }
        _fct_ConditionTableHead("Else If ( color_mode==3 )", bCondition);
        _fct_ChckRep(0, _ttg_var_color_mode_3_1_2_4_2_0, "Variable \'color_mode\'", "==", 3LL, "");
        _fct_TiCellResultTrueFalse((_ttg_var_color_mode_3_1_2_4_2_0==3LL));
        _fct_TiTableEnd("", 0, 2);
        if(bCondition)
        {
          bDone = 1;
          TestCommandBegin("CAPL Inline", "calculate duty cycle of all channels");
          {
            _ttg_fct_caplinline_3_1_2_4_6_2();
          }
          // _ttg_!_3_1_2_4_6_2
          TestCommandEnd();
          TestCommandBegin("Check", "Check if it's under Day mode Mode3");
          {
            _fct_TiTableHeadExpected();
            _fct_ChckRep(0, sysvarFloat::VTS::M9_Ch3::PWMFreq, "System variable \'M9_Ch3::PWMFreq\'", "==", 0LL, "");
            _fct_TiCellResult((CheckSignalMatch(sysvarFloat::VTS::M9_Ch3::PWMFreq, 0LL, "=") == 1));
            _fct_ChckRep(0, sysvarFloat::VTS::M9_Ch3::PWMDC, "System variable \'M9_Ch3::PWMDC\'", "==", 0LL, "");
            _fct_TiCellResult((CheckSignalMatch(sysvarFloat::VTS::M9_Ch3::PWMDC, 0LL, "=") == 1));
            _fct_ChckRep(0, sysvarFloat::VTS::M9_Ch3::Avg, "System variable \'M9_Ch3::Avg\'", "<=", 0.2, "");
            _fct_TiCellResult((CheckSignalMatch(sysvarFloat::VTS::M9_Ch3::Avg, 0.2, "<=") == 1));
            _fct_ChckRep(0, sysvarFloat::VTS::M9_Ch2::PWMFreq, "System variable \'M9_Ch2::PWMFreq\'", "Range", "190..210", "");
            _fct_TiCellResult(((@sysvarFloat::VTS::M9_Ch2::PWMFreq>=190LL) && (@sysvarFloat::VTS::M9_Ch2::PWMFreq<=210LL)));
            snprintf(_ttg_Z, elCount(_ttg_Z), "%.15g..%.15g (m9_ch2_pwmdc_low..m9_ch2_pwmdc_high)", _ttg_var_m9_ch2_pwmdc_low_3_1_2_4_3_3, _ttg_var_m9_ch2_pwmdc_high_3_1_2_4_3_2);
            _fct_ChckRep(0, sysvarFloat::VTS::M9_Ch2::PWMDC, "System variable \'M9_Ch2::PWMDC\'", "Range", _ttg_Z, "");
            _fct_TiCellResult(((@sysvarFloat::VTS::M9_Ch2::PWMDC>=_ttg_var_m9_ch2_pwmdc_low_3_1_2_4_3_3) && (@sysvarFloat::VTS::M9_Ch2::PWMDC<=_ttg_var_m9_ch2_pwmdc_high_3_1_2_4_3_2)));
            _fct_ChckRep(0, sysvarFloat::VTS::M9_Ch1::PWMFreq, "System variable \'M9_Ch1::PWMFreq\'", "==", 0LL, "");
            _fct_TiCellResult((CheckSignalMatch(sysvarFloat::VTS::M9_Ch1::PWMFreq, 0LL, "=") == 1));
            _fct_ChckRep(0, sysvarFloat::VTS::M9_Ch1::PWMDC, "System variable \'M9_Ch1::PWMDC\'", "==", 100LL, "");
            _fct_TiCellResult((CheckSignalMatch(sysvarFloat::VTS::M9_Ch1::PWMDC, 100LL, "=") == 1));
            _fct_ChckRep(0, sysvarFloat::VTS::M9_Ch1::Avg, "System variable \'M9_Ch1::Avg\'", ">=", 11LL, "");
            _fct_TiCellResult((CheckSignalMatch(sysvarFloat::VTS::M9_Ch1::Avg, 11LL, ">=") == 1));
            _fct_TiTableEvaluation("1");
          }
          // _ttg_!_3_1_2_4_6_3
          TestCommandEnd();
        }
      }
    }
    // _ttg_!_3_1_2_4_6
    _fct_TestControlStructEnd(1);
    _ttg_verdict = -1;
    TestControlStructBegin("Else If", "");
    {
      if(_fct_DoElseIf(bDone))
      {
        {
          bCondition = (_ttg_var_color_mode_3_1_2_4_2_0==4LL);
        }
        _fct_ConditionTableHead("Else If ( color_mode==4 )", bCondition);
        _fct_ChckRep(0, _ttg_var_color_mode_3_1_2_4_2_0, "Variable \'color_mode\'", "==", 4LL, "");
        _fct_TiCellResultTrueFalse((_ttg_var_color_mode_3_1_2_4_2_0==4LL));
        _fct_TiTableEnd("", 0, 2);
        if(bCondition)
        {
          bDone = 1;
          TestCommandBegin("CAPL Inline", "calculate duty cycle of all channels");
          {
            _ttg_fct_caplinline_3_1_2_4_7_2();
          }
          // _ttg_!_3_1_2_4_7_2
          TestCommandEnd();
          TestCommandBegin("Check", "Check if it's under Day mode Mode4");
          {
            _fct_TiTableHeadExpected();
            _fct_ChckRep(0, sysvarFloat::VTS::M9_Ch3::PWMFreq, "System variable \'M9_Ch3::PWMFreq\'", "Range", "190..210", "");
            _fct_TiCellResult(((@sysvarFloat::VTS::M9_Ch3::PWMFreq>=190LL) && (@sysvarFloat::VTS::M9_Ch3::PWMFreq<=210LL)));
            snprintf(_ttg_Z, elCount(_ttg_Z), "%.15g..%.15g (m9_ch3_pwmdc_low..m9_ch3_pwmdc_high)", _ttg_var_m9_ch3_pwmdc_low_3_1_2_4_3_1, _ttg_var_m9_ch3_pwmdc_high_3_1_2_4_3_0);
            _fct_ChckRep(0, sysvarFloat::VTS::M9_Ch3::PWMDC, "System variable \'M9_Ch3::PWMDC\'", "Range", _ttg_Z, "");
            _fct_TiCellResult(((@sysvarFloat::VTS::M9_Ch3::PWMDC>=_ttg_var_m9_ch3_pwmdc_low_3_1_2_4_3_1) && (@sysvarFloat::VTS::M9_Ch3::PWMDC<=_ttg_var_m9_ch3_pwmdc_high_3_1_2_4_3_0)));
            _fct_ChckRep(0, sysvarFloat::VTS::M9_Ch2::PWMFreq, "System variable \'M9_Ch2::PWMFreq\'", "==", 0LL, "");
            _fct_TiCellResult((CheckSignalMatch(sysvarFloat::VTS::M9_Ch2::PWMFreq, 0LL, "=") == 1));
            _fct_ChckRep(0, sysvarFloat::VTS::M9_Ch2::PWMDC, "System variable \'M9_Ch2::PWMDC\'", "==", 0LL, "");
            _fct_TiCellResult((CheckSignalMatch(sysvarFloat::VTS::M9_Ch2::PWMDC, 0LL, "=") == 1));
            _fct_ChckRep(0, sysvarFloat::VTS::M9_Ch2::Avg, "System variable \'M9_Ch2::Avg\'", "<=", 0.2, "");
            _fct_TiCellResult((CheckSignalMatch(sysvarFloat::VTS::M9_Ch2::Avg, 0.2, "<=") == 1));
            _fct_ChckRep(0, sysvarFloat::VTS::M9_Ch1::PWMFreq, "System variable \'M9_Ch1::PWMFreq\'", "Range", "190..210", "");
            _fct_TiCellResult(((@sysvarFloat::VTS::M9_Ch1::PWMFreq>=190LL) && (@sysvarFloat::VTS::M9_Ch1::PWMFreq<=210LL)));
            snprintf(_ttg_Z, elCount(_ttg_Z), "%.15g..%.15g (m9_ch1_pwmdc_low..m9_ch1_pwmdc_high)", _ttg_var_m9_ch1_pwmdc_low_3_1_2_4_3_5, _ttg_var_m9_ch1_pwmdc_high_3_1_2_4_3_4);
            _fct_ChckRep(0, sysvarFloat::VTS::M9_Ch1::PWMDC, "System variable \'M9_Ch1::PWMDC\'", "Range", _ttg_Z, "");
            _fct_TiCellResult(((@sysvarFloat::VTS::M9_Ch1::PWMDC>=_ttg_var_m9_ch1_pwmdc_low_3_1_2_4_3_5) && (@sysvarFloat::VTS::M9_Ch1::PWMDC<=_ttg_var_m9_ch1_pwmdc_high_3_1_2_4_3_4)));
            _fct_TiTableEvaluation("1");
          }
          // _ttg_!_3_1_2_4_7_3
          TestCommandEnd();
        }
      }
    }
    // _ttg_!_3_1_2_4_7
    _fct_TestControlStructEnd(1);
    _ttg_verdict = -1;
    TestControlStructBegin("Else If", "");
    {
      if(_fct_DoElseIf(bDone))
      {
        {
          bCondition = (_ttg_var_color_mode_3_1_2_4_2_0==5LL);
        }
        _fct_ConditionTableHead("Else If ( color_mode==5 )", bCondition);
        _fct_ChckRep(0, _ttg_var_color_mode_3_1_2_4_2_0, "Variable \'color_mode\'", "==", 5LL, "");
        _fct_TiCellResultTrueFalse((_ttg_var_color_mode_3_1_2_4_2_0==5LL));
        _fct_TiTableEnd("", 0, 2);
        if(bCondition)
        {
          bDone = 1;
          TestCommandBegin("CAPL Inline", "calculate duty cycle of all channels");
          {
            _ttg_fct_caplinline_3_1_2_4_8_2();
          }
          // _ttg_!_3_1_2_4_8_2
          TestCommandEnd();
          TestCommandBegin("Check", "Check if it's under Day mode Mode5");
          {
            _fct_TiTableHeadExpected();
            _fct_ChckRep(0, sysvarFloat::VTS::M9_Ch3::PWMFreq, "System variable \'M9_Ch3::PWMFreq\'", "Range", "190..210", "");
            _fct_TiCellResult(((@sysvarFloat::VTS::M9_Ch3::PWMFreq>=190LL) && (@sysvarFloat::VTS::M9_Ch3::PWMFreq<=210LL)));
            snprintf(_ttg_Z, elCount(_ttg_Z), "%.15g..%.15g (m9_ch3_pwmdc_low..m9_ch3_pwmdc_high)", _ttg_var_m9_ch3_pwmdc_low_3_1_2_4_3_1, _ttg_var_m9_ch3_pwmdc_high_3_1_2_4_3_0);
            _fct_ChckRep(0, sysvarFloat::VTS::M9_Ch3::PWMDC, "System variable \'M9_Ch3::PWMDC\'", "Range", _ttg_Z, "");
            _fct_TiCellResult(((@sysvarFloat::VTS::M9_Ch3::PWMDC>=_ttg_var_m9_ch3_pwmdc_low_3_1_2_4_3_1) && (@sysvarFloat::VTS::M9_Ch3::PWMDC<=_ttg_var_m9_ch3_pwmdc_high_3_1_2_4_3_0)));
            _fct_ChckRep(0, sysvarFloat::VTS::M9_Ch2::PWMFreq, "System variable \'M9_Ch2::PWMFreq\'", "Range", "190..210", "");
            _fct_TiCellResult(((@sysvarFloat::VTS::M9_Ch2::PWMFreq>=190LL) && (@sysvarFloat::VTS::M9_Ch2::PWMFreq<=210LL)));
            snprintf(_ttg_Z, elCount(_ttg_Z), "%.15g..%.15g (m9_ch2_pwmdc_low..m9_ch2_pwmdc_high)", _ttg_var_m9_ch2_pwmdc_low_3_1_2_4_3_3, _ttg_var_m9_ch2_pwmdc_high_3_1_2_4_3_2);
            _fct_ChckRep(0, sysvarFloat::VTS::M9_Ch2::PWMDC, "System variable \'M9_Ch2::PWMDC\'", "Range", _ttg_Z, "");
            _fct_TiCellResult(((@sysvarFloat::VTS::M9_Ch2::PWMDC>=_ttg_var_m9_ch2_pwmdc_low_3_1_2_4_3_3) && (@sysvarFloat::VTS::M9_Ch2::PWMDC<=_ttg_var_m9_ch2_pwmdc_high_3_1_2_4_3_2)));
            _fct_ChckRep(0, sysvarFloat::VTS::M9_Ch1::PWMFreq, "System variable \'M9_Ch1::PWMFreq\'", "==", 0LL, "");
            _fct_TiCellResult((CheckSignalMatch(sysvarFloat::VTS::M9_Ch1::PWMFreq, 0LL, "=") == 1));
            _fct_ChckRep(0, sysvarFloat::VTS::M9_Ch1::PWMDC, "System variable \'M9_Ch1::PWMDC\'", "==", 0LL, "");
            _fct_TiCellResult((CheckSignalMatch(sysvarFloat::VTS::M9_Ch1::PWMDC, 0LL, "=") == 1));
            _fct_ChckRep(0, sysvarFloat::VTS::M9_Ch1::Avg, "System variable \'M9_Ch1::Avg\'", "<=", 0.2, "");
            _fct_TiCellResult((CheckSignalMatch(sysvarFloat::VTS::M9_Ch1::Avg, 0.2, "<=") == 1));
            _fct_TiTableEvaluation("1");
          }
          // _ttg_!_3_1_2_4_8_3
          TestCommandEnd();
        }
      }
    }
    // _ttg_!_3_1_2_4_8
    _fct_TestControlStructEnd(1);
    _ttg_verdict = -1;
    TestControlStructBegin("Else If", "");
    {
      if(_fct_DoElseIf(bDone))
      {
        {
          bCondition = (_ttg_var_color_mode_3_1_2_4_2_0==6LL);
        }
        _fct_ConditionTableHead("Else If ( color_mode==6 )", bCondition);
        _fct_ChckRep(0, _ttg_var_color_mode_3_1_2_4_2_0, "Variable \'color_mode\'", "==", 6LL, "");
        _fct_TiCellResultTrueFalse((_ttg_var_color_mode_3_1_2_4_2_0==6LL));
        _fct_TiTableEnd("", 0, 2);
        if(bCondition)
        {
          bDone = 1;
          TestCommandBegin("CAPL Inline", "calculate duty cycle of all channels");
          {
            _ttg_fct_caplinline_3_1_2_4_9_2();
          }
          // _ttg_!_3_1_2_4_9_2
          TestCommandEnd();
          TestCommandBegin("Check", "Check if it's under Day mode Mode6");
          {
            _fct_TiTableHeadExpected();
            _fct_ChckRep(0, sysvarFloat::VTS::M9_Ch3::PWMFreq, "System variable \'M9_Ch3::PWMFreq\'", "==", 0LL, "");
            _fct_TiCellResult((CheckSignalMatch(sysvarFloat::VTS::M9_Ch3::PWMFreq, 0LL, "=") == 1));
            _fct_ChckRep(0, sysvarFloat::VTS::M9_Ch3::PWMDC, "System variable \'M9_Ch3::PWMDC\'", "==", 0LL, "");
            _fct_TiCellResult((CheckSignalMatch(sysvarFloat::VTS::M9_Ch3::PWMDC, 0LL, "=") == 1));
            _fct_ChckRep(0, sysvarFloat::VTS::M9_Ch3::Avg, "System variable \'M9_Ch3::Avg\'", "<=", 0.2, "");
            _fct_TiCellResult((CheckSignalMatch(sysvarFloat::VTS::M9_Ch3::Avg, 0.2, "<=") == 1));
            _fct_ChckRep(0, sysvarFloat::VTS::M9_Ch2::PWMFreq, "System variable \'M9_Ch2::PWMFreq\'", "Range", "190..210", "");
            _fct_TiCellResult(((@sysvarFloat::VTS::M9_Ch2::PWMFreq>=190LL) && (@sysvarFloat::VTS::M9_Ch2::PWMFreq<=210LL)));
            snprintf(_ttg_Z, elCount(_ttg_Z), "%.15g..%.15g (m9_ch2_pwmdc_low..m9_ch2_pwmdc_high)", _ttg_var_m9_ch2_pwmdc_low_3_1_2_4_3_3, _ttg_var_m9_ch2_pwmdc_high_3_1_2_4_3_2);
            _fct_ChckRep(0, sysvarFloat::VTS::M9_Ch2::PWMDC, "System variable \'M9_Ch2::PWMDC\'", "Range", _ttg_Z, "");
            _fct_TiCellResult(((@sysvarFloat::VTS::M9_Ch2::PWMDC>=_ttg_var_m9_ch2_pwmdc_low_3_1_2_4_3_3) && (@sysvarFloat::VTS::M9_Ch2::PWMDC<=_ttg_var_m9_ch2_pwmdc_high_3_1_2_4_3_2)));
            _fct_ChckRep(0, sysvarFloat::VTS::M9_Ch1::PWMFreq, "System variable \'M9_Ch1::PWMFreq\'", "Range", "190..210", "");
            _fct_TiCellResult(((@sysvarFloat::VTS::M9_Ch1::PWMFreq>=190LL) && (@sysvarFloat::VTS::M9_Ch1::PWMFreq<=210LL)));
            snprintf(_ttg_Z, elCount(_ttg_Z), "%.15g..%.15g (m9_ch1_pwmdc_low..m9_ch1_pwmdc_high)", _ttg_var_m9_ch1_pwmdc_low_3_1_2_4_3_5, _ttg_var_m9_ch1_pwmdc_high_3_1_2_4_3_4);
            _fct_ChckRep(0, sysvarFloat::VTS::M9_Ch1::PWMDC, "System variable \'M9_Ch1::PWMDC\'", "Range", _ttg_Z, "");
            _fct_TiCellResult(((@sysvarFloat::VTS::M9_Ch1::PWMDC>=_ttg_var_m9_ch1_pwmdc_low_3_1_2_4_3_5) && (@sysvarFloat::VTS::M9_Ch1::PWMDC<=_ttg_var_m9_ch1_pwmdc_high_3_1_2_4_3_4)));
            _fct_TiTableEvaluation("1");
          }
          // _ttg_!_3_1_2_4_9_3
          TestCommandEnd();
        }
      }
    }
    // _ttg_!_3_1_2_4_9
    _fct_TestControlStructEnd(1);
    _ttg_verdict = -1;
    TestControlStructBegin("Else", "");
    {
      if(_fct_DoElse(bDone))
      {
        bDone = 1;
        TestCommandBegin("Check", "Check if it's under Day mode Mode0");
        {
          _fct_TiTableHeadExpected();
          _fct_ChckRep(0, sysvarFloat::VTS::M9_Ch3::PWMFreq, "System variable \'M9_Ch3::PWMFreq\'", "==", 0LL, "");
          _fct_TiCellResult((CheckSignalMatch(sysvarFloat::VTS::M9_Ch3::PWMFreq, 0LL, "=") == 1));
          _fct_ChckRep(0, sysvarFloat::VTS::M9_Ch3::Avg, "System variable \'M9_Ch3::Avg\'", "<=", 0.2, "");
          _fct_TiCellResult((CheckSignalMatch(sysvarFloat::VTS::M9_Ch3::Avg, 0.2, "<=") == 1));
          _fct_ChckRep(0, sysvarFloat::VTS::M9_Ch2::PWMFreq, "System variable \'M9_Ch2::PWMFreq\'", "==", 0LL, "");
          _fct_TiCellResult((CheckSignalMatch(sysvarFloat::VTS::M9_Ch2::PWMFreq, 0LL, "=") == 1));
          _fct_ChckRep(0, sysvarFloat::VTS::M9_Ch2::Avg, "System variable \'M9_Ch2::Avg\'", "<=", 0.2, "");
          _fct_TiCellResult((CheckSignalMatch(sysvarFloat::VTS::M9_Ch2::Avg, 0.2, "<=") == 1));
          _fct_ChckRep(0, sysvarFloat::VTS::M9_Ch1::PWMFreq, "System variable \'M9_Ch1::PWMFreq\'", "==", 0LL, "");
          _fct_TiCellResult((CheckSignalMatch(sysvarFloat::VTS::M9_Ch1::PWMFreq, 0LL, "=") == 1));
          _fct_ChckRep(0, sysvarFloat::VTS::M9_Ch1::Avg, "System variable \'M9_Ch1::Avg\'", "<=", 0.2, "");
          _fct_TiCellResult((CheckSignalMatch(sysvarFloat::VTS::M9_Ch1::Avg, 0.2, "<=") == 1));
          _fct_TiTableEvaluation("1");
        }
        // _ttg_!_3_1_2_4_10_1
        TestCommandEnd();
      }
    }
  }
  // _ttg_!_3_1_2_4_10
  _fct_TestControlStructEnd(1);
}
// _ttg_#_3_1_2_4
export void switch_off_by_locked_signal(int64 _ttg_var_system_power_mode_next_3_1_2_5_2_0)
{
  TestCommandBegin("Set", "");
  {
    _fct_TiTableHeadAssignment();
    _fct_Set(CAN::dbNode::PEPS::PEPS2::SystemPowerMode, "CAN signal \'SystemPowerMode\'", 0LL, "OFF");
    _fct_Set(CAN::dbNode::PEPS::PEPS1::RKEDoorLockCmd, "CAN signal \'RKEDoorLockCmd\'", 1LL, "RKE door lock");
    _fct_TiTableEnd("1", 0, 0);
  }
  // _ttg_!_3_1_2_5_3
  TestCommandEnd();
  TestCommandBegin("Wait", "");
  {
    _fct_Wait("1", (int64)(2LL * 1000000000LL), 1000000000, "");
  }
  // _ttg_!_3_1_2_5_4
  TestCommandEnd();
  TestCommandBegin("Check", "Check if it will switched off");
  {
    _fct_TiTableHeadExpected();
    _fct_ChckRep(0, sysvarFloat::VTS::M9_Ch3::PWMFreq, "System variable \'M9_Ch3::PWMFreq\'", "==", 0LL, "");
    _fct_TiCellResult((CheckSignalMatch(sysvarFloat::VTS::M9_Ch3::PWMFreq, 0LL, "=") == 1));
    _fct_ChckRep(0, sysvarFloat::VTS::M9_Ch3::Avg, "System variable \'M9_Ch3::Avg\'", "<=", 0.2, "");
    _fct_TiCellResult((CheckSignalMatch(sysvarFloat::VTS::M9_Ch3::Avg, 0.2, "<=") == 1));
    _fct_ChckRep(0, sysvarFloat::VTS::M9_Ch2::PWMFreq, "System variable \'M9_Ch2::PWMFreq\'", "==", 0LL, "");
    _fct_TiCellResult((CheckSignalMatch(sysvarFloat::VTS::M9_Ch2::PWMFreq, 0LL, "=") == 1));
    _fct_ChckRep(0, sysvarFloat::VTS::M9_Ch2::Avg, "System variable \'M9_Ch2::Avg\'", "<=", 0.2, "");
    _fct_TiCellResult((CheckSignalMatch(sysvarFloat::VTS::M9_Ch2::Avg, 0.2, "<=") == 1));
    _fct_ChckRep(0, sysvarFloat::VTS::M9_Ch1::PWMFreq, "System variable \'M9_Ch1::PWMFreq\'", "==", 0LL, "");
    _fct_TiCellResult((CheckSignalMatch(sysvarFloat::VTS::M9_Ch1::PWMFreq, 0LL, "=") == 1));
    _fct_ChckRep(0, sysvarFloat::VTS::M9_Ch1::Avg, "System variable \'M9_Ch1::Avg\'", "<=", 0.2, "");
    _fct_TiCellResult((CheckSignalMatch(sysvarFloat::VTS::M9_Ch1::Avg, 0.2, "<=") == 1));
    _fct_TiTableEvaluation("1");
  }
  // _ttg_!_3_1_2_5_5
  TestCommandEnd();
  TestCommandBegin("Set", "");
  {
    _fct_TiTableHeadAssignment();
    _fct_Set(CAN::dbNode::PEPS::PEPS1::RKEDoorLockCmd, "CAN signal \'RKEDoorLockCmd\'", 0LL, "No Action");
    _fct_Set(CAN::dbNode::PEPS::PEPS2::SystemPowerMode, "CAN signal \'SystemPowerMode\'", _ttg_var_system_power_mode_next_3_1_2_5_2_0, "system_power_mode_next");
    _fct_TiTableEnd("1", 0, 0);
  }
  // _ttg_!_3_1_2_5_6
  TestCommandEnd();
}
// _ttg_#_3_1_2_5
export void change_color_mode_by_pin4_then_decide_power_mode(int64 _ttg_var_color_mode_3_1_2_6_2_0, int64 _ttg_var_system_power_mode_next_3_1_2_6_2_1, int64 _ttg_var_light_level_3_1_2_6_2_2, int64 _ttg_var_pos_lamp_sts_3_1_2_6_2_3, int64 _ttg_var_driving_mode_3_1_2_6_2_4)
{
  TestCommandBegin("Set", "");
  {
    _fct_TiTableHeadAssignment();
    _fct_Set(CAN::dbNode::PEPS::PEPS2::SystemPowerMode, "CAN signal \'SystemPowerMode\'", 2LL, "ON");
    _fct_Set(CAN::dbNode::HUT::HUT8::ALCMLightLvlSet, "CAN signal \'ALCMLightLvlSet\'", _ttg_var_light_level_3_1_2_6_2_2, "light_level");
    _fct_Set(CAN::dbNode::BCM::BCM1::PosLmpSts, "CAN signal \'PosLmpSts\'", _ttg_var_pos_lamp_sts_3_1_2_6_2_3, "pos_lamp_sts");
    _fct_Set(CAN::dbNode::BCM::BCM8::DrivingModeReq, "CAN signal \'DrivingModeReq\'", _ttg_var_driving_mode_3_1_2_6_2_4, "driving_mode");
    _fct_TiTableEnd("1", 0, 0);
  }
  // _ttg_!_3_1_2_6_3
  TestCommandEnd();
  TestCommandBegin("Wait", "");
  {
    _fct_Wait("1", (int64)(100LL * 1000000LL), 1000000, "");
  }
  // _ttg_!_3_1_2_6_4
  TestCommandEnd();
  {
    CreateTTEIFFunction("press_pin4_ms_wait_s_for_active", 0, 1);
    AddIFParameterInt64(50LL);
    AddIFParameterInt64(2LL);
    CallInterfaceFunction("press_pin4_ms_wait_s_for_active (press_time=50, wait_for_active_s=2)");
  }
  {
    CreateTTEIFFunction("check_color_mode_when_ALCMLightLvlSet_actived", 0, 1);
    AddIFParameterInt64(_ttg_var_color_mode_3_1_2_6_2_0);
    CallInterfaceFunction("check_color_mode_when_ALCMLightLvlSet_actived (color_mode=color_mode)");
  }
  TestCommandBegin("Set", "");
  {
    _fct_TiTableHeadAssignment();
    _fct_Set(CAN::dbNode::PEPS::PEPS2::SystemPowerMode, "CAN signal \'SystemPowerMode\'", _ttg_var_system_power_mode_next_3_1_2_6_2_1, "system_power_mode_next");
    _fct_TiTableEnd("1", 0, 0);
  }
  // _ttg_!_3_1_2_6_7
  TestCommandEnd();
}
// _ttg_#_3_1_2_6
export void enter_mode0_by_pin4_then_decide_power_mode(int64 _ttg_var_system_power_mode_next_3_1_2_7_2_0, int64 _ttg_var_light_level_3_1_2_7_2_1, int64 _ttg_var_pos_lamp_sts_3_1_2_7_2_2, int64 _ttg_var_driving_mode_3_1_2_7_2_3, int64 _ttg_var_light_level_next_3_1_2_7_2_4, int64 _ttg_var_pos_lamp_sts_next_3_1_2_7_2_5, int64 _ttg_var_driving_mode_next_3_1_2_7_2_6)
{
  TestCommandBegin("Set", "");
  {
    _fct_TiTableHeadAssignment();
    _fct_Set(CAN::dbNode::PEPS::PEPS2::SystemPowerMode, "CAN signal \'SystemPowerMode\'", 2LL, "ON");
    _fct_Set(CAN::dbNode::HUT::HUT8::ALCMLightLvlSet, "CAN signal \'ALCMLightLvlSet\'", _ttg_var_light_level_3_1_2_7_2_1, "light_level");
    _fct_Set(CAN::dbNode::BCM::BCM1::PosLmpSts, "CAN signal \'PosLmpSts\'", _ttg_var_pos_lamp_sts_3_1_2_7_2_2, "pos_lamp_sts");
    _fct_Set(CAN::dbNode::BCM::BCM8::DrivingModeReq, "CAN signal \'DrivingModeReq\'", _ttg_var_driving_mode_3_1_2_7_2_3, "driving_mode");
    _fct_TiTableEnd("1", 0, 0);
  }
  // _ttg_!_3_1_2_7_3
  TestCommandEnd();
  TestCommandBegin("Wait", "");
  {
    _fct_Wait("1", (int64)(500LL * 1000000LL), 1000000, "");
  }
  // _ttg_!_3_1_2_7_4
  TestCommandEnd();
  {
    CreateTTEIFFunction("press_pin4_ms_wait_s_for_active", 0, 1);
    AddIFParameterInt64(900LL);
    AddIFParameterInt64(2LL);
    CallInterfaceFunction("press_pin4_ms_wait_s_for_active (press_time=900, wait_for_active_s=2)");
  }
  TestCommandBegin("Check", "Check if it will switched off");
  {
    _fct_TiTableHeadExpected();
    _fct_ChckRep(0, sysvarFloat::VTS::M9_Ch3::PWMFreq, "System variable \'M9_Ch3::PWMFreq\'", "==", 0LL, "");
    _fct_TiCellResult((CheckSignalMatch(sysvarFloat::VTS::M9_Ch3::PWMFreq, 0LL, "=") == 1));
    _fct_ChckRep(0, sysvarFloat::VTS::M9_Ch3::Avg, "System variable \'M9_Ch3::Avg\'", "<=", 0.2, "");
    _fct_TiCellResult((CheckSignalMatch(sysvarFloat::VTS::M9_Ch3::Avg, 0.2, "<=") == 1));
    _fct_ChckRep(0, sysvarFloat::VTS::M9_Ch2::PWMFreq, "System variable \'M9_Ch2::PWMFreq\'", "==", 0LL, "");
    _fct_TiCellResult((CheckSignalMatch(sysvarFloat::VTS::M9_Ch2::PWMFreq, 0LL, "=") == 1));
    _fct_ChckRep(0, sysvarFloat::VTS::M9_Ch2::Avg, "System variable \'M9_Ch2::Avg\'", "<=", 0.2, "");
    _fct_TiCellResult((CheckSignalMatch(sysvarFloat::VTS::M9_Ch2::Avg, 0.2, "<=") == 1));
    _fct_ChckRep(0, sysvarFloat::VTS::M9_Ch1::PWMFreq, "System variable \'M9_Ch1::PWMFreq\'", "==", 0LL, "");
    _fct_TiCellResult((CheckSignalMatch(sysvarFloat::VTS::M9_Ch1::PWMFreq, 0LL, "=") == 1));
    _fct_ChckRep(0, sysvarFloat::VTS::M9_Ch1::Avg, "System variable \'M9_Ch1::Avg\'", "<=", 0.2, "");
    _fct_TiCellResult((CheckSignalMatch(sysvarFloat::VTS::M9_Ch1::Avg, 0.2, "<=") == 1));
    _fct_TiTableEvaluation("1");
  }
  // _ttg_!_3_1_2_7_6
  TestCommandEnd();
  TestCommandBegin("Set", "");
  {
    _fct_TiTableHeadAssignment();
    _fct_Set(CAN::dbNode::PEPS::PEPS2::SystemPowerMode, "CAN signal \'SystemPowerMode\'", _ttg_var_system_power_mode_next_3_1_2_7_2_0, "system_power_mode_next");
    _fct_Set(CAN::dbNode::HUT::HUT8::ALCMLightLvlSet, "CAN signal \'ALCMLightLvlSet\'", _ttg_var_light_level_next_3_1_2_7_2_4, "light_level_next");
    _fct_Set(CAN::dbNode::BCM::BCM1::PosLmpSts, "CAN signal \'PosLmpSts\'", _ttg_var_pos_lamp_sts_next_3_1_2_7_2_5, "pos_lamp_sts_next");
    _fct_Set(CAN::dbNode::BCM::BCM8::DrivingModeReq, "CAN signal \'DrivingModeReq\'", _ttg_var_driving_mode_next_3_1_2_7_2_6, "driving_mode_next");
    _fct_TiTableEnd("1", 0, 0);
  }
  // _ttg_!_3_1_2_7_7
  TestCommandEnd();
}
// _ttg_#_3_1_2_7
export void check_color_mode_when_DrivingModeReq_actived(char _ttg_var_color_should_be_3_1_2_8_2_0[])
{
  {
    // Variables
    _ttg_var_driving_mode_3_1_2_8_3_0 = 0LL;
    snprintf(_ttg_B, 2000, "%I64d", 0LL);
    TestReportVariableDefinition("driving_mode", "int", _ttg_B);
    _ttg_var_pos_lmp_sts_3_1_2_8_3_1 = 0LL;
    snprintf(_ttg_B, 2000, "%I64d", 0LL);
    TestReportVariableDefinition("pos_lmp_sts", "int", _ttg_B);
  }
  TestCommandBegin("CAPL Inline", "get signal from DrivingModeReq & PosLmpSts");
  {
    _ttg_fct_caplinline_3_1_2_8_4();
  }
  // _ttg_!_3_1_2_8_4
  TestCommandEnd();
  _ttg_verdict = -1;
  TestControlStructBegin("If", "");
  {
    int bCondition, bDone;
    bDone = 0;
    {
      {
        bCondition = ((_ttg_var_driving_mode_3_1_2_8_3_0==0LL) || (_ttg_var_driving_mode_3_1_2_8_3_0==1LL) || (_ttg_var_driving_mode_3_1_2_8_3_0==3LL) || (_ttg_var_driving_mode_3_1_2_8_3_0==4LL) || (_ttg_var_driving_mode_3_1_2_8_3_0==9LL) || (_ttg_var_driving_mode_3_1_2_8_3_0==10LL) || (_ttg_var_driving_mode_3_1_2_8_3_0==11LL) || (_ttg_var_driving_mode_3_1_2_8_3_0==13LL));
      }
      _fct_ConditionTableHead("If ( driving_mode one of [0;1;3;4;9;10;11;13;] )", bCondition);
      _fct_ChckRep(0, _ttg_var_driving_mode_3_1_2_8_3_0, "Variable \'driving_mode\'", "OneOf", "0; 1; 3; 4; 9; 10; 11; 13;", "");
      _fct_TiCellResultTrueFalse(((_ttg_var_driving_mode_3_1_2_8_3_0==0LL) || (_ttg_var_driving_mode_3_1_2_8_3_0==1LL) || (_ttg_var_driving_mode_3_1_2_8_3_0==3LL) || (_ttg_var_driving_mode_3_1_2_8_3_0==4LL) || (_ttg_var_driving_mode_3_1_2_8_3_0==9LL) || (_ttg_var_driving_mode_3_1_2_8_3_0==10LL) || (_ttg_var_driving_mode_3_1_2_8_3_0==11LL) || (_ttg_var_driving_mode_3_1_2_8_3_0==13LL)));
      _fct_TiTableEnd("", 0, 2);
      if(bCondition)
      {
        bDone = 1;
        _ttg_verdict = -1;
        TestControlStructBegin("If", "");
        {
          int bCondition, bDone;
          bDone = 0;
          {
            {
              bCondition = (_ttg_var_driving_mode_3_1_2_8_3_0==4LL);
            }
            _fct_ConditionTableHead("If ( driving_mode==4 )", bCondition);
            _fct_ChckRep(0, _ttg_var_driving_mode_3_1_2_8_3_0, "Variable \'driving_mode\'", "==", 4LL, "");
            _fct_TiCellResultTrueFalse((_ttg_var_driving_mode_3_1_2_8_3_0==4LL));
            _fct_TiTableEnd("", 0, 2);
            if(bCondition)
            {
              bDone = 1;
              _ttg_verdict = -1;
              TestControlStructBegin("If", "");
              {
                int bCondition, bDone;
                bDone = 0;
                {
                  {
                    bCondition = (_ttg_var_pos_lmp_sts_3_1_2_8_3_1==0LL);
                  }
                  _fct_ConditionTableHead("If ( pos_lmp_sts==0 )", bCondition);
                  _fct_ChckRep(0, _ttg_var_pos_lmp_sts_3_1_2_8_3_1, "Variable \'pos_lmp_sts\'", "==", 0LL, "");
                  _fct_TiCellResultTrueFalse((_ttg_var_pos_lmp_sts_3_1_2_8_3_1==0LL));
                  _fct_TiTableEnd("", 0, 2);
                  if(bCondition)
                  {
                    bDone = 1;
                    {
                      CreateTTEIFFunction("check_color_mode_when_ALCMLightLvlSet_actived", 0, 1);
                      AddIFParameterInt64(1LL);
                      CallInterfaceFunction("check_color_mode_when_ALCMLightLvlSet_actived (color_mode=1)");
                    }
                  }
                }
                // _ttg_!_3_1_2_8_5_2_2
                _fct_TestControlStructEnd(1);
                _ttg_verdict = -1;
                TestControlStructBegin("Else", "");
                {
                  if(_fct_DoElse(bDone))
                  {
                    bDone = 1;
                    {
                      CreateTTEIFFunction("check_color_mode_when_ALCMLightLvlSet_actived", 0, 1);
                      AddIFParameterInt64(4LL);
                      CallInterfaceFunction("check_color_mode_when_ALCMLightLvlSet_actived (color_mode=4)");
                    }
                  }
                }
              }
              // _ttg_!_3_1_2_8_5_2_3
              _fct_TestControlStructEnd(1);
            }
          }
          // _ttg_!_3_1_2_8_5_2
          _fct_TestControlStructEnd(1);
          _ttg_verdict = -1;
          TestControlStructBegin("Else", "");
          {
            if(_fct_DoElse(bDone))
            {
              bDone = 1;
              _ttg_verdict = -1;
              TestControlStructBegin("If", "");
              {
                int bCondition, bDone;
                bDone = 0;
                {
                  {
                    bCondition = (strncmp(_ttg_var_color_should_be_3_1_2_8_2_0, "\"blue\"", 2000)==0);
                  }
                  _fct_ConditionTableHead("If ( color_should_be==\"blue\" )", bCondition);
                  _fct_ChckRep(0, _ttg_var_color_should_be_3_1_2_8_2_0, "Variable \'color_should_be\'", "==", "\"blue\"", "");
                  _fct_TiCellResultTrueFalse((strncmp(_ttg_var_color_should_be_3_1_2_8_2_0, "\"blue\"", 2000)==0));
                  _fct_TiTableEnd("", 0, 2);
                  if(bCondition)
                  {
                    bDone = 1;
                    _ttg_verdict = -1;
                    TestControlStructBegin("If", "");
                    {
                      int bCondition, bDone;
                      bDone = 0;
                      {
                        {
                          bCondition = (_ttg_var_pos_lmp_sts_3_1_2_8_3_1==0LL);
                        }
                        _fct_ConditionTableHead("If ( pos_lmp_sts==0 )", bCondition);
                        _fct_ChckRep(0, _ttg_var_pos_lmp_sts_3_1_2_8_3_1, "Variable \'pos_lmp_sts\'", "==", 0LL, "");
                        _fct_TiCellResultTrueFalse((_ttg_var_pos_lmp_sts_3_1_2_8_3_1==0LL));
                        _fct_TiTableEnd("", 0, 2);
                        if(bCondition)
                        {
                          bDone = 1;
                          {
                            CreateTTEIFFunction("check_color_mode_when_ALCMLightLvlSet_actived", 0, 1);
                            AddIFParameterInt64(3LL);
                            CallInterfaceFunction("check_color_mode_when_ALCMLightLvlSet_actived (color_mode=3)");
                          }
                        }
                      }
                      // _ttg_!_3_1_2_8_5_3_1_2
                      _fct_TestControlStructEnd(1);
                      _ttg_verdict = -1;
                      TestControlStructBegin("Else", "");
                      {
                        if(_fct_DoElse(bDone))
                        {
                          bDone = 1;
                          {
                            CreateTTEIFFunction("check_color_mode_when_ALCMLightLvlSet_actived", 0, 1);
                            AddIFParameterInt64(6LL);
                            CallInterfaceFunction("check_color_mode_when_ALCMLightLvlSet_actived (color_mode=6)");
                          }
                        }
                      }
                    }
                    // _ttg_!_3_1_2_8_5_3_1_3
                    _fct_TestControlStructEnd(1);
                  }
                }
                // _ttg_!_3_1_2_8_5_3_1
                _fct_TestControlStructEnd(1);
                _ttg_verdict = -1;
                TestControlStructBegin("Else", "");
                {
                  if(_fct_DoElse(bDone))
                  {
                    bDone = 1;
                    _ttg_verdict = -1;
                    TestControlStructBegin("If", "");
                    {
                      int bCondition, bDone;
                      bDone = 0;
                      {
                        {
                          bCondition = (_ttg_var_pos_lmp_sts_3_1_2_8_3_1==0LL);
                        }
                        _fct_ConditionTableHead("If ( pos_lmp_sts==0 )", bCondition);
                        _fct_ChckRep(0, _ttg_var_pos_lmp_sts_3_1_2_8_3_1, "Variable \'pos_lmp_sts\'", "==", 0LL, "");
                        _fct_TiCellResultTrueFalse((_ttg_var_pos_lmp_sts_3_1_2_8_3_1==0LL));
                        _fct_TiTableEnd("", 0, 2);
                        if(bCondition)
                        {
                          bDone = 1;
                          {
                            CreateTTEIFFunction("check_color_mode_when_ALCMLightLvlSet_actived", 0, 1);
                            AddIFParameterInt64(2LL);
                            CallInterfaceFunction("check_color_mode_when_ALCMLightLvlSet_actived (color_mode=2)");
                          }
                        }
                      }
                      // _ttg_!_3_1_2_8_5_3_2_1
                      _fct_TestControlStructEnd(1);
                      _ttg_verdict = -1;
                      TestControlStructBegin("Else", "");
                      {
                        if(_fct_DoElse(bDone))
                        {
                          bDone = 1;
                          {
                            CreateTTEIFFunction("check_color_mode_when_ALCMLightLvlSet_actived", 0, 1);
                            AddIFParameterInt64(5LL);
                            CallInterfaceFunction("check_color_mode_when_ALCMLightLvlSet_actived (color_mode=5)");
                          }
                        }
                      }
                    }
                    // _ttg_!_3_1_2_8_5_3_2_2
                    _fct_TestControlStructEnd(1);
                  }
                }
              }
              // _ttg_!_3_1_2_8_5_3_2
              _fct_TestControlStructEnd(1);
            }
          }
        }
        // _ttg_!_3_1_2_8_5_3
        _fct_TestControlStructEnd(1);
      }
    }
    // _ttg_!_3_1_2_8_5
    _fct_TestControlStructEnd(1);
    _ttg_verdict = -1;
    TestControlStructBegin("Else", "");
    {
      if(_fct_DoElse(bDone))
      {
        bDone = 1;
        TestCommandBegin("CANoe Standard Service", "testValidateTesterConfirmation");
        {
          testStep(2, "", "Execute testValidateTesterConfirmation(\"This driving mode is invalid,enter it will make color mode fixed.\", \"\", 1)");
          testValidateTesterConfirmation("This driving mode is invalid,enter it will make color mode fixed.", "", 1LL);
        }
        // _ttg_!_3_1_2_8_6_1
        TestCommandEnd();
      }
    }
  }
  // _ttg_!_3_1_2_8_6
  _fct_TestControlStructEnd(1);
}
// _ttg_#_3_1_2_8
// Test Tree
void _ttg_fct_tt_3_0()
{
  // Init FlexRay configuration
}
// _ttg_#_3_0
// Power supply initialization
void _ttg_fct_ts_3_0_0()
{
  _fct_CallTsTc("_ttg_ts_ts_3_0_0",3, 0,"Power supply initialization");
}
// _ttg_#_3_0_0
// 3.5.1 Switch on Ambient light by door open signal
void _ttg_fct_ts_3_0_1()
{
  _fct_CallTsTc("_ttg_ts_ts_3_0_1",3, 0,"3.5.1 Switch on Ambient light by door open signal");
}
// _ttg_#_3_0_1
// 3.5.2 Switch on ambient light by ACC or IGN ON
void _ttg_fct_ts_3_0_2()
{
  _fct_CallTsTc("_ttg_ts_ts_3_0_2",3, 0,"3.5.2 Switch on ambient light by ACC or IGN ON");
}
// _ttg_#_3_0_2
// 3.5.3 Switch off function
void _ttg_fct_ts_3_0_3()
{
  _fct_CallTsTc("_ttg_ts_ts_3_0_3",3, 0,"3.5.3 Switch off function");
}
// _ttg_#_3_0_3
// Read SW version
void _ttg_fct_ts_3_0_4()
{
  _fct_CallTsTc("_ttg_ts_ts_3_0_4",3, 0,"Read SW version");
}
// _ttg_#_3_0_4
void _ttg_fct_caplinline_3_1_2_0_4()
{
  {
    @sysvar::VTS::M9_Ch4::RelayGnd = 1;
  }
}
// _ttg_#_3_1_2_0_4
void _ttg_fct_caplinline_3_1_2_0_6()
{
  {
    @sysvar::VTS::M9_Ch4::RelayGnd = 0;
  }
}
// _ttg_#_3_1_2_0_6
void _ttg_fct_caplinline_3_1_2_3_4()
{
  int64 light_level;
  light_level = _ttg_var_light_level_3_1_2_3_3_0;
  {
    light_level=$ALCMLightLvlSet;

  }
  _ttg_var_light_level_3_1_2_3_3_0 = light_level;
}
// _ttg_#_3_1_2_3_4
void _ttg_fct_caplinline_3_1_2_3_5_2_2()
{
  int64 light_level;
  double m9_ch3_pwmdc_high;
  double m9_ch3_pwmdc_low;
  double m9_ch1_pwmdc_high;
  double m9_ch1_pwmdc_low;
  light_level = _ttg_var_light_level_3_1_2_3_3_0;
  m9_ch3_pwmdc_high = _ttg_var_m9_ch3_pwmdc_high_3_1_2_3_3_1;
  m9_ch3_pwmdc_low = _ttg_var_m9_ch3_pwmdc_low_3_1_2_3_3_2;
  m9_ch1_pwmdc_high = _ttg_var_m9_ch1_pwmdc_high_3_1_2_3_3_5;
  m9_ch1_pwmdc_low = _ttg_var_m9_ch1_pwmdc_low_3_1_2_3_3_6;
  {
    m9_ch3_pwmdc_high=3*1.02/10*light_level;
m9_ch3_pwmdc_low=3*0.98/10*light_level;
m9_ch1_pwmdc_high=100*1.02/10*light_level;
m9_ch1_pwmdc_low=100*0.98/10*light_level;
  }
  _ttg_var_light_level_3_1_2_3_3_0 = light_level;
  _ttg_var_m9_ch3_pwmdc_high_3_1_2_3_3_1 = m9_ch3_pwmdc_high;
  _ttg_var_m9_ch3_pwmdc_low_3_1_2_3_3_2 = m9_ch3_pwmdc_low;
  _ttg_var_m9_ch1_pwmdc_high_3_1_2_3_3_5 = m9_ch1_pwmdc_high;
  _ttg_var_m9_ch1_pwmdc_low_3_1_2_3_3_6 = m9_ch1_pwmdc_low;
}
// _ttg_#_3_1_2_3_5_2_2
void _ttg_fct_caplinline_3_1_2_3_5_3_2()
{
  int64 light_level;
  double m9_ch3_pwmdc_high;
  double m9_ch3_pwmdc_low;
  double m9_ch2_pwmdc_high;
  double m9_ch2_pwmdc_low;
  light_level = _ttg_var_light_level_3_1_2_3_3_0;
  m9_ch3_pwmdc_high = _ttg_var_m9_ch3_pwmdc_high_3_1_2_3_3_1;
  m9_ch3_pwmdc_low = _ttg_var_m9_ch3_pwmdc_low_3_1_2_3_3_2;
  m9_ch2_pwmdc_high = _ttg_var_m9_ch2_pwmdc_high_3_1_2_3_3_3;
  m9_ch2_pwmdc_low = _ttg_var_m9_ch2_pwmdc_low_3_1_2_3_3_4;
  {
    m9_ch3_pwmdc_high=96*1.02/10*light_level;
m9_ch3_pwmdc_low=96*0.98/10*light_level;
m9_ch2_pwmdc_high=20*1.02/10*light_level;
m9_ch2_pwmdc_low=20*0.98/10*light_level;
  }
  _ttg_var_light_level_3_1_2_3_3_0 = light_level;
  _ttg_var_m9_ch3_pwmdc_high_3_1_2_3_3_1 = m9_ch3_pwmdc_high;
  _ttg_var_m9_ch3_pwmdc_low_3_1_2_3_3_2 = m9_ch3_pwmdc_low;
  _ttg_var_m9_ch2_pwmdc_high_3_1_2_3_3_3 = m9_ch2_pwmdc_high;
  _ttg_var_m9_ch2_pwmdc_low_3_1_2_3_3_4 = m9_ch2_pwmdc_low;
}
// _ttg_#_3_1_2_3_5_3_2
void _ttg_fct_caplinline_3_1_2_3_5_4_2()
{
  int64 light_level;
  double m9_ch2_pwmdc_high;
  double m9_ch2_pwmdc_low;
  double m9_ch1_pwmdc_high;
  double m9_ch1_pwmdc_low;
  light_level = _ttg_var_light_level_3_1_2_3_3_0;
  m9_ch2_pwmdc_high = _ttg_var_m9_ch2_pwmdc_high_3_1_2_3_3_3;
  m9_ch2_pwmdc_low = _ttg_var_m9_ch2_pwmdc_low_3_1_2_3_3_4;
  m9_ch1_pwmdc_high = _ttg_var_m9_ch1_pwmdc_high_3_1_2_3_3_5;
  m9_ch1_pwmdc_low = _ttg_var_m9_ch1_pwmdc_low_3_1_2_3_3_6;
  {
    m9_ch2_pwmdc_high=32*1.02/10*light_level;
m9_ch2_pwmdc_low=32*0.98/10*light_level;
m9_ch1_pwmdc_high=100*1.02/10*light_level;
m9_ch1_pwmdc_low=100*0.98/10*light_level;
  }
  _ttg_var_light_level_3_1_2_3_3_0 = light_level;
  _ttg_var_m9_ch2_pwmdc_high_3_1_2_3_3_3 = m9_ch2_pwmdc_high;
  _ttg_var_m9_ch2_pwmdc_low_3_1_2_3_3_4 = m9_ch2_pwmdc_low;
  _ttg_var_m9_ch1_pwmdc_high_3_1_2_3_3_5 = m9_ch1_pwmdc_high;
  _ttg_var_m9_ch1_pwmdc_low_3_1_2_3_3_6 = m9_ch1_pwmdc_low;
}
// _ttg_#_3_1_2_3_5_4_2
void _ttg_fct_caplinline_3_1_2_3_5_5_2()
{
  int64 light_level;
  double m9_ch3_pwmdc_high;
  double m9_ch3_pwmdc_low;
  double m9_ch1_pwmdc_high;
  double m9_ch1_pwmdc_low;
  light_level = _ttg_var_light_level_3_1_2_3_3_0;
  m9_ch3_pwmdc_high = _ttg_var_m9_ch3_pwmdc_high_3_1_2_3_3_1;
  m9_ch3_pwmdc_low = _ttg_var_m9_ch3_pwmdc_low_3_1_2_3_3_2;
  m9_ch1_pwmdc_high = _ttg_var_m9_ch1_pwmdc_high_3_1_2_3_3_5;
  m9_ch1_pwmdc_low = _ttg_var_m9_ch1_pwmdc_low_3_1_2_3_3_6;
  {
    m9_ch3_pwmdc_high=2*1.02/10*light_level;
m9_ch3_pwmdc_low=2*0.98/10*light_level;
m9_ch1_pwmdc_high=75*1.02/10*light_level;
m9_ch1_pwmdc_low=75*0.98/10*light_level;
  }
  _ttg_var_light_level_3_1_2_3_3_0 = light_level;
  _ttg_var_m9_ch3_pwmdc_high_3_1_2_3_3_1 = m9_ch3_pwmdc_high;
  _ttg_var_m9_ch3_pwmdc_low_3_1_2_3_3_2 = m9_ch3_pwmdc_low;
  _ttg_var_m9_ch1_pwmdc_high_3_1_2_3_3_5 = m9_ch1_pwmdc_high;
  _ttg_var_m9_ch1_pwmdc_low_3_1_2_3_3_6 = m9_ch1_pwmdc_low;
}
// _ttg_#_3_1_2_3_5_5_2
void _ttg_fct_caplinline_3_1_2_3_5_6_2()
{
  int64 light_level;
  double m9_ch3_pwmdc_high;
  double m9_ch3_pwmdc_low;
  double m9_ch2_pwmdc_high;
  double m9_ch2_pwmdc_low;
  light_level = _ttg_var_light_level_3_1_2_3_3_0;
  m9_ch3_pwmdc_high = _ttg_var_m9_ch3_pwmdc_high_3_1_2_3_3_1;
  m9_ch3_pwmdc_low = _ttg_var_m9_ch3_pwmdc_low_3_1_2_3_3_2;
  m9_ch2_pwmdc_high = _ttg_var_m9_ch2_pwmdc_high_3_1_2_3_3_3;
  m9_ch2_pwmdc_low = _ttg_var_m9_ch2_pwmdc_low_3_1_2_3_3_4;
  {
    m9_ch3_pwmdc_high=72*1.02/10*light_level;
m9_ch3_pwmdc_low=72*0.98/10*light_level;
m9_ch2_pwmdc_high=15*1.02/10*light_level;
m9_ch2_pwmdc_low=15*0.98/10*light_level;
  }
  _ttg_var_light_level_3_1_2_3_3_0 = light_level;
  _ttg_var_m9_ch3_pwmdc_high_3_1_2_3_3_1 = m9_ch3_pwmdc_high;
  _ttg_var_m9_ch3_pwmdc_low_3_1_2_3_3_2 = m9_ch3_pwmdc_low;
  _ttg_var_m9_ch2_pwmdc_high_3_1_2_3_3_3 = m9_ch2_pwmdc_high;
  _ttg_var_m9_ch2_pwmdc_low_3_1_2_3_3_4 = m9_ch2_pwmdc_low;
}
// _ttg_#_3_1_2_3_5_6_2
void _ttg_fct_caplinline_3_1_2_3_5_7_2()
{
  int64 light_level;
  double m9_ch2_pwmdc_high;
  double m9_ch2_pwmdc_low;
  double m9_ch1_pwmdc_high;
  double m9_ch1_pwmdc_low;
  light_level = _ttg_var_light_level_3_1_2_3_3_0;
  m9_ch2_pwmdc_high = _ttg_var_m9_ch2_pwmdc_high_3_1_2_3_3_3;
  m9_ch2_pwmdc_low = _ttg_var_m9_ch2_pwmdc_low_3_1_2_3_3_4;
  m9_ch1_pwmdc_high = _ttg_var_m9_ch1_pwmdc_high_3_1_2_3_3_5;
  m9_ch1_pwmdc_low = _ttg_var_m9_ch1_pwmdc_low_3_1_2_3_3_6;
  {
    m9_ch2_pwmdc_high=24*1.02/10*light_level;
m9_ch2_pwmdc_low=24*0.98/10*light_level;
m9_ch1_pwmdc_high=75*1.02/10*light_level;
m9_ch1_pwmdc_low=75*0.98/10*light_level;
  }
  _ttg_var_light_level_3_1_2_3_3_0 = light_level;
  _ttg_var_m9_ch2_pwmdc_high_3_1_2_3_3_3 = m9_ch2_pwmdc_high;
  _ttg_var_m9_ch2_pwmdc_low_3_1_2_3_3_4 = m9_ch2_pwmdc_low;
  _ttg_var_m9_ch1_pwmdc_high_3_1_2_3_3_5 = m9_ch1_pwmdc_high;
  _ttg_var_m9_ch1_pwmdc_low_3_1_2_3_3_6 = m9_ch1_pwmdc_low;
}
// _ttg_#_3_1_2_3_5_7_2
void _ttg_fct_caplinline_3_1_2_3_6_2_2()
{
  double m9_ch3_pwmdc_high;
  double m9_ch3_pwmdc_low;
  m9_ch3_pwmdc_high = _ttg_var_m9_ch3_pwmdc_high_3_1_2_3_3_1;
  m9_ch3_pwmdc_low = _ttg_var_m9_ch3_pwmdc_low_3_1_2_3_3_2;
  {
    m9_ch3_pwmdc_high=3*1.02;
m9_ch3_pwmdc_low=3*0.98;
  }
  _ttg_var_m9_ch3_pwmdc_high_3_1_2_3_3_1 = m9_ch3_pwmdc_high;
  _ttg_var_m9_ch3_pwmdc_low_3_1_2_3_3_2 = m9_ch3_pwmdc_low;
}
// _ttg_#_3_1_2_3_6_2_2
void _ttg_fct_caplinline_3_1_2_3_6_3_2()
{
  double m9_ch3_pwmdc_high;
  double m9_ch3_pwmdc_low;
  double m9_ch2_pwmdc_high;
  double m9_ch2_pwmdc_low;
  m9_ch3_pwmdc_high = _ttg_var_m9_ch3_pwmdc_high_3_1_2_3_3_1;
  m9_ch3_pwmdc_low = _ttg_var_m9_ch3_pwmdc_low_3_1_2_3_3_2;
  m9_ch2_pwmdc_high = _ttg_var_m9_ch2_pwmdc_high_3_1_2_3_3_3;
  m9_ch2_pwmdc_low = _ttg_var_m9_ch2_pwmdc_low_3_1_2_3_3_4;
  {
    m9_ch3_pwmdc_high=96*1.02;
m9_ch3_pwmdc_low=96*0.98;
m9_ch2_pwmdc_high=20*1.02;
m9_ch2_pwmdc_low=20*0.98;
  }
  _ttg_var_m9_ch3_pwmdc_high_3_1_2_3_3_1 = m9_ch3_pwmdc_high;
  _ttg_var_m9_ch3_pwmdc_low_3_1_2_3_3_2 = m9_ch3_pwmdc_low;
  _ttg_var_m9_ch2_pwmdc_high_3_1_2_3_3_3 = m9_ch2_pwmdc_high;
  _ttg_var_m9_ch2_pwmdc_low_3_1_2_3_3_4 = m9_ch2_pwmdc_low;
}
// _ttg_#_3_1_2_3_6_3_2
void _ttg_fct_caplinline_3_1_2_3_6_4_2()
{
  double m9_ch2_pwmdc_high;
  double m9_ch2_pwmdc_low;
  m9_ch2_pwmdc_high = _ttg_var_m9_ch2_pwmdc_high_3_1_2_3_3_3;
  m9_ch2_pwmdc_low = _ttg_var_m9_ch2_pwmdc_low_3_1_2_3_3_4;
  {
    m9_ch2_pwmdc_high=32*1.02;
m9_ch2_pwmdc_low=32*0.98;
  }
  _ttg_var_m9_ch2_pwmdc_high_3_1_2_3_3_3 = m9_ch2_pwmdc_high;
  _ttg_var_m9_ch2_pwmdc_low_3_1_2_3_3_4 = m9_ch2_pwmdc_low;
}
// _ttg_#_3_1_2_3_6_4_2
void _ttg_fct_caplinline_3_1_2_3_6_5_2()
{
  double m9_ch3_pwmdc_high;
  double m9_ch3_pwmdc_low;
  double m9_ch1_pwmdc_high;
  double m9_ch1_pwmdc_low;
  m9_ch3_pwmdc_high = _ttg_var_m9_ch3_pwmdc_high_3_1_2_3_3_1;
  m9_ch3_pwmdc_low = _ttg_var_m9_ch3_pwmdc_low_3_1_2_3_3_2;
  m9_ch1_pwmdc_high = _ttg_var_m9_ch1_pwmdc_high_3_1_2_3_3_5;
  m9_ch1_pwmdc_low = _ttg_var_m9_ch1_pwmdc_low_3_1_2_3_3_6;
  {
    m9_ch3_pwmdc_high=2*1.02;
m9_ch3_pwmdc_low=2*0.98;
m9_ch1_pwmdc_high=75*1.02;
m9_ch1_pwmdc_low=75*0.98;
  }
  _ttg_var_m9_ch3_pwmdc_high_3_1_2_3_3_1 = m9_ch3_pwmdc_high;
  _ttg_var_m9_ch3_pwmdc_low_3_1_2_3_3_2 = m9_ch3_pwmdc_low;
  _ttg_var_m9_ch1_pwmdc_high_3_1_2_3_3_5 = m9_ch1_pwmdc_high;
  _ttg_var_m9_ch1_pwmdc_low_3_1_2_3_3_6 = m9_ch1_pwmdc_low;
}
// _ttg_#_3_1_2_3_6_5_2
void _ttg_fct_caplinline_3_1_2_3_6_6_2()
{
  double m9_ch3_pwmdc_high;
  double m9_ch3_pwmdc_low;
  double m9_ch2_pwmdc_high;
  double m9_ch2_pwmdc_low;
  m9_ch3_pwmdc_high = _ttg_var_m9_ch3_pwmdc_high_3_1_2_3_3_1;
  m9_ch3_pwmdc_low = _ttg_var_m9_ch3_pwmdc_low_3_1_2_3_3_2;
  m9_ch2_pwmdc_high = _ttg_var_m9_ch2_pwmdc_high_3_1_2_3_3_3;
  m9_ch2_pwmdc_low = _ttg_var_m9_ch2_pwmdc_low_3_1_2_3_3_4;
  {
    m9_ch3_pwmdc_high=72*1.02;
m9_ch3_pwmdc_low=72*0.98;
m9_ch2_pwmdc_high=15*1.02;
m9_ch2_pwmdc_low=15*0.98;
  }
  _ttg_var_m9_ch3_pwmdc_high_3_1_2_3_3_1 = m9_ch3_pwmdc_high;
  _ttg_var_m9_ch3_pwmdc_low_3_1_2_3_3_2 = m9_ch3_pwmdc_low;
  _ttg_var_m9_ch2_pwmdc_high_3_1_2_3_3_3 = m9_ch2_pwmdc_high;
  _ttg_var_m9_ch2_pwmdc_low_3_1_2_3_3_4 = m9_ch2_pwmdc_low;
}
// _ttg_#_3_1_2_3_6_6_2
void _ttg_fct_caplinline_3_1_2_3_6_7_2()
{
  double m9_ch2_pwmdc_high;
  double m9_ch2_pwmdc_low;
  double m9_ch1_pwmdc_high;
  double m9_ch1_pwmdc_low;
  m9_ch2_pwmdc_high = _ttg_var_m9_ch2_pwmdc_high_3_1_2_3_3_3;
  m9_ch2_pwmdc_low = _ttg_var_m9_ch2_pwmdc_low_3_1_2_3_3_4;
  m9_ch1_pwmdc_high = _ttg_var_m9_ch1_pwmdc_high_3_1_2_3_3_5;
  m9_ch1_pwmdc_low = _ttg_var_m9_ch1_pwmdc_low_3_1_2_3_3_6;
  {
    m9_ch2_pwmdc_high=24*1.02;
m9_ch2_pwmdc_low=24*0.98;
m9_ch1_pwmdc_high=75*1.02;
m9_ch1_pwmdc_low=75*0.98;
  }
  _ttg_var_m9_ch2_pwmdc_high_3_1_2_3_3_3 = m9_ch2_pwmdc_high;
  _ttg_var_m9_ch2_pwmdc_low_3_1_2_3_3_4 = m9_ch2_pwmdc_low;
  _ttg_var_m9_ch1_pwmdc_high_3_1_2_3_3_5 = m9_ch1_pwmdc_high;
  _ttg_var_m9_ch1_pwmdc_low_3_1_2_3_3_6 = m9_ch1_pwmdc_low;
}
// _ttg_#_3_1_2_3_6_7_2
void _ttg_fct_caplinline_3_1_2_4_4_2()
{
  double m9_ch3_pwmdc_high;
  double m9_ch3_pwmdc_low;
  m9_ch3_pwmdc_high = _ttg_var_m9_ch3_pwmdc_high_3_1_2_4_3_0;
  m9_ch3_pwmdc_low = _ttg_var_m9_ch3_pwmdc_low_3_1_2_4_3_1;
  {
    m9_ch3_pwmdc_high=3*1.02;
m9_ch3_pwmdc_low=3*0.98;
  }
  _ttg_var_m9_ch3_pwmdc_high_3_1_2_4_3_0 = m9_ch3_pwmdc_high;
  _ttg_var_m9_ch3_pwmdc_low_3_1_2_4_3_1 = m9_ch3_pwmdc_low;
}
// _ttg_#_3_1_2_4_4_2
void _ttg_fct_caplinline_3_1_2_4_5_2()
{
  double m9_ch3_pwmdc_high;
  double m9_ch3_pwmdc_low;
  double m9_ch2_pwmdc_high;
  double m9_ch2_pwmdc_low;
  m9_ch3_pwmdc_high = _ttg_var_m9_ch3_pwmdc_high_3_1_2_4_3_0;
  m9_ch3_pwmdc_low = _ttg_var_m9_ch3_pwmdc_low_3_1_2_4_3_1;
  m9_ch2_pwmdc_high = _ttg_var_m9_ch2_pwmdc_high_3_1_2_4_3_2;
  m9_ch2_pwmdc_low = _ttg_var_m9_ch2_pwmdc_low_3_1_2_4_3_3;
  {
    m9_ch3_pwmdc_high=96*1.02;
m9_ch3_pwmdc_low=96*0.98;
m9_ch2_pwmdc_high=20*1.02;
m9_ch2_pwmdc_low=20*0.98;
  }
  _ttg_var_m9_ch3_pwmdc_high_3_1_2_4_3_0 = m9_ch3_pwmdc_high;
  _ttg_var_m9_ch3_pwmdc_low_3_1_2_4_3_1 = m9_ch3_pwmdc_low;
  _ttg_var_m9_ch2_pwmdc_high_3_1_2_4_3_2 = m9_ch2_pwmdc_high;
  _ttg_var_m9_ch2_pwmdc_low_3_1_2_4_3_3 = m9_ch2_pwmdc_low;
}
// _ttg_#_3_1_2_4_5_2
void _ttg_fct_caplinline_3_1_2_4_6_2()
{
  double m9_ch2_pwmdc_high;
  double m9_ch2_pwmdc_low;
  m9_ch2_pwmdc_high = _ttg_var_m9_ch2_pwmdc_high_3_1_2_4_3_2;
  m9_ch2_pwmdc_low = _ttg_var_m9_ch2_pwmdc_low_3_1_2_4_3_3;
  {
    m9_ch2_pwmdc_high=32*1.02;
m9_ch2_pwmdc_low=32*0.98;
  }
  _ttg_var_m9_ch2_pwmdc_high_3_1_2_4_3_2 = m9_ch2_pwmdc_high;
  _ttg_var_m9_ch2_pwmdc_low_3_1_2_4_3_3 = m9_ch2_pwmdc_low;
}
// _ttg_#_3_1_2_4_6_2
void _ttg_fct_caplinline_3_1_2_4_7_2()
{
  double m9_ch3_pwmdc_high;
  double m9_ch3_pwmdc_low;
  double m9_ch1_pwmdc_high;
  double m9_ch1_pwmdc_low;
  m9_ch3_pwmdc_high = _ttg_var_m9_ch3_pwmdc_high_3_1_2_4_3_0;
  m9_ch3_pwmdc_low = _ttg_var_m9_ch3_pwmdc_low_3_1_2_4_3_1;
  m9_ch1_pwmdc_high = _ttg_var_m9_ch1_pwmdc_high_3_1_2_4_3_4;
  m9_ch1_pwmdc_low = _ttg_var_m9_ch1_pwmdc_low_3_1_2_4_3_5;
  {
    m9_ch3_pwmdc_high=2*1.02;
m9_ch3_pwmdc_low=2*0.98;
m9_ch1_pwmdc_high=75*1.02;
m9_ch1_pwmdc_low=75*0.98;
  }
  _ttg_var_m9_ch3_pwmdc_high_3_1_2_4_3_0 = m9_ch3_pwmdc_high;
  _ttg_var_m9_ch3_pwmdc_low_3_1_2_4_3_1 = m9_ch3_pwmdc_low;
  _ttg_var_m9_ch1_pwmdc_high_3_1_2_4_3_4 = m9_ch1_pwmdc_high;
  _ttg_var_m9_ch1_pwmdc_low_3_1_2_4_3_5 = m9_ch1_pwmdc_low;
}
// _ttg_#_3_1_2_4_7_2
void _ttg_fct_caplinline_3_1_2_4_8_2()
{
  double m9_ch3_pwmdc_high;
  double m9_ch3_pwmdc_low;
  double m9_ch2_pwmdc_high;
  double m9_ch2_pwmdc_low;
  m9_ch3_pwmdc_high = _ttg_var_m9_ch3_pwmdc_high_3_1_2_4_3_0;
  m9_ch3_pwmdc_low = _ttg_var_m9_ch3_pwmdc_low_3_1_2_4_3_1;
  m9_ch2_pwmdc_high = _ttg_var_m9_ch2_pwmdc_high_3_1_2_4_3_2;
  m9_ch2_pwmdc_low = _ttg_var_m9_ch2_pwmdc_low_3_1_2_4_3_3;
  {
    m9_ch3_pwmdc_high=72*1.02;
m9_ch3_pwmdc_low=72*0.98;
m9_ch2_pwmdc_high=15*1.02;
m9_ch2_pwmdc_low=15*0.98;
  }
  _ttg_var_m9_ch3_pwmdc_high_3_1_2_4_3_0 = m9_ch3_pwmdc_high;
  _ttg_var_m9_ch3_pwmdc_low_3_1_2_4_3_1 = m9_ch3_pwmdc_low;
  _ttg_var_m9_ch2_pwmdc_high_3_1_2_4_3_2 = m9_ch2_pwmdc_high;
  _ttg_var_m9_ch2_pwmdc_low_3_1_2_4_3_3 = m9_ch2_pwmdc_low;
}
// _ttg_#_3_1_2_4_8_2
void _ttg_fct_caplinline_3_1_2_4_9_2()
{
  double m9_ch2_pwmdc_high;
  double m9_ch2_pwmdc_low;
  double m9_ch1_pwmdc_high;
  double m9_ch1_pwmdc_low;
  m9_ch2_pwmdc_high = _ttg_var_m9_ch2_pwmdc_high_3_1_2_4_3_2;
  m9_ch2_pwmdc_low = _ttg_var_m9_ch2_pwmdc_low_3_1_2_4_3_3;
  m9_ch1_pwmdc_high = _ttg_var_m9_ch1_pwmdc_high_3_1_2_4_3_4;
  m9_ch1_pwmdc_low = _ttg_var_m9_ch1_pwmdc_low_3_1_2_4_3_5;
  {
    m9_ch2_pwmdc_high=24*1.02;
m9_ch2_pwmdc_low=24*0.98;
m9_ch1_pwmdc_high=75*1.02;
m9_ch1_pwmdc_low=75*0.98;
  }
  _ttg_var_m9_ch2_pwmdc_high_3_1_2_4_3_2 = m9_ch2_pwmdc_high;
  _ttg_var_m9_ch2_pwmdc_low_3_1_2_4_3_3 = m9_ch2_pwmdc_low;
  _ttg_var_m9_ch1_pwmdc_high_3_1_2_4_3_4 = m9_ch1_pwmdc_high;
  _ttg_var_m9_ch1_pwmdc_low_3_1_2_4_3_5 = m9_ch1_pwmdc_low;
}
// _ttg_#_3_1_2_4_9_2
void _ttg_fct_caplinline_3_1_2_8_4()
{
  int64 driving_mode;
  int64 pos_lmp_sts;
  driving_mode = _ttg_var_driving_mode_3_1_2_8_3_0;
  pos_lmp_sts = _ttg_var_pos_lmp_sts_3_1_2_8_3_1;
  {
    driving_mode=$DrivingModeReq;
pos_lmp_sts=$PosLmpSts;
  }
  _ttg_var_driving_mode_3_1_2_8_3_0 = driving_mode;
  _ttg_var_pos_lmp_sts_3_1_2_8_3_1 = pos_lmp_sts;
}
// _ttg_#_3_1_2_8_4
void _ttg_fct_caplinline_3_0_0_3()
{
  {
    sysvar::VTS::M12_VT7001.SetInterconnectionMode(0);
sysvar::VTS::M12_SupInt.SetRefVoltageMode(1);
@sysvar::VTS::M12_SupInt::RefVoltage = 12;
@sysvar::VTS::M12_Out2::Active = 1;
@sysvar::VTS::M9_Ch1::RelayOrgComponent = 0;
@sysvar::VTS::M9_Ch2::RelayOrgComponent = 0;
@sysvar::VTS::M9_Ch3::RelayOrgComponent = 0;


  }
}
// _ttg_#_3_0_0_3
void _ttg_fct_caplinline_3_0_0_7()
{
  {
    @sysvar::VTS::M9_Ch4::RelayGnd = 0;
@sysvar::VTS::M9_Ch1::RelayOrgComponent = 1;
@sysvar::VTS::M9_Ch2::RelayOrgComponent = 1;
@sysvar::VTS::M9_Ch3::RelayOrgComponent = 1;
  }
}
// _ttg_#_3_0_0_7
void _ttg_fct_caplinline_3_0_0_9()
{
  {
    testEnableMsg("HUT8");
  }
}
// _ttg_#_3_0_0_9
// Power supply initialization
testsequence _ttg_ts_ts_3_0_0()
{
  TestCommandBegin("CAPL Inline", "Initialize VT system,make VT internal power supply voltage output equals 12V");
  {
    _ttg_fct_caplinline_3_0_0_3();
  }
  // _ttg_!_3_0_0_3
  TestCommandEnd();
  if(_fct_DoStop(EVerdBOF_TS, 1))
  {
    return;
  }
  TestCommandBegin("Wait", "Wait for power supply initialization complete");
  {
    _fct_Wait("1", (int64)(300LL * 1000000LL), 1000000, "");
  }
  // _ttg_!_3_0_0_4
  TestCommandEnd();
  if(_fct_DoStop(EVerdBOF_TS, 1))
  {
    return;
  }
  TestCommandBegin("Check", "");
  {
    _fct_TiTableHeadExpected();
    _fct_ChckRep(0, sysvarFloat::VTS::M12_Out2::AvgVoltage, "System variable \'M12_Out2::AvgVoltage\'", "<=", 12.5, "");
    _fct_TiCellResult((CheckSignalMatch(sysvarFloat::VTS::M12_Out2::AvgVoltage, 12.5, "<=") == 1));
    _fct_ChckRep(0, sysvarFloat::VTS::M12_Out2::AvgVoltage, "System variable \'M12_Out2::AvgVoltage\'", ">=", 11.5, "");
    _fct_TiCellResult((CheckSignalMatch(sysvarFloat::VTS::M12_Out2::AvgVoltage, 11.5, ">=") == 1));
    _fct_ChckRep(0, sysvarFloat::VTS::M12_Out2::AvgCurrent, "System variable \'M12_Out2::AvgCurrent\'", ">=", 0.001, "");
    _fct_TiCellResult((CheckSignalMatch(sysvarFloat::VTS::M12_Out2::AvgCurrent, 0.001, ">=") == 1));
    _fct_ChckRep(0, sysvarFloat::VTS::M12_Out2::AvgCurrent, "System variable \'M12_Out2::AvgCurrent\'", "<=", 0.1, "");
    _fct_TiCellResult((CheckSignalMatch(sysvarFloat::VTS::M12_Out2::AvgCurrent, 0.1, "<=") == 1));
    _fct_TiTableEvaluation("1");
  }
  // _ttg_!_3_0_0_5
  TestCommandEnd();
  if(_fct_DoStop(EVerdBOF_TS, 1))
  {
    return;
  }
  TestCommandBegin("Wait", "");
  {
    _fct_Wait("1", (int64)(100LL * 1000000LL), 1000000, "");
  }
  // _ttg_!_3_0_0_6
  TestCommandEnd();
  if(_fct_DoStop(EVerdBOF_TS, 1))
  {
    return;
  }
  TestCommandBegin("CAPL Inline", "Set Pin4 input inactive at the beginning and Pin1~3 connect with loads");
  {
    _ttg_fct_caplinline_3_0_0_7();
  }
  // _ttg_!_3_0_0_7
  TestCommandEnd();
  if(_fct_DoStop(EVerdBOF_TS, 1))
  {
    return;
  }
  TestCommandBegin("CANoe Standard Service", "testValidateTesterConfirmation");
  {
    testStep(2, "", "Execute testValidateTesterConfirmation(\"for 3.5.2 debug\", \"\", 1)");
    testValidateTesterConfirmation("for 3.5.2 debug", "", 1LL);
  }
  // _ttg_!_3_0_0_8
  TestCommandEnd();
  if(_fct_DoStop(EVerdBOF_TS, 1))
  {
    return;
  }
  TestCommandBegin("CAPL Inline", "");
  {
    _ttg_fct_caplinline_3_0_0_9();
  }
  // _ttg_!_3_0_0_9
  TestCommandEnd();
  if(_fct_DoStop(EVerdBOF_TS, 1))
  {
    return;
  }
  TestCommandBegin("Set", "");
  {
    _fct_TiTableHeadAssignment();
    _fct_Set(CAN::dbNode::PEPS::PEPS2::SystemPowerMode, "CAN signal \'SystemPowerMode\'", 2LL, "ON");
    _fct_Set(CAN::dbNode::HUT::HUT8::ALCMLightLvlSet, "CAN signal \'ALCMLightLvlSet\'", 10LL, "");
    _fct_Set(CAN::dbNode::BCM::BCM1::PosLmpSts, "CAN signal \'PosLmpSts\'", 0LL, "OFF");
    _fct_TiTableEnd("1", 0, 0);
  }
  // _ttg_!_3_0_0_10
  TestCommandEnd();
  if(_fct_DoStop(EVerdBOF_TS, 1))
  {
    return;
  }
  TestCommandBegin("CANoe Standard Service", "testValidateTesterConfirmation");
  {
    testStep(2, "", "Execute testValidateTesterConfirmation(\"Manually short press PIN4 to make it mode2\", \"\", 1)");
    testValidateTesterConfirmation("Manually short press PIN4 to make it mode2", "", 1LL);
  }
  // _ttg_!_3_0_0_11
  TestCommandEnd();
  if(_fct_DoStop(EVerdBOF_TS, 1))
  {
    return;
  }
  {
    CreateTTEIFFunction("switch_off_by_locked_signal", 0, 1);
    AddIFParameterInt64(0LL);
    CallInterfaceFunction("switch_off_by_locked_signal (system_power_mode_next=0)");
    if(_fct_DoStop(EVerdBOF_TS, 1))
    {
      return;
    }
  }
}
// _ttg_#_3_0_0
// 3.5.1 Switch on Ambient light by door open signal
testsequence _ttg_ts_ts_3_0_1()
{
  {
    _fct_CallTsTc("_ttg_tc_tc_3_0_1_2",1, 0,"TEST1:When IGN is OFF and initial power on,once received door open status signal is actived,ALCM will change to default color mode and luminance in 1s by dimming directly.Factory default color is blue and default luminance is 50%");
    if(_fct_DoStop(EVerdBOF_TS, 1))
    {
      return;
    }
  }
  TestCommandBegin("CANoe Standard Service", "testValidateTesterConfirmation");
  {
    testStep(2, "", "Execute testValidateTesterConfirmation(\"test1 over\", \"\", 1)");
    testValidateTesterConfirmation("test1 over", "", 1LL);
  }
  // _ttg_!_3_0_1_3
  TestCommandEnd();
  if(_fct_DoStop(EVerdBOF_TS, 1))
  {
    return;
  }
  {
    _fct_CallTsTc("_ttg_tc_tc_3_0_1_4",1, 0,"TEST2:When Power mode is OFF,ALCM will ignore DrivingModeReq and ALCMLightLvlSet signal.");
    if(_fct_DoStop(EVerdBOF_TS, 1))
    {
      return;
    }
  }
  TestCommandBegin("CANoe Standard Service", "testValidateTesterConfirmation");
  {
    testStep(2, "", "Execute testValidateTesterConfirmation(\"test 2 over\", \"\", 1)");
    testValidateTesterConfirmation("test 2 over", "", 1LL);
  }
  // _ttg_!_3_0_1_5
  TestCommandEnd();
  if(_fct_DoStop(EVerdBOF_TS, 1))
  {
    return;
  }
  {
    _fct_CallTsTc("_ttg_tc_tc_3_0_1_6",1, 0,"TEST3:Once received PosLmpStsl is active,ALCM will change color mode from day mode to night mode in 1s");
    if(_fct_DoStop(EVerdBOF_TS, 1))
    {
      return;
    }
  }
  TestCommandBegin("CANoe Standard Service", "testValidateTesterConfirmation");
  {
    testStep(2, "", "Execute testValidateTesterConfirmation(\"test 3 over\", \"\", 1)");
    testValidateTesterConfirmation("test 3 over", "", 1LL);
  }
  // _ttg_!_3_0_1_7
  TestCommandEnd();
  if(_fct_DoStop(EVerdBOF_TS, 1))
  {
    return;
  }
  {
    _fct_CallTsTc("_ttg_tc_tc_3_0_1_8",1, 0,"TEST4:When IGN is OFF,if there is any other color output (except mode0) during last shut down,once received door open status and ALCM will change to last saved value and luminance in 1s");
    if(_fct_DoStop(EVerdBOF_TS, 1))
    {
      return;
    }
  }
  TestCommandBegin("CANoe Standard Service", "testValidateTesterConfirmation");
  {
    testStep(2, "", "Execute testValidateTesterConfirmation(\"test 4 over\", \"\", 1)");
    testValidateTesterConfirmation("test 4 over", "", 1LL);
  }
  // _ttg_!_3_0_1_9
  TestCommandEnd();
  if(_fct_DoStop(EVerdBOF_TS, 1))
  {
    return;
  }
  {
    _fct_CallTsTc("_ttg_tc_tc_3_0_1_10",1, 0,"TEST5:If all doors are closed and any doors are open again,then the time 20s will be recalculated from door open");
    if(_fct_DoStop(EVerdBOF_TS, 1))
    {
      return;
    }
  }
  TestCommandBegin("CANoe Standard Service", "testValidateTesterConfirmation");
  {
    testStep(2, "", "Execute testValidateTesterConfirmation(\"test 5 over\", \"\", 1)");
    testValidateTesterConfirmation("test 5 over", "", 1LL);
  }
  // _ttg_!_3_0_1_11
  TestCommandEnd();
  if(_fct_DoStop(EVerdBOF_TS, 1))
  {
    return;
  }
  {
    _fct_CallTsTc("_ttg_tc_tc_3_0_1_12",1, 0,"TEST6:If received ACC or IGN ON signal during light 20s,ambient light will be continuously switched on");
    if(_fct_DoStop(EVerdBOF_TS, 1))
    {
      return;
    }
  }
  TestCommandBegin("CANoe Standard Service", "testValidateTesterConfirmation");
  {
    testStep(2, "", "Execute testValidateTesterConfirmation(\"test 6 over\", \"\", 1)");
    testValidateTesterConfirmation("test 6 over", "", 1LL);
  }
  // _ttg_!_3_0_1_13
  TestCommandEnd();
  if(_fct_DoStop(EVerdBOF_TS, 1))
  {
    return;
  }
  {
    _fct_CallTsTc("_ttg_tc_tc_3_0_1_14",1, 0,"TEST7:If received ACC or IGN ON signal after 20s,ambient light will be shutted down and switched on last saved color and luminance in 1s");
    if(_fct_DoStop(EVerdBOF_TS, 1))
    {
      return;
    }
  }
  TestCommandBegin("CANoe Standard Service", "testValidateTesterConfirmation");
  {
    testStep(2, "", "Execute testValidateTesterConfirmation(\"test 7 over\", \"\", 1)");
    testValidateTesterConfirmation("test 7 over", "", 1LL);
  }
  // _ttg_!_3_0_1_15
  TestCommandEnd();
  if(_fct_DoStop(EVerdBOF_TS, 1))
  {
    return;
  }
  {
    _fct_CallTsTc("_ttg_tc_tc_3_0_1_16",1, 0,"TEST8:When IGN is OFF,if there is no color output (color mode is MODE 0) during last shut down, once received door open status and ALCM can not switch on ambient light. ");
    if(_fct_DoStop(EVerdBOF_TS, 1))
    {
      return;
    }
  }
}
// _ttg_#_3_0_1
// 3.5.2 Switch on ambient light by ACC or IGN ON
testsequence _ttg_ts_ts_3_0_2()
{
  {
    _fct_CallTsTc("_ttg_tc_tc_3_0_2_3",1, 0,"TEST1:Ambient light is Mode0,when power mode is ACC,then ALCM can not switch on ambient light.");
    if(_fct_DoStop(EVerdBOF_TS, 0))
    {
      return;
    }
  }
  TestCommandBegin("CANoe Standard Service", "testValidateTesterConfirmation");
  {
    testStep(2, "", "Execute testValidateTesterConfirmation(\"3.5.2 test1 over\", \"\", 1)");
    testValidateTesterConfirmation("3.5.2 test1 over", "", 1LL);
  }
  // _ttg_!_3_0_2_4
  TestCommandEnd();
  if(_fct_DoStop(EVerdBOF_TS, 0))
  {
    return;
  }
  {
    _fct_CallTsTc("_ttg_tc_tc_3_0_2_5",1, 0,"TEST2:If IGN is ON,receive and deal with all CAN bus signals.");
    if(_fct_DoStop(EVerdBOF_TS, 0))
    {
      return;
    }
  }
  TestCommandBegin("CANoe Standard Service", "testValidateTesterConfirmation");
  {
    testStep(2, "", "Execute testValidateTesterConfirmation(\"3.5.2 test2 over\", \"\", 1)");
    testValidateTesterConfirmation("3.5.2 test2 over", "", 1LL);
  }
  // _ttg_!_3_0_2_6
  TestCommandEnd();
  if(_fct_DoStop(EVerdBOF_TS, 0))
  {
    return;
  }
  {
    _fct_CallTsTc("_ttg_tc_tc_3_0_2_7",1, 0,"TEST3:Ambient light is switched off by time,locked signal or power supply off,when power mode is ACC,then ALCM can switch on last saved color and luminance in 1s by dimming");
    if(_fct_DoStop(EVerdBOF_TS, 0))
    {
      return;
    }
  }
  TestCommandBegin("CANoe Standard Service", "testValidateTesterConfirmation");
  {
    testStep(2, "", "Execute testValidateTesterConfirmation(\"3.5.2 test3 over\", \"\", 1)");
    testValidateTesterConfirmation("3.5.2 test3 over", "", 1LL);
  }
  // _ttg_!_3_0_2_8
  TestCommandEnd();
  if(_fct_DoStop(EVerdBOF_TS, 0))
  {
    return;
  }
  {
    _fct_CallTsTc("_ttg_tc_tc_3_0_2_9",1, 0,"TEST4:When Power mode is ACC,ALCM will ignore DrivingModeReq and ALCMLightLvlSet signal.");
    if(_fct_DoStop(EVerdBOF_TS, 0))
    {
      return;
    }
  }
  TestCommandBegin("CANoe Standard Service", "testValidateTesterConfirmation");
  {
    testStep(2, "", "Execute testValidateTesterConfirmation(\"3.5.2 test4 over\", \"\", 1)");
    testValidateTesterConfirmation("3.5.2 test4 over", "", 1LL);
  }
  // _ttg_!_3_0_2_10
  TestCommandEnd();
  if(_fct_DoStop(EVerdBOF_TS, 0))
  {
    return;
  }
  {
    _fct_CallTsTc("_ttg_tc_tc_3_0_2_11",1, 0,"TEST5:Ambient light is Mode0,if the color mode is Mode0,received IGN ON signal and short or long press one time,ALCM will switch on last saved color and luminance in 1s by dimming,then will change to corresponding color and luminance by received DrivingModeReq and ALCMLightLvlSet signal.");
    if(_fct_DoStop(EVerdBOF_TS, 0))
    {
      return;
    }
  }
  TestCommandBegin("CANoe Standard Service", "testValidateTesterConfirmation");
  {
    testStep(2, "", "Execute testValidateTesterConfirmation(\"3.5.2 test5 over\", \"\", 1)");
    testValidateTesterConfirmation("3.5.2 test5 over", "", 1LL);
  }
  // _ttg_!_3_0_2_12
  TestCommandEnd();
  if(_fct_DoStop(EVerdBOF_TS, 0))
  {
    return;
  }
  {
    _fct_CallTsTc("_ttg_tc_tc_3_0_2_13",1, 0,"TEST6:Ambient light is switched off by time,locked signal or power supply off,received IGN ON signal and ALCM will switch on last saved color and luminance in 1s by dimming,then will change to corresponding color and luminance by received DrivingModeReq and ALCMLightLvlset signal.");
    if(_fct_DoStop(EVerdBOF_TS, 0))
    {
      return;
    }
  }
  TestCommandBegin("CANoe Standard Service", "testValidateTesterConfirmation");
  {
    testStep(2, "", "Execute testValidateTesterConfirmation(\"3.5.2 test6 over\", \"\", 1)");
    testValidateTesterConfirmation("3.5.2 test6 over", "", 1LL);
  }
  // _ttg_!_3_0_2_14
  TestCommandEnd();
  if(_fct_DoStop(EVerdBOF_TS, 0))
  {
    return;
  }
  {
    _fct_CallTsTc("_ttg_tc_tc_3_0_2_15",1, 0,"TEST7:When IGN is off,ambient light is ON,if received power mode is ACC,ALCM cannot change color.");
    if(_fct_DoStop(EVerdBOF_TS, 0))
    {
      return;
    }
  }
  TestCommandBegin("CANoe Standard Service", "testValidateTesterConfirmation");
  {
    testStep(2, "", "Execute testValidateTesterConfirmation(\"3.5.2 test7 over\", \"\", 1)");
    testValidateTesterConfirmation("3.5.2 test7 over", "", 1LL);
  }
  // _ttg_!_3_0_2_16
  TestCommandEnd();
  if(_fct_DoStop(EVerdBOF_TS, 0))
  {
    return;
  }
  {
    _fct_CallTsTc("_ttg_tc_tc_3_0_2_17",1, 0,"TEST8:When IGN is off,ambient light is ON,if received power mode is IGN ON,ALCM will change to corresponding color and luminance in 1s by dimming according to received DrivingModeReq and ALCMLightLvlset signal.");
    if(_fct_DoStop(EVerdBOF_TS, 0))
    {
      return;
    }
  }
  TestCommandBegin("CANoe Standard Service", "testValidateTesterConfirmation");
  {
    testStep(2, "", "Execute testValidateTesterConfirmation(\"3.5.2 test8 over\", \"\", 1)");
    testValidateTesterConfirmation("3.5.2 test8 over", "", 1LL);
  }
  // _ttg_!_3_0_2_18
  TestCommandEnd();
  if(_fct_DoStop(EVerdBOF_TS, 0))
  {
    return;
  }
  {
    _fct_CallTsTc("_ttg_tc_tc_3_0_2_19",1, 0,"TEST9:When IGN is ON and ambient light is switched on,if the current color is red,short press color switch can not change color;If current color is not red,short press color switch can change color between blue and golden,changing process will ignore short press switch again.");
    if(_fct_DoStop(EVerdBOF_TS, 0))
    {
      return;
    }
  }
  TestCommandBegin("CANoe Standard Service", "testValidateTesterConfirmation");
  {
    testStep(2, "", "Execute testValidateTesterConfirmation(\"3.5.2 test9 over\", \"\", 1)");
    testValidateTesterConfirmation("3.5.2 test9 over", "", 1LL);
  }
  // _ttg_!_3_0_2_20
  TestCommandEnd();
  if(_fct_DoStop(EVerdBOF_TS, 0))
  {
    return;
  }
}
// _ttg_#_3_0_2
// 3.5.3 Switch off function
testsequence _ttg_ts_ts_3_0_3()
{
  {
    _fct_CallTsTc("_ttg_tc_tc_3_0_3_2",1, 0,"TEST1:If long press switch one time,then will remember current color mode and luminance,then will switch off ambient light in 1s by dimming.During dimming off,if short press switch again,then ambient light will be switched on again.");
    if(_fct_DoStop(EVerdBOF_TS, 0))
    {
      return;
    }
  }
}
// _ttg_#_3_0_3
// Read SW version
testsequence _ttg_ts_ts_3_0_4()
{
  {
    _fct_CallTsTc("_ttg_tc_tc_3_0_4_2",1, 0,"Read SW version");
    if(_fct_DoStop(EVerdBOF_TS, 0))
    {
      return;
    }
  }
}
// _ttg_#_3_0_4
// TEST1:When IGN is OFF and initial power on,once received door open status signal is actived,ALCM will change to default color mode and luminance in 1s by dimming directly.Factory default color is blue and default luminance is 50%
testcase _ttg_tc_tc_3_0_1_2()
{
  TestCaseTitle("", "TEST1:When IGN is OFF and initial power on,once received door open status signal is actived,ALCM will change to default color mode and luminance in 1s by dimming directly.Factory default color is blue and default luminance is 50%");
  TestCommandBegin("Report", "");
  {
    testStep(2, "", "TEST:When IGN is OFF and initial power on,once received door open status signal is actived,ALCM will change to default color mode and luminance in 1s by dimming directly.Factory default color is blue and default luminance is 50%");
  }
  // _ttg_!_3_0_1_2_3
  TestCommandEnd();
  if(_fct_DoStop(EVerdBOF_TC, 0))
  {
    return;
  }
  {
    CreateTTEIFFunction("switch_on_by_door_open_signal_when_ign_off", 0, 1);
    AddIFParameterInt64(0LL);
    AddIFParameterSignal(CAN::dbNode::BCM::BCM1::DriverDoorSts);
    AddIFParameterInt64(2LL);
    CallInterfaceFunction("switch_on_by_door_open_signal_when_ign_off (PosLmpSts_value=0, door_open_signal=DriverDoorSts, color_mode=2)");
    if(_fct_DoStop(EVerdBOF_TC, 0))
    {
      return;
    }
  }
  {
    CreateTTEIFFunction("switch_off_by_time_ms", 0, 1);
    AddIFParameterInt64(21000LL);
    AddIFParameterInt64(0LL);
    CallInterfaceFunction("switch_off_by_time_ms (wait_for_switch_off=21000, need_close_door_or_not=0)");
    if(_fct_DoStop(EVerdBOF_TC, 0))
    {
      return;
    }
  }
}
// _ttg_#_3_0_1_2
// TEST2:When Power mode is OFF,ALCM will ignore DrivingModeReq and ALCMLightLvlSet signal.
testcase _ttg_tc_tc_3_0_1_4()
{
  TestCaseTitle("", "TEST2:When Power mode is OFF,ALCM will ignore DrivingModeReq and ALCMLightLvlSet signal.");
  {
    CreateTTEIFFunction("switch_on_by_door_open_signal_when_ign_off", 0, 1);
    AddIFParameterInt64(0LL);
    AddIFParameterSignal(CAN::dbNode::BCM::BCM1::PassengerDoorSts);
    AddIFParameterInt64(2LL);
    CallInterfaceFunction("switch_on_by_door_open_signal_when_ign_off (PosLmpSts_value=0, door_open_signal=PassengerDoorSts, color_mode=2)");
    if(_fct_DoStop(EVerdBOF_TC, 0))
    {
      return;
    }
  }
  TestCommandBegin("Report", "");
  {
    testStep(2, "", "TEST:When Power mode is OFF,ALCM will ignore DrivingModeReq and ALCMLightLvlSet signal.");
  }
  // _ttg_!_3_0_1_4_3
  TestCommandEnd();
  if(_fct_DoStop(EVerdBOF_TC, 0))
  {
    return;
  }
  _ttg_verdict = -1;
  {
    // begin of for block
    {
      int64 _ttg_var_startvalue_3_0_1_4_4_2;
      int64 _ttg_var_stopvalue_3_0_1_4_4_3;
      int64 _ttg_var_increment_3_0_1_4_4_4;
      _ttg_var_startvalue_3_0_1_4_4_2 = 10LL;
      _ttg_var_stopvalue_3_0_1_4_4_3 = 0LL;
      _ttg_var_increment_3_0_1_4_4_4 = -1LL;
      for(_ttg_var_i_3_0_1_4_4 = _ttg_var_startvalue_3_0_1_4_4_2; (_ttg_var_increment_3_0_1_4_4_4<0)?(_ttg_var_i_3_0_1_4_4 >= _ttg_var_stopvalue_3_0_1_4_4_3):(_ttg_var_i_3_0_1_4_4 <= _ttg_var_stopvalue_3_0_1_4_4_3); _ttg_var_i_3_0_1_4_4 += _ttg_var_increment_3_0_1_4_4_4)
      {
        snprintf(_ttg_B, 2000, "For (For i=10..0, increment=-1; current i = %I64d)", _ttg_var_i_3_0_1_4_4);
        if(_fct_LoopIsBlocking())
        {
          _fct_CommandVerdict(1);
          break;
        }
        TestControlStructBegin("For", _ttg_B);
        TestCommandBegin("Set", "");
        {
          _fct_TiTableHeadAssignment();
          _fct_Set(CAN::dbNode::HUT::HUT8::ALCMLightLvlSet, "CAN signal \'ALCMLightLvlSet\'", _ttg_var_i_3_0_1_4_4, "i");
          _fct_TiTableEnd("1", 0, 0);
        }
        // _ttg_!_3_0_1_4_4_5
        TestCommandEnd();
        if(_fct_DoStop(EVerdBOF_TC, 0))
        {
          _fct_TestControlStructEnd(1);
          return;
        }
        TestCommandBegin("Wait", "");
        {
          _fct_Wait("1", (int64)(100LL * 1000000LL), 1000000, "");
        }
        // _ttg_!_3_0_1_4_4_6
        TestCommandEnd();
        if(_fct_DoStop(EVerdBOF_TC, 0))
        {
          _fct_TestControlStructEnd(1);
          return;
        }
        {
          CreateTTEIFFunction("check_color_mode_when_ALCMLightLvlSet_inactived", 0, 1);
          AddIFParameterInt64(2LL);
          CallInterfaceFunction("check_color_mode_when_ALCMLightLvlSet_inactived (color_mode=2)");
          if(_fct_DoStop(EVerdBOF_TC, 0))
          {
            _fct_TestControlStructEnd(1);
            return;
          }
        }
        _fct_TestControlStructEnd(1);
      }
    }
    // end of for block
  }
  // _ttg_!_3_0_1_4_4
  if(_fct_DoStop(EVerdBOF_TC, 0))
  {
    return;
  }
  TestCommandBegin("Set", "Reset ALCMLightLvlSet=10");
  {
    _fct_TiTableHeadAssignment();
    _fct_Set(CAN::dbNode::HUT::HUT8::ALCMLightLvlSet, "CAN signal \'ALCMLightLvlSet\'", 10LL, "");
    _fct_TiTableEnd("1", 0, 0);
  }
  // _ttg_!_3_0_1_4_5
  TestCommandEnd();
  if(_fct_DoStop(EVerdBOF_TC, 0))
  {
    return;
  }
  _ttg_verdict = -1;
  {
    // begin of for block
    {
      int64 _ttg_var_startvalue_3_0_1_4_6_2;
      int64 _ttg_var_stopvalue_3_0_1_4_6_3;
      int64 _ttg_var_increment_3_0_1_4_6_4;
      _ttg_var_startvalue_3_0_1_4_6_2 = 0LL;
      _ttg_var_stopvalue_3_0_1_4_6_3 = 15LL;
      _ttg_var_increment_3_0_1_4_6_4 = 1LL;
      for(_ttg_var_i_3_0_1_4_6 = _ttg_var_startvalue_3_0_1_4_6_2; (_ttg_var_increment_3_0_1_4_6_4<0)?(_ttg_var_i_3_0_1_4_6 >= _ttg_var_stopvalue_3_0_1_4_6_3):(_ttg_var_i_3_0_1_4_6 <= _ttg_var_stopvalue_3_0_1_4_6_3); _ttg_var_i_3_0_1_4_6 += _ttg_var_increment_3_0_1_4_6_4)
      {
        snprintf(_ttg_B, 2000, "For (For i=0..15, increment=1; current i = %I64d)", _ttg_var_i_3_0_1_4_6);
        if(_fct_LoopIsBlocking())
        {
          _fct_CommandVerdict(1);
          break;
        }
        TestControlStructBegin("For", _ttg_B);
        TestCommandBegin("Set", "");
        {
          _fct_TiTableHeadAssignment();
          _fct_Set(CAN::dbNode::BCM::BCM8::DrivingModeReq, "CAN signal \'DrivingModeReq\'", _ttg_var_i_3_0_1_4_6, "i");
          _fct_TiTableEnd("1", 0, 0);
        }
        // _ttg_!_3_0_1_4_6_5
        TestCommandEnd();
        if(_fct_DoStop(EVerdBOF_TC, 0))
        {
          _fct_TestControlStructEnd(1);
          return;
        }
        TestCommandBegin("Wait", "");
        {
          _fct_Wait("1", (int64)(100LL * 1000000LL), 1000000, "");
        }
        // _ttg_!_3_0_1_4_6_6
        TestCommandEnd();
        if(_fct_DoStop(EVerdBOF_TC, 0))
        {
          _fct_TestControlStructEnd(1);
          return;
        }
        {
          CreateTTEIFFunction("check_color_mode_when_ALCMLightLvlSet_inactived", 0, 1);
          AddIFParameterInt64(2LL);
          CallInterfaceFunction("check_color_mode_when_ALCMLightLvlSet_inactived (color_mode=2)");
          if(_fct_DoStop(EVerdBOF_TC, 0))
          {
            _fct_TestControlStructEnd(1);
            return;
          }
        }
        _fct_TestControlStructEnd(1);
      }
    }
    // end of for block
  }
  // _ttg_!_3_0_1_4_6
  if(_fct_DoStop(EVerdBOF_TC, 0))
  {
    return;
  }
  TestCommandBegin("Set", "Reset DrivingModeReq=0");
  {
    _fct_TiTableHeadAssignment();
    _fct_Set(CAN::dbNode::BCM::BCM8::DrivingModeReq, "CAN signal \'DrivingModeReq\'", 0LL, "");
    _fct_TiTableEnd("1", 0, 0);
  }
  // _ttg_!_3_0_1_4_7
  TestCommandEnd();
  if(_fct_DoStop(EVerdBOF_TC, 0))
  {
    return;
  }
  {
    CreateTTEIFFunction("switch_off_by_locked_signal", 0, 1);
    AddIFParameterInt64(0LL);
    CallInterfaceFunction("switch_off_by_locked_signal (system_power_mode_next=0)");
    if(_fct_DoStop(EVerdBOF_TC, 0))
    {
      return;
    }
  }
}
// _ttg_#_3_0_1_4
// TEST3:Once received PosLmpStsl is active,ALCM will change color mode from day mode to night mode in 1s
testcase _ttg_tc_tc_3_0_1_6()
{
  TestCaseTitle("", "TEST3:Once received PosLmpStsl is active,ALCM will change color mode from day mode to night mode in 1s");
  TestCommandBegin("Report", "");
  {
    testStep(2, "", "TEST:Once received PosLmpStsl is active,ALCM will change color mode from day mode to night mode in 1s");
  }
  // _ttg_!_3_0_1_6_2
  TestCommandEnd();
  if(_fct_DoStop(EVerdBOF_TC, 0))
  {
    return;
  }
  {
    CreateTTEIFFunction("switch_on_by_door_open_signal_when_ign_off", 0, 1);
    AddIFParameterInt64(1LL);
    AddIFParameterSignal(CAN::dbNode::BCM::BCM1::RLDoorSts);
    AddIFParameterInt64(5LL);
    CallInterfaceFunction("switch_on_by_door_open_signal_when_ign_off (PosLmpSts_value=1, door_open_signal=RLDoorSts, color_mode=5)");
    if(_fct_DoStop(EVerdBOF_TC, 0))
    {
      return;
    }
  }
  {
    CreateTTEIFFunction("switch_off_by_locked_signal", 0, 1);
    AddIFParameterInt64(0LL);
    CallInterfaceFunction("switch_off_by_locked_signal (system_power_mode_next=0)");
    if(_fct_DoStop(EVerdBOF_TC, 0))
    {
      return;
    }
  }
  {
    CreateTTEIFFunction("switch_on_by_door_open_signal_when_ign_off", 0, 1);
    AddIFParameterInt64(0LL);
    AddIFParameterSignal(CAN::dbNode::BCM::BCM1::RLDoorSts);
    AddIFParameterInt64(2LL);
    CallInterfaceFunction("switch_on_by_door_open_signal_when_ign_off (PosLmpSts_value=0, door_open_signal=RLDoorSts, color_mode=2)");
    if(_fct_DoStop(EVerdBOF_TC, 0))
    {
      return;
    }
  }
  {
    CreateTTEIFFunction("switch_off_by_locked_signal", 0, 1);
    AddIFParameterInt64(0LL);
    CallInterfaceFunction("switch_off_by_locked_signal (system_power_mode_next=0)");
    if(_fct_DoStop(EVerdBOF_TC, 0))
    {
      return;
    }
  }
}
// _ttg_#_3_0_1_6
// TEST4:When IGN is OFF,if there is any other color output (except mode0) during last shut down,once received door open status and ALCM will change to last saved value and luminance in 1s
testcase _ttg_tc_tc_3_0_1_8()
{
  TestCaseTitle("", "TEST4:When IGN is OFF,if there is any other color output (except mode0) during last shut down,once received door open status and ALCM will change to last saved value and luminance in 1s");
  TestCommandBegin("Report", "");
  {
    testStep(2, "", "TEST:When IGN is OFF,if there is any other color output (except mode0) during last shut down,once received door open status and ALCM will change to last saved value and luminance in 1s");
  }
  // _ttg_!_3_0_1_8_2
  TestCommandEnd();
  if(_fct_DoStop(EVerdBOF_TC, 0))
  {
    return;
  }
  {
    CreateTTEIFFunction("switch_on_by_door_open_signal_when_ign_off", 0, 1);
    AddIFParameterInt64(0LL);
    AddIFParameterSignal(CAN::dbNode::BCM::BCM1::RRDoorSts);
    AddIFParameterInt64(2LL);
    CallInterfaceFunction("switch_on_by_door_open_signal_when_ign_off (PosLmpSts_value=0, door_open_signal=RRDoorSts, color_mode=2)");
    if(_fct_DoStop(EVerdBOF_TC, 0))
    {
      return;
    }
  }
  {
    CreateTTEIFFunction("change_color_mode_by_pin4_then_decide_power_mode", 0, 1);
    AddIFParameterInt64(3LL);
    AddIFParameterInt64(0LL);
    AddIFParameterInt64(10LL);
    AddIFParameterInt64(0LL);
    AddIFParameterInt64(0LL);
    CallInterfaceFunction("change_color_mode_by_pin4_then_decide_power_mode (color_mode=3, system_power_mode_next=0, light_level=10, pos_lamp_sts=0, driving_mode=0)");
    if(_fct_DoStop(EVerdBOF_TC, 0))
    {
      return;
    }
  }
  {
    CreateTTEIFFunction("switch_off_by_locked_signal", 0, 1);
    AddIFParameterInt64(0LL);
    CallInterfaceFunction("switch_off_by_locked_signal (system_power_mode_next=0)");
    if(_fct_DoStop(EVerdBOF_TC, 0))
    {
      return;
    }
  }
  {
    CreateTTEIFFunction("switch_on_by_door_open_signal_when_ign_off", 0, 1);
    AddIFParameterInt64(0LL);
    AddIFParameterSignal(CAN::dbNode::BCM::BCM1::DriverDoorSts);
    AddIFParameterInt64(3LL);
    CallInterfaceFunction("switch_on_by_door_open_signal_when_ign_off (PosLmpSts_value=0, door_open_signal=DriverDoorSts, color_mode=3)");
    if(_fct_DoStop(EVerdBOF_TC, 0))
    {
      return;
    }
  }
  {
    CreateTTEIFFunction("change_color_mode_by_pin4_then_decide_power_mode", 0, 1);
    AddIFParameterInt64(2LL);
    AddIFParameterInt64(0LL);
    AddIFParameterInt64(10LL);
    AddIFParameterInt64(0LL);
    AddIFParameterInt64(0LL);
    CallInterfaceFunction("change_color_mode_by_pin4_then_decide_power_mode (color_mode=2, system_power_mode_next=0, light_level=10, pos_lamp_sts=0, driving_mode=0)");
    if(_fct_DoStop(EVerdBOF_TC, 0))
    {
      return;
    }
  }
  {
    CreateTTEIFFunction("switch_off_by_locked_signal", 0, 1);
    AddIFParameterInt64(0LL);
    CallInterfaceFunction("switch_off_by_locked_signal (system_power_mode_next=0)");
    if(_fct_DoStop(EVerdBOF_TC, 0))
    {
      return;
    }
  }
  {
    CreateTTEIFFunction("switch_on_by_door_open_signal_when_ign_off", 0, 1);
    AddIFParameterInt64(0LL);
    AddIFParameterSignal(CAN::dbNode::BCM::BCM1::DriverDoorSts);
    AddIFParameterInt64(2LL);
    CallInterfaceFunction("switch_on_by_door_open_signal_when_ign_off (PosLmpSts_value=0, door_open_signal=DriverDoorSts, color_mode=2)");
    if(_fct_DoStop(EVerdBOF_TC, 0))
    {
      return;
    }
  }
  {
    CreateTTEIFFunction("switch_off_by_locked_signal", 0, 1);
    AddIFParameterInt64(0LL);
    CallInterfaceFunction("switch_off_by_locked_signal (system_power_mode_next=0)");
    if(_fct_DoStop(EVerdBOF_TC, 0))
    {
      return;
    }
  }
}
// _ttg_#_3_0_1_8
// TEST5:If all doors are closed and any doors are open again,then the time 20s will be recalculated from door open
testcase _ttg_tc_tc_3_0_1_10()
{
  TestCaseTitle("", "TEST5:If all doors are closed and any doors are open again,then the time 20s will be recalculated from door open");
  TestCommandBegin("Report", "");
  {
    testStep(2, "", "TEST:If all doors are closed and any doors are open again,then the time 20s will be recalculated from door open");
  }
  // _ttg_!_3_0_1_10_2
  TestCommandEnd();
  if(_fct_DoStop(EVerdBOF_TC, 0))
  {
    return;
  }
  {
    CreateTTEIFFunction("switch_on_by_door_open_signal_when_ign_off", 0, 1);
    AddIFParameterInt64(0LL);
    AddIFParameterSignal(CAN::dbNode::BCM::BCM1::PassengerDoorSts);
    AddIFParameterInt64(2LL);
    CallInterfaceFunction("switch_on_by_door_open_signal_when_ign_off (PosLmpSts_value=0, door_open_signal=PassengerDoorSts, color_mode=2)");
    if(_fct_DoStop(EVerdBOF_TC, 0))
    {
      return;
    }
  }
  TestCommandBegin("Wait", "Make it lighten for 10s");
  {
    _fct_Wait("1", (int64)(10LL * 1000000000LL), 1000000000, "");
  }
  // _ttg_!_3_0_1_10_4
  TestCommandEnd();
  if(_fct_DoStop(EVerdBOF_TC, 0))
  {
    return;
  }
  {
    CreateTTEIFFunction("switch_on_by_door_open_signal_when_ign_off", 0, 1);
    AddIFParameterInt64(0LL);
    AddIFParameterSignal(CAN::dbNode::BCM::BCM1::RLDoorSts);
    AddIFParameterInt64(2LL);
    CallInterfaceFunction("switch_on_by_door_open_signal_when_ign_off (PosLmpSts_value=0, door_open_signal=RLDoorSts, color_mode=2)");
    if(_fct_DoStop(EVerdBOF_TC, 0))
    {
      return;
    }
  }
  TestCommandBegin("Wait", "");
  {
    _fct_Wait("1", (int64)(18LL * 1000000000LL), 1000000000, "");
  }
  // _ttg_!_3_0_1_10_6
  TestCommandEnd();
  if(_fct_DoStop(EVerdBOF_TC, 0))
  {
    return;
  }
  {
    CreateTTEIFFunction("check_color_mode_when_ALCMLightLvlSet_inactived", 0, 1);
    AddIFParameterInt64(2LL);
    CallInterfaceFunction("check_color_mode_when_ALCMLightLvlSet_inactived (color_mode=2)");
    if(_fct_DoStop(EVerdBOF_TC, 0))
    {
      return;
    }
  }
  TestCommandBegin("Wait", "");
  {
    _fct_Wait("1", (int64)(3LL * 1000000000LL), 1000000000, "");
  }
  // _ttg_!_3_0_1_10_8
  TestCommandEnd();
  if(_fct_DoStop(EVerdBOF_TC, 0))
  {
    return;
  }
  {
    CreateTTEIFFunction("switch_off_by_time_ms", 0, 1);
    AddIFParameterInt64(0LL);
    AddIFParameterInt64(0LL);
    CallInterfaceFunction("switch_off_by_time_ms (wait_for_switch_off=0, need_close_door_or_not=0)");
    if(_fct_DoStop(EVerdBOF_TC, 0))
    {
      return;
    }
  }
}
// _ttg_#_3_0_1_10
// TEST6:If received ACC or IGN ON signal during light 20s,ambient light will be continuously switched on
testcase _ttg_tc_tc_3_0_1_12()
{
  TestCaseTitle("", "TEST6:If received ACC or IGN ON signal during light 20s,ambient light will be continuously switched on");
  TestCommandBegin("Report", "");
  {
    testStep(2, "", "TEST:If received ACC or IGN ON signal during light 20s,ambient light will be continuously switched on");
  }
  // _ttg_!_3_0_1_12_2
  TestCommandEnd();
  if(_fct_DoStop(EVerdBOF_TC, 0))
  {
    return;
  }
  {
    CreateTTEIFFunction("switch_on_by_door_open_signal_when_ign_off", 0, 1);
    AddIFParameterInt64(0LL);
    AddIFParameterSignal(CAN::dbNode::BCM::BCM1::DriverDoorSts);
    AddIFParameterInt64(2LL);
    CallInterfaceFunction("switch_on_by_door_open_signal_when_ign_off (PosLmpSts_value=0, door_open_signal=DriverDoorSts, color_mode=2)");
    if(_fct_DoStop(EVerdBOF_TC, 0))
    {
      return;
    }
  }
  _ttg_verdict = -1;
  {
    // begin of for block
    {
      int64 _ttg_var_startvalue_3_0_1_12_4_2;
      int64 _ttg_var_stopvalue_3_0_1_12_4_3;
      int64 _ttg_var_increment_3_0_1_12_4_4;
      _ttg_var_startvalue_3_0_1_12_4_2 = 2LL;
      _ttg_var_stopvalue_3_0_1_12_4_3 = 1LL;
      _ttg_var_increment_3_0_1_12_4_4 = -1LL;
      for(_ttg_var_i_3_0_1_12_4 = _ttg_var_startvalue_3_0_1_12_4_2; (_ttg_var_increment_3_0_1_12_4_4<0)?(_ttg_var_i_3_0_1_12_4 >= _ttg_var_stopvalue_3_0_1_12_4_3):(_ttg_var_i_3_0_1_12_4 <= _ttg_var_stopvalue_3_0_1_12_4_3); _ttg_var_i_3_0_1_12_4 += _ttg_var_increment_3_0_1_12_4_4)
      {
        snprintf(_ttg_B, 2000, "For (For i=2..1, increment=-1; current i = %I64d)", _ttg_var_i_3_0_1_12_4);
        if(_fct_LoopIsBlocking())
        {
          _fct_CommandVerdict(1);
          break;
        }
        TestControlStructBegin("For", _ttg_B);
        TestCommandBegin("Wait", "");
        {
          _fct_Wait("1", (int64)(5LL * 1000000000LL), 1000000000, "");
        }
        // _ttg_!_3_0_1_12_4_5
        TestCommandEnd();
        if(_fct_DoStop(EVerdBOF_TC, 0))
        {
          _fct_TestControlStructEnd(1);
          return;
        }
        TestCommandBegin("Set", "");
        {
          _fct_TiTableHeadAssignment();
          _fct_Set(CAN::dbNode::PEPS::PEPS2::SystemPowerMode, "CAN signal \'SystemPowerMode\'", _ttg_var_i_3_0_1_12_4, "i");
          _fct_TiTableEnd("1", 0, 0);
        }
        // _ttg_!_3_0_1_12_4_6
        TestCommandEnd();
        if(_fct_DoStop(EVerdBOF_TC, 0))
        {
          _fct_TestControlStructEnd(1);
          return;
        }
        TestCommandBegin("Wait", "");
        {
          _fct_Wait("1", (int64)(30LL * 1000000000LL), 1000000000, "");
        }
        // _ttg_!_3_0_1_12_4_7
        TestCommandEnd();
        if(_fct_DoStop(EVerdBOF_TC, 0))
        {
          _fct_TestControlStructEnd(1);
          return;
        }
        {
          CreateTTEIFFunction("check_color_mode_when_ALCMLightLvlSet_actived", 0, 1);
          AddIFParameterInt64(2LL);
          CallInterfaceFunction("check_color_mode_when_ALCMLightLvlSet_actived (color_mode=2)");
          if(_fct_DoStop(EVerdBOF_TC, 0))
          {
            _fct_TestControlStructEnd(1);
            return;
          }
        }
        TestCommandBegin("Set", "");
        {
          _fct_TiTableHeadAssignment();
          _fct_Set(CAN::dbNode::PEPS::PEPS2::SystemPowerMode, "CAN signal \'SystemPowerMode\'", 0LL, "");
          _fct_TiTableEnd("1", 0, 0);
        }
        // _ttg_!_3_0_1_12_4_9
        TestCommandEnd();
        if(_fct_DoStop(EVerdBOF_TC, 0))
        {
          _fct_TestControlStructEnd(1);
          return;
        }
        TestCommandBegin("Wait", "");
        {
          _fct_Wait("1", (int64)(200LL * 1000000LL), 1000000, "");
        }
        // _ttg_!_3_0_1_12_4_10
        TestCommandEnd();
        if(_fct_DoStop(EVerdBOF_TC, 0))
        {
          _fct_TestControlStructEnd(1);
          return;
        }
        _fct_TestControlStructEnd(1);
      }
    }
    // end of for block
  }
  // _ttg_!_3_0_1_12_4
  if(_fct_DoStop(EVerdBOF_TC, 0))
  {
    return;
  }
  {
    CreateTTEIFFunction("switch_off_by_locked_signal", 0, 1);
    AddIFParameterInt64(0LL);
    CallInterfaceFunction("switch_off_by_locked_signal (system_power_mode_next=0)");
    if(_fct_DoStop(EVerdBOF_TC, 0))
    {
      return;
    }
  }
}
// _ttg_#_3_0_1_12
// TEST7:If received ACC or IGN ON signal after 20s,ambient light will be shutted down and switched on last saved color and luminance in 1s
testcase _ttg_tc_tc_3_0_1_14()
{
  TestCaseTitle("", "TEST7:If received ACC or IGN ON signal after 20s,ambient light will be shutted down and switched on last saved color and luminance in 1s");
  TestCommandBegin("Report", "");
  {
    testStep(2, "", "TEST:If received ACC or IGN ON signal after 20s,ambient light will be shutted down and switched on last saved color and luminance in 1s");
  }
  // _ttg_!_3_0_1_14_2
  TestCommandEnd();
  if(_fct_DoStop(EVerdBOF_TC, 0))
  {
    return;
  }
  {
    CreateTTEIFFunction("switch_on_by_door_open_signal_when_ign_off", 0, 1);
    AddIFParameterInt64(0LL);
    AddIFParameterSignal(CAN::dbNode::BCM::BCM1::PassengerDoorSts);
    AddIFParameterInt64(2LL);
    CallInterfaceFunction("switch_on_by_door_open_signal_when_ign_off (PosLmpSts_value=0, door_open_signal=PassengerDoorSts, color_mode=2)");
    if(_fct_DoStop(EVerdBOF_TC, 0))
    {
      return;
    }
  }
  {
    CreateTTEIFFunction("switch_off_by_time_ms", 0, 1);
    AddIFParameterInt64(23000LL);
    AddIFParameterInt64(0LL);
    CallInterfaceFunction("switch_off_by_time_ms (wait_for_switch_off=23000, need_close_door_or_not=0)");
    if(_fct_DoStop(EVerdBOF_TC, 0))
    {
      return;
    }
  }
  _ttg_verdict = -1;
  {
    // begin of for block
    {
      int64 _ttg_var_startvalue_3_0_1_14_5_2;
      int64 _ttg_var_stopvalue_3_0_1_14_5_3;
      int64 _ttg_var_increment_3_0_1_14_5_4;
      _ttg_var_startvalue_3_0_1_14_5_2 = 2LL;
      _ttg_var_stopvalue_3_0_1_14_5_3 = 1LL;
      _ttg_var_increment_3_0_1_14_5_4 = -1LL;
      for(_ttg_var_i_3_0_1_14_5 = _ttg_var_startvalue_3_0_1_14_5_2; (_ttg_var_increment_3_0_1_14_5_4<0)?(_ttg_var_i_3_0_1_14_5 >= _ttg_var_stopvalue_3_0_1_14_5_3):(_ttg_var_i_3_0_1_14_5 <= _ttg_var_stopvalue_3_0_1_14_5_3); _ttg_var_i_3_0_1_14_5 += _ttg_var_increment_3_0_1_14_5_4)
      {
        snprintf(_ttg_B, 2000, "For (For i=2..1, increment=-1; current i = %I64d)", _ttg_var_i_3_0_1_14_5);
        if(_fct_LoopIsBlocking())
        {
          _fct_CommandVerdict(1);
          break;
        }
        TestControlStructBegin("For", _ttg_B);
        TestCommandBegin("Set", "");
        {
          _fct_TiTableHeadAssignment();
          _fct_Set(CAN::dbNode::PEPS::PEPS2::SystemPowerMode, "CAN signal \'SystemPowerMode\'", _ttg_var_i_3_0_1_14_5, "i");
          _fct_TiTableEnd("1", 0, 0);
        }
        // _ttg_!_3_0_1_14_5_5
        TestCommandEnd();
        if(_fct_DoStop(EVerdBOF_TC, 0))
        {
          _fct_TestControlStructEnd(1);
          return;
        }
        TestCommandBegin("Wait", "");
        {
          _fct_Wait("1", (int64)(2LL * 1000000000LL), 1000000000, "");
        }
        // _ttg_!_3_0_1_14_5_6
        TestCommandEnd();
        if(_fct_DoStop(EVerdBOF_TC, 0))
        {
          _fct_TestControlStructEnd(1);
          return;
        }
        {
          CreateTTEIFFunction("check_color_mode_when_ALCMLightLvlSet_actived", 0, 1);
          AddIFParameterInt64(2LL);
          CallInterfaceFunction("check_color_mode_when_ALCMLightLvlSet_actived (color_mode=2)");
          if(_fct_DoStop(EVerdBOF_TC, 0))
          {
            _fct_TestControlStructEnd(1);
            return;
          }
        }
        {
          CreateTTEIFFunction("switch_off_by_locked_signal", 0, 1);
          AddIFParameterInt64(0LL);
          CallInterfaceFunction("switch_off_by_locked_signal (system_power_mode_next=0)");
          if(_fct_DoStop(EVerdBOF_TC, 0))
          {
            _fct_TestControlStructEnd(1);
            return;
          }
        }
        TestCommandBegin("Wait", "");
        {
          _fct_Wait("1", (int64)(100LL * 1000000LL), 1000000, "");
        }
        // _ttg_!_3_0_1_14_5_9
        TestCommandEnd();
        if(_fct_DoStop(EVerdBOF_TC, 0))
        {
          _fct_TestControlStructEnd(1);
          return;
        }
        _fct_TestControlStructEnd(1);
      }
    }
    // end of for block
  }
  // _ttg_!_3_0_1_14_5
  if(_fct_DoStop(EVerdBOF_TC, 0))
  {
    return;
  }
}
// _ttg_#_3_0_1_14
// TEST8:When IGN is OFF,if there is no color output (color mode is MODE 0) during last shut down, once received door open status and ALCM can not switch on ambient light. 
testcase _ttg_tc_tc_3_0_1_16()
{
  TestCaseTitle("", "TEST8:When IGN is OFF,if there is no color output (color mode is MODE 0) during last shut down, once received door open status and ALCM can not switch on ambient light. ");
  TestCommandBegin("Report", "");
  {
    testStep(2, "", "TEST8:When IGN is OFF,if there is no color output (color mode is MODE 0) during last shut down, once received door open status and ALCM can not switch on ambient light.");
  }
  // _ttg_!_3_0_1_16_2
  TestCommandEnd();
  if(_fct_DoStop(EVerdBOF_TC, 0))
  {
    return;
  }
  {
    CreateTTEIFFunction("switch_on_by_door_open_signal_when_ign_off", 0, 1);
    AddIFParameterInt64(0LL);
    AddIFParameterSignal(CAN::dbNode::BCM::BCM1::RLDoorSts);
    AddIFParameterInt64(2LL);
    CallInterfaceFunction("switch_on_by_door_open_signal_when_ign_off (PosLmpSts_value=0, door_open_signal=RLDoorSts, color_mode=2)");
    if(_fct_DoStop(EVerdBOF_TC, 0))
    {
      return;
    }
  }
  {
    CreateTTEIFFunction("enter_mode0_by_pin4_then_decide_power_mode", 0, 1);
    AddIFParameterInt64(0LL);
    AddIFParameterInt64(10LL);
    AddIFParameterInt64(0LL);
    AddIFParameterInt64(0LL);
    AddIFParameterInt64(10LL);
    AddIFParameterInt64(0LL);
    AddIFParameterInt64(0LL);
    CallInterfaceFunction("enter_mode0_by_pin4_then_decide_power_mode (system_power_mode_next=0, light_level=10, pos_lamp_sts=0, driving_mode=0, light_level_next=10, pos_lamp_sts_next=0, driving_mode_next=0)");
    if(_fct_DoStop(EVerdBOF_TC, 0))
    {
      return;
    }
  }
  {
    CreateTTEIFFunction("switch_on_by_door_open_signal_when_ign_off", 0, 1);
    AddIFParameterInt64(0LL);
    AddIFParameterSignal(CAN::dbNode::BCM::BCM1::DriverDoorSts);
    AddIFParameterInt64(0LL);
    CallInterfaceFunction("switch_on_by_door_open_signal_when_ign_off (PosLmpSts_value=0, door_open_signal=DriverDoorSts, color_mode=0)");
    if(_fct_DoStop(EVerdBOF_TC, 0))
    {
      return;
    }
  }
  {
    CreateTTEIFFunction("switch_on_by_door_open_signal_when_ign_off", 0, 1);
    AddIFParameterInt64(0LL);
    AddIFParameterSignal(CAN::dbNode::BCM::BCM1::PassengerDoorSts);
    AddIFParameterInt64(0LL);
    CallInterfaceFunction("switch_on_by_door_open_signal_when_ign_off (PosLmpSts_value=0, door_open_signal=PassengerDoorSts, color_mode=0)");
    if(_fct_DoStop(EVerdBOF_TC, 0))
    {
      return;
    }
  }
  {
    CreateTTEIFFunction("switch_on_by_door_open_signal_when_ign_off", 0, 1);
    AddIFParameterInt64(0LL);
    AddIFParameterSignal(CAN::dbNode::BCM::BCM1::RLDoorSts);
    AddIFParameterInt64(0LL);
    CallInterfaceFunction("switch_on_by_door_open_signal_when_ign_off (PosLmpSts_value=0, door_open_signal=RLDoorSts, color_mode=0)");
    if(_fct_DoStop(EVerdBOF_TC, 0))
    {
      return;
    }
  }
  {
    CreateTTEIFFunction("switch_on_by_door_open_signal_when_ign_off", 0, 1);
    AddIFParameterInt64(0LL);
    AddIFParameterSignal(CAN::dbNode::BCM::BCM1::RRDoorSts);
    AddIFParameterInt64(0LL);
    CallInterfaceFunction("switch_on_by_door_open_signal_when_ign_off (PosLmpSts_value=0, door_open_signal=RRDoorSts, color_mode=0)");
    if(_fct_DoStop(EVerdBOF_TC, 0))
    {
      return;
    }
  }
}
// _ttg_#_3_0_1_16
// TEST1:Ambient light is Mode0,when power mode is ACC,then ALCM can not switch on ambient light.
testcase _ttg_tc_tc_3_0_2_3()
{
  TestCaseTitle("", "TEST1:Ambient light is Mode0,when power mode is ACC,then ALCM can not switch on ambient light.");
  TestCommandBegin("Report", "");
  {
    testStep(2, "", "TEST:Ambient light is Mode0,when power mode is ACC,then ALCM can not switch on ambient light.");
  }
  // _ttg_!_3_0_2_3_2
  TestCommandEnd();
  if(_fct_DoStop(EVerdBOF_TC, 0))
  {
    return;
  }
  TestCommandBegin("Set", "");
  {
    _fct_TiTableHeadAssignment();
    _fct_Set(CAN::dbNode::PEPS::PEPS2::SystemPowerMode, "CAN signal \'SystemPowerMode\'", 1LL, "ACC");
    _fct_Set(CAN::dbNode::BCM::BCM1::PosLmpSts, "CAN signal \'PosLmpSts\'", 0LL, "OFF");
    _fct_Set(CAN::dbNode::HUT::HUT8::ALCMLightLvlSet, "CAN signal \'ALCMLightLvlSet\'", 10LL, "");
    _fct_TiTableEnd("1", 0, 0);
  }
  // _ttg_!_3_0_2_3_3
  TestCommandEnd();
  if(_fct_DoStop(EVerdBOF_TC, 0))
  {
    return;
  }
  TestCommandBegin("Wait", "");
  {
    _fct_Wait("1", (int64)(100LL * 1000000LL), 1000000, "");
  }
  // _ttg_!_3_0_2_3_4
  TestCommandEnd();
  if(_fct_DoStop(EVerdBOF_TC, 0))
  {
    return;
  }
  {
    CreateTTEIFFunction("check_color_mode_when_ALCMLightLvlSet_inactived", 0, 1);
    AddIFParameterInt64(0LL);
    CallInterfaceFunction("check_color_mode_when_ALCMLightLvlSet_inactived (color_mode=0)");
    if(_fct_DoStop(EVerdBOF_TC, 0))
    {
      return;
    }
  }
  TestCommandBegin("Set", "");
  {
    _fct_TiTableHeadAssignment();
    _fct_Set(CAN::dbNode::PEPS::PEPS2::SystemPowerMode, "CAN signal \'SystemPowerMode\'", 0LL, "OFF");
    _fct_TiTableEnd("1", 0, 0);
  }
  // _ttg_!_3_0_2_3_6
  TestCommandEnd();
  if(_fct_DoStop(EVerdBOF_TC, 0))
  {
    return;
  }
}
// _ttg_#_3_0_2_3
// TEST2:If IGN is ON,receive and deal with all CAN bus signals.
testcase _ttg_tc_tc_3_0_2_5()
{
  TestCaseTitle("", "TEST2:If IGN is ON,receive and deal with all CAN bus signals.");
  TestCommandBegin("Report", "");
  {
    testStep(2, "", "TEST:If IGN is ON,receive and deal with all CAN bus signals.");
  }
  // _ttg_!_3_0_2_5_2
  TestCommandEnd();
  if(_fct_DoStop(EVerdBOF_TC, 0))
  {
    return;
  }
  TestCommandBegin("Wait", "");
  {
    _fct_Wait("1", (int64)(2LL * 1000000000LL), 1000000000, "");
  }
  // _ttg_!_3_0_2_5_3
  TestCommandEnd();
  if(_fct_DoStop(EVerdBOF_TC, 0))
  {
    return;
  }
  {
    CreateTTEIFFunction("change_color_mode_by_pin4_then_decide_power_mode", 0, 1);
    AddIFParameterInt64(2LL);
    AddIFParameterInt64(2LL);
    AddIFParameterInt64(10LL);
    AddIFParameterInt64(0LL);
    AddIFParameterInt64(0LL);
    CallInterfaceFunction("change_color_mode_by_pin4_then_decide_power_mode (color_mode=2, system_power_mode_next=2, light_level=10, pos_lamp_sts=0, driving_mode=0)");
    if(_fct_DoStop(EVerdBOF_TC, 0))
    {
      return;
    }
  }
  {
    CreateTTEIFFunction("change_color_mode_by_pin4_then_decide_power_mode", 0, 1);
    AddIFParameterInt64(3LL);
    AddIFParameterInt64(2LL);
    AddIFParameterInt64(10LL);
    AddIFParameterInt64(0LL);
    AddIFParameterInt64(0LL);
    CallInterfaceFunction("change_color_mode_by_pin4_then_decide_power_mode (color_mode=3, system_power_mode_next=2, light_level=10, pos_lamp_sts=0, driving_mode=0)");
    if(_fct_DoStop(EVerdBOF_TC, 0))
    {
      return;
    }
  }
  _ttg_verdict = -1;
  {
    // begin of for block
    {
      int64 _ttg_var_startvalue_3_0_2_5_6_2;
      int64 _ttg_var_stopvalue_3_0_2_5_6_3;
      int64 _ttg_var_increment_3_0_2_5_6_4;
      _ttg_var_startvalue_3_0_2_5_6_2 = 10LL;
      _ttg_var_stopvalue_3_0_2_5_6_3 = 0LL;
      _ttg_var_increment_3_0_2_5_6_4 = -1LL;
      for(_ttg_var_i_3_0_2_5_6 = _ttg_var_startvalue_3_0_2_5_6_2; (_ttg_var_increment_3_0_2_5_6_4<0)?(_ttg_var_i_3_0_2_5_6 >= _ttg_var_stopvalue_3_0_2_5_6_3):(_ttg_var_i_3_0_2_5_6 <= _ttg_var_stopvalue_3_0_2_5_6_3); _ttg_var_i_3_0_2_5_6 += _ttg_var_increment_3_0_2_5_6_4)
      {
        snprintf(_ttg_B, 2000, "For (For i=10..0, increment=-1; current i = %I64d)", _ttg_var_i_3_0_2_5_6);
        if(_fct_LoopIsBlocking())
        {
          _fct_CommandVerdict(1);
          break;
        }
        TestControlStructBegin("For", _ttg_B);
        TestCommandBegin("Set", "");
        {
          _fct_TiTableHeadAssignment();
          _fct_Set(CAN::dbNode::HUT::HUT8::ALCMLightLvlSet, "CAN signal \'ALCMLightLvlSet\'", _ttg_var_i_3_0_2_5_6, "i");
          _fct_TiTableEnd("1", 0, 0);
        }
        // _ttg_!_3_0_2_5_6_5
        TestCommandEnd();
        if(_fct_DoStop(EVerdBOF_TC, 0))
        {
          _fct_TestControlStructEnd(1);
          return;
        }
        TestCommandBegin("Wait", "");
        {
          _fct_Wait("1", (int64)(2LL * 1000000000LL), 1000000000, "");
        }
        // _ttg_!_3_0_2_5_6_6
        TestCommandEnd();
        if(_fct_DoStop(EVerdBOF_TC, 0))
        {
          _fct_TestControlStructEnd(1);
          return;
        }
        {
          CreateTTEIFFunction("check_color_mode_when_ALCMLightLvlSet_actived", 0, 1);
          AddIFParameterInt64(3LL);
          CallInterfaceFunction("check_color_mode_when_ALCMLightLvlSet_actived (color_mode=3)");
          if(_fct_DoStop(EVerdBOF_TC, 0))
          {
            _fct_TestControlStructEnd(1);
            return;
          }
        }
        _fct_TestControlStructEnd(1);
      }
    }
    // end of for block
  }
  // _ttg_!_3_0_2_5_6
  if(_fct_DoStop(EVerdBOF_TC, 0))
  {
    return;
  }
  TestCommandBegin("Set", "Reset ALCMLightLvlSet=10");
  {
    _fct_TiTableHeadAssignment();
    _fct_Set(CAN::dbNode::HUT::HUT8::ALCMLightLvlSet, "CAN signal \'ALCMLightLvlSet\'", 10LL, "");
    _fct_TiTableEnd("1", 0, 0);
  }
  // _ttg_!_3_0_2_5_7
  TestCommandEnd();
  if(_fct_DoStop(EVerdBOF_TC, 0))
  {
    return;
  }
  _ttg_verdict = -1;
  {
    // begin of for block
    {
      int64 _ttg_var_startvalue_3_0_2_5_8_2;
      int64 _ttg_var_stopvalue_3_0_2_5_8_3;
      int64 _ttg_var_increment_3_0_2_5_8_4;
      _ttg_var_startvalue_3_0_2_5_8_2 = 0LL;
      _ttg_var_stopvalue_3_0_2_5_8_3 = 15LL;
      _ttg_var_increment_3_0_2_5_8_4 = 1LL;
      for(_ttg_var_i_3_0_2_5_8 = _ttg_var_startvalue_3_0_2_5_8_2; (_ttg_var_increment_3_0_2_5_8_4<0)?(_ttg_var_i_3_0_2_5_8 >= _ttg_var_stopvalue_3_0_2_5_8_3):(_ttg_var_i_3_0_2_5_8 <= _ttg_var_stopvalue_3_0_2_5_8_3); _ttg_var_i_3_0_2_5_8 += _ttg_var_increment_3_0_2_5_8_4)
      {
        snprintf(_ttg_B, 2000, "For (For i=0..15, increment=1; current i = %I64d)", _ttg_var_i_3_0_2_5_8);
        if(_fct_LoopIsBlocking())
        {
          _fct_CommandVerdict(1);
          break;
        }
        TestControlStructBegin("For", _ttg_B);
        _ttg_verdict = -1;
        TestControlStructBegin("If", "");
        {
          int bCondition, bDone;
          bDone = 0;
          {
            {
              bCondition = ((_ttg_var_i_3_0_2_5_8==0LL) || (_ttg_var_i_3_0_2_5_8==1LL) || (_ttg_var_i_3_0_2_5_8==3LL) || (_ttg_var_i_3_0_2_5_8==4LL) || (_ttg_var_i_3_0_2_5_8==9LL) || (_ttg_var_i_3_0_2_5_8==10LL) || (_ttg_var_i_3_0_2_5_8==11LL) || (_ttg_var_i_3_0_2_5_8==13LL));
            }
            _fct_ConditionTableHead("If ( i one of [0;1;3;4;9;10;11;13;] )", bCondition);
            _fct_ChckRep(0, _ttg_var_i_3_0_2_5_8, "Variable \'i\'", "OneOf", "0; 1; 3; 4; 9; 10; 11; 13;", "");
            _fct_TiCellResultTrueFalse(((_ttg_var_i_3_0_2_5_8==0LL) || (_ttg_var_i_3_0_2_5_8==1LL) || (_ttg_var_i_3_0_2_5_8==3LL) || (_ttg_var_i_3_0_2_5_8==4LL) || (_ttg_var_i_3_0_2_5_8==9LL) || (_ttg_var_i_3_0_2_5_8==10LL) || (_ttg_var_i_3_0_2_5_8==11LL) || (_ttg_var_i_3_0_2_5_8==13LL)));
            _fct_TiTableEnd("", 0, 2);
            if(bCondition)
            {
              bDone = 1;
              TestCommandBegin("Set", "");
              {
                _fct_TiTableHeadAssignment();
                _fct_Set(CAN::dbNode::BCM::BCM8::DrivingModeReq, "CAN signal \'DrivingModeReq\'", _ttg_var_i_3_0_2_5_8, "i");
                _fct_Set(CAN::dbNode::BCM::BCM1::PosLmpSts, "CAN signal \'PosLmpSts\'", 0LL, "");
                _fct_TiTableEnd("1", 0, 0);
              }
              // _ttg_!_3_0_2_5_8_5_2
              TestCommandEnd();
              if(_fct_DoStop(EVerdBOF_TC, 0))
              {
                _fct_TestControlStructEnd(2);
                return;
              }
              _ttg_verdict = -1;
              TestControlStructBegin("If", "");
              {
                int bCondition, bDone;
                bDone = 0;
                {
                  {
                    bCondition = (_ttg_var_i_3_0_2_5_8>=4LL);
                  }
                  _fct_ConditionTableHead("If ( i>=4 )", bCondition);
                  _fct_ChckRep(0, _ttg_var_i_3_0_2_5_8, "Variable \'i\'", ">=", 4LL, "");
                  _fct_TiCellResultTrueFalse((_ttg_var_i_3_0_2_5_8>=4LL));
                  _fct_TiTableEnd("", 0, 2);
                  if(bCondition)
                  {
                    bDone = 1;
                    TestCommandBegin("Wait", "");
                    {
                      _fct_Wait("1", (int64)(3LL * 1000000000LL), 1000000000, "");
                    }
                    // _ttg_!_3_0_2_5_8_5_3_2
                    TestCommandEnd();
                    if(_fct_DoStop(EVerdBOF_TC, 0))
                    {
                      _fct_TestControlStructEnd(3);
                      return;
                    }
                  }
                }
                // _ttg_!_3_0_2_5_8_5_3
                _fct_TestControlStructEnd(1);
                if(_fct_DoStop(EVerdBOF_TC, 0))
                {
                  _fct_TestControlStructEnd(2);
                  return;
                }
                _ttg_verdict = -1;
                TestControlStructBegin("Else", "");
                {
                  if(_fct_DoElse(bDone))
                  {
                    bDone = 1;
                    TestCommandBegin("Wait", "");
                    {
                      _fct_Wait("1", (int64)(2LL * 1000000000LL), 1000000000, "");
                    }
                    // _ttg_!_3_0_2_5_8_5_4_1
                    TestCommandEnd();
                    if(_fct_DoStop(EVerdBOF_TC, 0))
                    {
                      _fct_TestControlStructEnd(3);
                      return;
                    }
                  }
                }
              }
              // _ttg_!_3_0_2_5_8_5_4
              _fct_TestControlStructEnd(1);
              if(_fct_DoStop(EVerdBOF_TC, 0))
              {
                _fct_TestControlStructEnd(2);
                return;
              }
              {
                CreateTTEIFFunction("check_color_mode_when_DrivingModeReq_actived", 0, 1);
                AddIFParameterChar("\"blue\"");
                CallInterfaceFunction("check_color_mode_when_DrivingModeReq_actived (color_should_be=\"blue\")");
                if(_fct_DoStop(EVerdBOF_TC, 0))
                {
                  _fct_TestControlStructEnd(2);
                  return;
                }
              }
              TestCommandBegin("Set", "");
              {
                _fct_TiTableHeadAssignment();
                _fct_Set(CAN::dbNode::BCM::BCM1::PosLmpSts, "CAN signal \'PosLmpSts\'", 1LL, "");
                _fct_TiTableEnd("1", 0, 0);
              }
              // _ttg_!_3_0_2_5_8_5_6
              TestCommandEnd();
              if(_fct_DoStop(EVerdBOF_TC, 0))
              {
                _fct_TestControlStructEnd(2);
                return;
              }
              TestCommandBegin("Wait", "");
              {
                _fct_Wait("1", (int64)(2LL * 1000000000LL), 1000000000, "");
              }
              // _ttg_!_3_0_2_5_8_5_7
              TestCommandEnd();
              if(_fct_DoStop(EVerdBOF_TC, 0))
              {
                _fct_TestControlStructEnd(2);
                return;
              }
              {
                CreateTTEIFFunction("check_color_mode_when_DrivingModeReq_actived", 0, 1);
                AddIFParameterChar("\"blue\"");
                CallInterfaceFunction("check_color_mode_when_DrivingModeReq_actived (color_should_be=\"blue\")");
                if(_fct_DoStop(EVerdBOF_TC, 0))
                {
                  _fct_TestControlStructEnd(2);
                  return;
                }
              }
            }
          }
        }
        // _ttg_!_3_0_2_5_8_5
        _fct_TestControlStructEnd(1);
        if(_fct_DoStop(EVerdBOF_TC, 0))
        {
          _fct_TestControlStructEnd(1);
          return;
        }
        _fct_TestControlStructEnd(1);
      }
    }
    // end of for block
  }
  // _ttg_!_3_0_2_5_8
  if(_fct_DoStop(EVerdBOF_TC, 0))
  {
    return;
  }
  TestCommandBegin("Set", "");
  {
    _fct_TiTableHeadAssignment();
    _fct_Set(CAN::dbNode::BCM::BCM1::PosLmpSts, "CAN signal \'PosLmpSts\'", 0LL, "OFF");
    _fct_Set(CAN::dbNode::BCM::BCM8::DrivingModeReq, "CAN signal \'DrivingModeReq\'", 0LL, "");
    _fct_TiTableEnd("1", 0, 0);
  }
  // _ttg_!_3_0_2_5_9
  TestCommandEnd();
  if(_fct_DoStop(EVerdBOF_TC, 0))
  {
    return;
  }
  TestCommandBegin("Wait", "");
  {
    _fct_Wait("1", (int64)(1LL * 1000000000LL), 1000000000, "");
  }
  // _ttg_!_3_0_2_5_10
  TestCommandEnd();
  if(_fct_DoStop(EVerdBOF_TC, 0))
  {
    return;
  }
  {
    CreateTTEIFFunction("change_color_mode_by_pin4_then_decide_power_mode", 0, 1);
    AddIFParameterInt64(2LL);
    AddIFParameterInt64(2LL);
    AddIFParameterInt64(10LL);
    AddIFParameterInt64(0LL);
    AddIFParameterInt64(0LL);
    CallInterfaceFunction("change_color_mode_by_pin4_then_decide_power_mode (color_mode=2, system_power_mode_next=2, light_level=10, pos_lamp_sts=0, driving_mode=0)");
    if(_fct_DoStop(EVerdBOF_TC, 0))
    {
      return;
    }
  }
}
// _ttg_#_3_0_2_5
// TEST3:Ambient light is switched off by time,locked signal or power supply off,when power mode is ACC,then ALCM can switch on last saved color and luminance in 1s by dimming
testcase _ttg_tc_tc_3_0_2_7()
{
  TestCaseTitle("", "TEST3:Ambient light is switched off by time,locked signal or power supply off,when power mode is ACC,then ALCM can switch on last saved color and luminance in 1s by dimming");
  TestCommandBegin("Report", "");
  {
    testStep(2, "", "TEST:Ambient light is switched off by time,locked signal or power supply off,when power mode is ACC,then ALCM can switch on last saved color and luminance in 1s by dimming");
  }
  // _ttg_!_3_0_2_7_2
  TestCommandEnd();
  if(_fct_DoStop(EVerdBOF_TC, 0))
  {
    return;
  }
  {
    CreateTTEIFFunction("switch_off_by_locked_signal", 0, 1);
    AddIFParameterInt64(1LL);
    CallInterfaceFunction("switch_off_by_locked_signal (system_power_mode_next=1)");
    if(_fct_DoStop(EVerdBOF_TC, 0))
    {
      return;
    }
  }
  TestCommandBegin("Set", "");
  {
    _fct_TiTableHeadAssignment();
    _fct_Set(CAN::dbNode::PEPS::PEPS2::SystemPowerMode, "CAN signal \'SystemPowerMode\'", 1LL, "ACC");
    _fct_TiTableEnd("1", 0, 0);
  }
  // _ttg_!_3_0_2_7_4
  TestCommandEnd();
  if(_fct_DoStop(EVerdBOF_TC, 0))
  {
    return;
  }
  TestCommandBegin("Wait", "");
  {
    _fct_Wait("1", (int64)(2LL * 1000000000LL), 1000000000, "");
  }
  // _ttg_!_3_0_2_7_5
  TestCommandEnd();
  if(_fct_DoStop(EVerdBOF_TC, 0))
  {
    return;
  }
  {
    CreateTTEIFFunction("check_color_mode_when_ALCMLightLvlSet_inactived", 0, 1);
    AddIFParameterInt64(2LL);
    CallInterfaceFunction("check_color_mode_when_ALCMLightLvlSet_inactived (color_mode=2)");
    if(_fct_DoStop(EVerdBOF_TC, 0))
    {
      return;
    }
  }
  {
    CreateTTEIFFunction("change_color_mode_by_pin4_then_decide_power_mode", 0, 1);
    AddIFParameterInt64(3LL);
    AddIFParameterInt64(2LL);
    AddIFParameterInt64(10LL);
    AddIFParameterInt64(0LL);
    AddIFParameterInt64(0LL);
    CallInterfaceFunction("change_color_mode_by_pin4_then_decide_power_mode (color_mode=3, system_power_mode_next=2, light_level=10, pos_lamp_sts=0, driving_mode=0)");
    if(_fct_DoStop(EVerdBOF_TC, 0))
    {
      return;
    }
  }
  {
    CreateTTEIFFunction("change_color_mode_by_pin4_then_decide_power_mode", 0, 1);
    AddIFParameterInt64(2LL);
    AddIFParameterInt64(1LL);
    AddIFParameterInt64(10LL);
    AddIFParameterInt64(0LL);
    AddIFParameterInt64(0LL);
    CallInterfaceFunction("change_color_mode_by_pin4_then_decide_power_mode (color_mode=2, system_power_mode_next=1, light_level=10, pos_lamp_sts=0, driving_mode=0)");
    if(_fct_DoStop(EVerdBOF_TC, 0))
    {
      return;
    }
  }
}
// _ttg_#_3_0_2_7
// TEST4:When Power mode is ACC,ALCM will ignore DrivingModeReq and ALCMLightLvlSet signal.
testcase _ttg_tc_tc_3_0_2_9()
{
  TestCaseTitle("", "TEST4:When Power mode is ACC,ALCM will ignore DrivingModeReq and ALCMLightLvlSet signal.");
  TestCommandBegin("Report", "");
  {
    testStep(2, "", "TEST:When Power mode is ACC,ALCM will ignore DrivingModeReq and ALCMLightLvlSet signal.");
  }
  // _ttg_!_3_0_2_9_2
  TestCommandEnd();
  if(_fct_DoStop(EVerdBOF_TC, 0))
  {
    return;
  }
  TestCommandBegin("Set", "");
  {
    _fct_TiTableHeadAssignment();
    _fct_Set(CAN::dbNode::PEPS::PEPS2::SystemPowerMode, "CAN signal \'SystemPowerMode\'", 1LL, "ACC");
    _fct_TiTableEnd("1", 0, 0);
  }
  // _ttg_!_3_0_2_9_3
  TestCommandEnd();
  if(_fct_DoStop(EVerdBOF_TC, 0))
  {
    return;
  }
  _ttg_verdict = -1;
  {
    // begin of for block
    {
      int64 _ttg_var_startvalue_3_0_2_9_4_2;
      int64 _ttg_var_stopvalue_3_0_2_9_4_3;
      int64 _ttg_var_increment_3_0_2_9_4_4;
      _ttg_var_startvalue_3_0_2_9_4_2 = 10LL;
      _ttg_var_stopvalue_3_0_2_9_4_3 = 0LL;
      _ttg_var_increment_3_0_2_9_4_4 = -1LL;
      for(_ttg_var_i_3_0_2_9_4 = _ttg_var_startvalue_3_0_2_9_4_2; (_ttg_var_increment_3_0_2_9_4_4<0)?(_ttg_var_i_3_0_2_9_4 >= _ttg_var_stopvalue_3_0_2_9_4_3):(_ttg_var_i_3_0_2_9_4 <= _ttg_var_stopvalue_3_0_2_9_4_3); _ttg_var_i_3_0_2_9_4 += _ttg_var_increment_3_0_2_9_4_4)
      {
        snprintf(_ttg_B, 2000, "For (For i=10..0, increment=-1; current i = %I64d)", _ttg_var_i_3_0_2_9_4);
        if(_fct_LoopIsBlocking())
        {
          _fct_CommandVerdict(1);
          break;
        }
        TestControlStructBegin("For", _ttg_B);
        TestCommandBegin("Set", "");
        {
          _fct_TiTableHeadAssignment();
          _fct_Set(CAN::dbNode::HUT::HUT8::ALCMLightLvlSet, "CAN signal \'ALCMLightLvlSet\'", _ttg_var_i_3_0_2_9_4, "i");
          _fct_TiTableEnd("1", 0, 0);
        }
        // _ttg_!_3_0_2_9_4_5
        TestCommandEnd();
        if(_fct_DoStop(EVerdBOF_TC, 0))
        {
          _fct_TestControlStructEnd(1);
          return;
        }
        TestCommandBegin("Wait", "");
        {
          _fct_Wait("1", (int64)(2LL * 1000000000LL), 1000000000, "");
        }
        // _ttg_!_3_0_2_9_4_6
        TestCommandEnd();
        if(_fct_DoStop(EVerdBOF_TC, 0))
        {
          _fct_TestControlStructEnd(1);
          return;
        }
        {
          CreateTTEIFFunction("check_color_mode_when_ALCMLightLvlSet_inactived", 0, 1);
          AddIFParameterInt64(2LL);
          CallInterfaceFunction("check_color_mode_when_ALCMLightLvlSet_inactived (color_mode=2)");
          if(_fct_DoStop(EVerdBOF_TC, 0))
          {
            _fct_TestControlStructEnd(1);
            return;
          }
        }
        _fct_TestControlStructEnd(1);
      }
    }
    // end of for block
  }
  // _ttg_!_3_0_2_9_4
  if(_fct_DoStop(EVerdBOF_TC, 0))
  {
    return;
  }
  TestCommandBegin("Set", "Reset ALCMLightLvlSet=10");
  {
    _fct_TiTableHeadAssignment();
    _fct_Set(CAN::dbNode::HUT::HUT8::ALCMLightLvlSet, "CAN signal \'ALCMLightLvlSet\'", 10LL, "");
    _fct_TiTableEnd("1", 0, 0);
  }
  // _ttg_!_3_0_2_9_5
  TestCommandEnd();
  if(_fct_DoStop(EVerdBOF_TC, 0))
  {
    return;
  }
  _ttg_verdict = -1;
  {
    // begin of for block
    {
      int64 _ttg_var_startvalue_3_0_2_9_6_2;
      int64 _ttg_var_stopvalue_3_0_2_9_6_3;
      int64 _ttg_var_increment_3_0_2_9_6_4;
      _ttg_var_startvalue_3_0_2_9_6_2 = 0LL;
      _ttg_var_stopvalue_3_0_2_9_6_3 = 15LL;
      _ttg_var_increment_3_0_2_9_6_4 = 1LL;
      for(_ttg_var_i_3_0_2_9_6 = _ttg_var_startvalue_3_0_2_9_6_2; (_ttg_var_increment_3_0_2_9_6_4<0)?(_ttg_var_i_3_0_2_9_6 >= _ttg_var_stopvalue_3_0_2_9_6_3):(_ttg_var_i_3_0_2_9_6 <= _ttg_var_stopvalue_3_0_2_9_6_3); _ttg_var_i_3_0_2_9_6 += _ttg_var_increment_3_0_2_9_6_4)
      {
        snprintf(_ttg_B, 2000, "For (For i=0..15, increment=1; current i = %I64d)", _ttg_var_i_3_0_2_9_6);
        if(_fct_LoopIsBlocking())
        {
          _fct_CommandVerdict(1);
          break;
        }
        TestControlStructBegin("For", _ttg_B);
        TestCommandBegin("Set", "");
        {
          _fct_TiTableHeadAssignment();
          _fct_Set(CAN::dbNode::BCM::BCM8::DrivingModeReq, "CAN signal \'DrivingModeReq\'", _ttg_var_i_3_0_2_9_6, "i");
          _fct_TiTableEnd("1", 0, 0);
        }
        // _ttg_!_3_0_2_9_6_5
        TestCommandEnd();
        if(_fct_DoStop(EVerdBOF_TC, 0))
        {
          _fct_TestControlStructEnd(1);
          return;
        }
        TestCommandBegin("Wait", "");
        {
          _fct_Wait("1", (int64)(2LL * 1000000000LL), 1000000000, "");
        }
        // _ttg_!_3_0_2_9_6_6
        TestCommandEnd();
        if(_fct_DoStop(EVerdBOF_TC, 0))
        {
          _fct_TestControlStructEnd(1);
          return;
        }
        {
          CreateTTEIFFunction("check_color_mode_when_ALCMLightLvlSet_inactived", 0, 1);
          AddIFParameterInt64(2LL);
          CallInterfaceFunction("check_color_mode_when_ALCMLightLvlSet_inactived (color_mode=2)");
          if(_fct_DoStop(EVerdBOF_TC, 0))
          {
            _fct_TestControlStructEnd(1);
            return;
          }
        }
        _fct_TestControlStructEnd(1);
      }
    }
    // end of for block
  }
  // _ttg_!_3_0_2_9_6
  if(_fct_DoStop(EVerdBOF_TC, 0))
  {
    return;
  }
  TestCommandBegin("Set", "Reset DrivingModeReq=0");
  {
    _fct_TiTableHeadAssignment();
    _fct_Set(CAN::dbNode::BCM::BCM8::DrivingModeReq, "CAN signal \'DrivingModeReq\'", 0LL, "");
    _fct_TiTableEnd("1", 0, 0);
  }
  // _ttg_!_3_0_2_9_7
  TestCommandEnd();
  if(_fct_DoStop(EVerdBOF_TC, 0))
  {
    return;
  }
}
// _ttg_#_3_0_2_9
// TEST5:Ambient light is Mode0,if the color mode is Mode0,received IGN ON signal and short or long press one time,ALCM will switch on last saved color and luminance in 1s by dimming,then will change to corresponding color and luminance by received DrivingModeReq and ALCMLightLvlSet signal.
testcase _ttg_tc_tc_3_0_2_11()
{
  TestCaseTitle("", "TEST5:Ambient light is Mode0,if the color mode is Mode0,received IGN ON signal and short or long press one time,ALCM will switch on last saved color and luminance in 1s by dimming,then will change to corresponding color and luminance by received DrivingModeReq and ALCMLightLvlSet signal.");
  TestCommandBegin("Report", "");
  {
    testStep(2, "", "TEST:Ambient light is Mode0,if the color mode is Mode0,received IGN ON signal and short or long press one time,ALCM will switch on last saved color and luminance in 1s by dimming,then will change to corresponding color and luminance by received DrivingModeReq and ALCMLightLvlSet signal.");
  }
  // _ttg_!_3_0_2_11_2
  TestCommandEnd();
  if(_fct_DoStop(EVerdBOF_TC, 0))
  {
    return;
  }
  {
    CreateTTEIFFunction("enter_mode0_by_pin4_then_decide_power_mode", 0, 1);
    AddIFParameterInt64(2LL);
    AddIFParameterInt64(10LL);
    AddIFParameterInt64(0LL);
    AddIFParameterInt64(0LL);
    AddIFParameterInt64(10LL);
    AddIFParameterInt64(1LL);
    AddIFParameterInt64(0LL);
    CallInterfaceFunction("enter_mode0_by_pin4_then_decide_power_mode (system_power_mode_next=2, light_level=10, pos_lamp_sts=0, driving_mode=0, light_level_next=10, pos_lamp_sts_next=1, driving_mode_next=0)");
    if(_fct_DoStop(EVerdBOF_TC, 0))
    {
      return;
    }
  }
  {
    CreateTTEIFFunction("press_pin4_ms_wait_s_for_active", 0, 1);
    AddIFParameterInt64(50LL);
    AddIFParameterInt64(1LL);
    CallInterfaceFunction("press_pin4_ms_wait_s_for_active (press_time=50, wait_for_active_s=1)");
    if(_fct_DoStop(EVerdBOF_TC, 0))
    {
      return;
    }
  }
  {
    CreateTTEIFFunction("check_color_mode_when_ALCMLightLvlSet_inactived", 0, 1);
    AddIFParameterInt64(2LL);
    CallInterfaceFunction("check_color_mode_when_ALCMLightLvlSet_inactived (color_mode=2)");
    if(_fct_DoStop(EVerdBOF_TC, 0))
    {
      return;
    }
  }
  TestCommandBegin("Wait", "");
  {
    _fct_Wait("1", (int64)(1LL * 1000000000LL), 1000000000, "");
  }
  // _ttg_!_3_0_2_11_6
  TestCommandEnd();
  if(_fct_DoStop(EVerdBOF_TC, 0))
  {
    return;
  }
  {
    CreateTTEIFFunction("check_color_mode_when_ALCMLightLvlSet_actived", 0, 1);
    AddIFParameterInt64(5LL);
    CallInterfaceFunction("check_color_mode_when_ALCMLightLvlSet_actived (color_mode=5)");
    if(_fct_DoStop(EVerdBOF_TC, 0))
    {
      return;
    }
  }
  {
    CreateTTEIFFunction("enter_mode0_by_pin4_then_decide_power_mode", 0, 1);
    AddIFParameterInt64(2LL);
    AddIFParameterInt64(10LL);
    AddIFParameterInt64(1LL);
    AddIFParameterInt64(0LL);
    AddIFParameterInt64(10LL);
    AddIFParameterInt64(0LL);
    AddIFParameterInt64(0LL);
    CallInterfaceFunction("enter_mode0_by_pin4_then_decide_power_mode (system_power_mode_next=2, light_level=10, pos_lamp_sts=1, driving_mode=0, light_level_next=10, pos_lamp_sts_next=0, driving_mode_next=0)");
    if(_fct_DoStop(EVerdBOF_TC, 0))
    {
      return;
    }
  }
  {
    CreateTTEIFFunction("press_pin4_ms_wait_s_for_active", 0, 1);
    AddIFParameterInt64(50LL);
    AddIFParameterInt64(1LL);
    CallInterfaceFunction("press_pin4_ms_wait_s_for_active (press_time=50, wait_for_active_s=1)");
    if(_fct_DoStop(EVerdBOF_TC, 0))
    {
      return;
    }
  }
  {
    CreateTTEIFFunction("check_color_mode_when_ALCMLightLvlSet_inactived", 0, 1);
    AddIFParameterInt64(5LL);
    CallInterfaceFunction("check_color_mode_when_ALCMLightLvlSet_inactived (color_mode=5)");
    if(_fct_DoStop(EVerdBOF_TC, 0))
    {
      return;
    }
  }
  TestCommandBegin("Wait", "");
  {
    _fct_Wait("1", (int64)(1LL * 1000000000LL), 1000000000, "");
  }
  // _ttg_!_3_0_2_11_11
  TestCommandEnd();
  if(_fct_DoStop(EVerdBOF_TC, 0))
  {
    return;
  }
  {
    CreateTTEIFFunction("check_color_mode_when_ALCMLightLvlSet_actived", 0, 1);
    AddIFParameterInt64(2LL);
    CallInterfaceFunction("check_color_mode_when_ALCMLightLvlSet_actived (color_mode=2)");
    if(_fct_DoStop(EVerdBOF_TC, 0))
    {
      return;
    }
  }
}
// _ttg_#_3_0_2_11
// TEST6:Ambient light is switched off by time,locked signal or power supply off,received IGN ON signal and ALCM will switch on last saved color and luminance in 1s by dimming,then will change to corresponding color and luminance by received DrivingModeReq and ALCMLightLvlset signal.
testcase _ttg_tc_tc_3_0_2_13()
{
  TestCaseTitle("", "TEST6:Ambient light is switched off by time,locked signal or power supply off,received IGN ON signal and ALCM will switch on last saved color and luminance in 1s by dimming,then will change to corresponding color and luminance by received DrivingModeReq and ALCMLightLvlset signal.");
  TestCommandBegin("Set", "");
  {
    _fct_TiTableHeadAssignment();
    _fct_Set(CAN::dbNode::PEPS::PEPS2::SystemPowerMode, "CAN signal \'SystemPowerMode\'", 0LL, "OFF");
    _fct_Set(CAN::dbNode::BCM::BCM1::PosLmpSts, "CAN signal \'PosLmpSts\'", 0LL, "");
    _fct_TiTableEnd("1", 0, 0);
  }
  // _ttg_!_3_0_2_13_2
  TestCommandEnd();
  if(_fct_DoStop(EVerdBOF_TC, 0))
  {
    return;
  }
  TestCommandBegin("Wait", "");
  {
    _fct_Wait("1", (int64)(1LL * 1000000000LL), 1000000000, "");
  }
  // _ttg_!_3_0_2_13_3
  TestCommandEnd();
  if(_fct_DoStop(EVerdBOF_TC, 0))
  {
    return;
  }
  {
    CreateTTEIFFunction("switch_off_by_locked_signal", 0, 1);
    AddIFParameterInt64(2LL);
    CallInterfaceFunction("switch_off_by_locked_signal (system_power_mode_next=2)");
    if(_fct_DoStop(EVerdBOF_TC, 0))
    {
      return;
    }
  }
  TestCommandBegin("Set", "");
  {
    _fct_TiTableHeadAssignment();
    _fct_Set(CAN::dbNode::HUT::HUT8::ALCMLightLvlSet, "CAN signal \'ALCMLightLvlSet\'", 10LL, "");
    _fct_Set(CAN::dbNode::BCM::BCM8::DrivingModeReq, "CAN signal \'DrivingModeReq\'", 0LL, "");
    _fct_Set(CAN::dbNode::BCM::BCM1::PosLmpSts, "CAN signal \'PosLmpSts\'", 1LL, "");
    _fct_TiTableEnd("1", 0, 0);
  }
  // _ttg_!_3_0_2_13_5
  TestCommandEnd();
  if(_fct_DoStop(EVerdBOF_TC, 0))
  {
    return;
  }
  TestCommandBegin("Set", "");
  {
    _fct_TiTableHeadAssignment();
    _fct_Set(CAN::dbNode::PEPS::PEPS2::SystemPowerMode, "CAN signal \'SystemPowerMode\'", 2LL, "");
    _fct_TiTableEnd("1", 0, 0);
  }
  // _ttg_!_3_0_2_13_6
  TestCommandEnd();
  if(_fct_DoStop(EVerdBOF_TC, 0))
  {
    return;
  }
  TestCommandBegin("Wait", "");
  {
    _fct_Wait("1", (int64)(1LL * 1000000000LL), 1000000000, "");
  }
  // _ttg_!_3_0_2_13_7
  TestCommandEnd();
  if(_fct_DoStop(EVerdBOF_TC, 0))
  {
    return;
  }
  {
    CreateTTEIFFunction("check_color_mode_when_ALCMLightLvlSet_inactived", 0, 1);
    AddIFParameterInt64(2LL);
    CallInterfaceFunction("check_color_mode_when_ALCMLightLvlSet_inactived (color_mode=2)");
    if(_fct_DoStop(EVerdBOF_TC, 0))
    {
      return;
    }
  }
  TestCommandBegin("Wait", "");
  {
    _fct_Wait("1", (int64)(1LL * 1000000000LL), 1000000000, "");
  }
  // _ttg_!_3_0_2_13_9
  TestCommandEnd();
  if(_fct_DoStop(EVerdBOF_TC, 0))
  {
    return;
  }
  {
    CreateTTEIFFunction("check_color_mode_when_ALCMLightLvlSet_actived", 0, 1);
    AddIFParameterInt64(5LL);
    CallInterfaceFunction("check_color_mode_when_ALCMLightLvlSet_actived (color_mode=5)");
    if(_fct_DoStop(EVerdBOF_TC, 0))
    {
      return;
    }
  }
  TestCommandBegin("Set", "");
  {
    _fct_TiTableHeadAssignment();
    _fct_Set(CAN::dbNode::BCM::BCM1::PosLmpSts, "CAN signal \'PosLmpSts\'", 0LL, "");
    _fct_TiTableEnd("1", 0, 0);
  }
  // _ttg_!_3_0_2_13_11
  TestCommandEnd();
  if(_fct_DoStop(EVerdBOF_TC, 0))
  {
    return;
  }
}
// _ttg_#_3_0_2_13
// TEST7:When IGN is off,ambient light is ON,if received power mode is ACC,ALCM cannot change color.
testcase _ttg_tc_tc_3_0_2_15()
{
  TestCaseTitle("", "TEST7:When IGN is off,ambient light is ON,if received power mode is ACC,ALCM cannot change color.");
  {
    CreateTTEIFFunction("switch_off_by_locked_signal", 0, 1);
    AddIFParameterInt64(0LL);
    CallInterfaceFunction("switch_off_by_locked_signal (system_power_mode_next=0)");
    if(_fct_DoStop(EVerdBOF_TC, 0))
    {
      return;
    }
  }
  TestCommandBegin("Set", "");
  {
    _fct_TiTableHeadAssignment();
    _fct_Set(CAN::dbNode::PEPS::PEPS2::SystemPowerMode, "CAN signal \'SystemPowerMode\'", 0LL, "OFF");
    _fct_TiTableEnd("1", 0, 0);
  }
  // _ttg_!_3_0_2_15_3
  TestCommandEnd();
  if(_fct_DoStop(EVerdBOF_TC, 0))
  {
    return;
  }
  {
    CreateTTEIFFunction("switch_on_by_door_open_signal_when_ign_off", 0, 1);
    AddIFParameterInt64(0LL);
    AddIFParameterSignal(CAN::dbNode::BCM::BCM1::DriverDoorSts);
    AddIFParameterInt64(2LL);
    CallInterfaceFunction("switch_on_by_door_open_signal_when_ign_off (PosLmpSts_value=0, door_open_signal=DriverDoorSts, color_mode=2)");
    if(_fct_DoStop(EVerdBOF_TC, 0))
    {
      return;
    }
  }
  TestCommandBegin("Set", "");
  {
    _fct_TiTableHeadAssignment();
    _fct_Set(CAN::dbNode::PEPS::PEPS2::SystemPowerMode, "CAN signal \'SystemPowerMode\'", 1LL, "ACC");
    _fct_TiTableEnd("1", 0, 0);
  }
  // _ttg_!_3_0_2_15_5
  TestCommandEnd();
  if(_fct_DoStop(EVerdBOF_TC, 0))
  {
    return;
  }
  {
    CreateTTEIFFunction("press_pin4_ms_wait_s_for_active", 0, 1);
    AddIFParameterInt64(50LL);
    AddIFParameterInt64(2LL);
    CallInterfaceFunction("press_pin4_ms_wait_s_for_active (press_time=50, wait_for_active_s=2)");
    if(_fct_DoStop(EVerdBOF_TC, 0))
    {
      return;
    }
  }
  {
    CreateTTEIFFunction("check_color_mode_when_ALCMLightLvlSet_inactived", 0, 1);
    AddIFParameterInt64(2LL);
    CallInterfaceFunction("check_color_mode_when_ALCMLightLvlSet_inactived (color_mode=2)");
    if(_fct_DoStop(EVerdBOF_TC, 0))
    {
      return;
    }
  }
  {
    CreateTTEIFFunction("press_pin4_ms_wait_s_for_active", 0, 1);
    AddIFParameterInt64(50LL);
    AddIFParameterInt64(2LL);
    CallInterfaceFunction("press_pin4_ms_wait_s_for_active (press_time=50, wait_for_active_s=2)");
    if(_fct_DoStop(EVerdBOF_TC, 0))
    {
      return;
    }
  }
  {
    CreateTTEIFFunction("check_color_mode_when_ALCMLightLvlSet_inactived", 0, 1);
    AddIFParameterInt64(2LL);
    CallInterfaceFunction("check_color_mode_when_ALCMLightLvlSet_inactived (color_mode=2)");
    if(_fct_DoStop(EVerdBOF_TC, 0))
    {
      return;
    }
  }
}
// _ttg_#_3_0_2_15
// TEST8:When IGN is off,ambient light is ON,if received power mode is IGN ON,ALCM will change to corresponding color and luminance in 1s by dimming according to received DrivingModeReq and ALCMLightLvlset signal.
testcase _ttg_tc_tc_3_0_2_17()
{
  TestCaseTitle("", "TEST8:When IGN is off,ambient light is ON,if received power mode is IGN ON,ALCM will change to corresponding color and luminance in 1s by dimming according to received DrivingModeReq and ALCMLightLvlset signal.");
  TestCommandBegin("Set", "");
  {
    _fct_TiTableHeadAssignment();
    _fct_Set(CAN::dbNode::PEPS::PEPS2::SystemPowerMode, "CAN signal \'SystemPowerMode\'", 0LL, "OFF");
    _fct_TiTableEnd("1", 0, 0);
  }
  // _ttg_!_3_0_2_17_2
  TestCommandEnd();
  if(_fct_DoStop(EVerdBOF_TC, 0))
  {
    return;
  }
  {
    CreateTTEIFFunction("switch_off_by_locked_signal", 0, 1);
    AddIFParameterInt64(0LL);
    CallInterfaceFunction("switch_off_by_locked_signal (system_power_mode_next=0)");
    if(_fct_DoStop(EVerdBOF_TC, 0))
    {
      return;
    }
  }
  {
    CreateTTEIFFunction("switch_on_by_door_open_signal_when_ign_off", 0, 1);
    AddIFParameterInt64(0LL);
    AddIFParameterSignal(CAN::dbNode::BCM::BCM1::DriverDoorSts);
    AddIFParameterInt64(2LL);
    CallInterfaceFunction("switch_on_by_door_open_signal_when_ign_off (PosLmpSts_value=0, door_open_signal=DriverDoorSts, color_mode=2)");
    if(_fct_DoStop(EVerdBOF_TC, 0))
    {
      return;
    }
  }
  TestCommandBegin("Set", "");
  {
    _fct_TiTableHeadAssignment();
    _fct_Set(CAN::dbNode::HUT::HUT8::ALCMLightLvlSet, "CAN signal \'ALCMLightLvlSet\'", 5LL, "");
    _fct_TiTableEnd("1", 0, 0);
  }
  // _ttg_!_3_0_2_17_5
  TestCommandEnd();
  if(_fct_DoStop(EVerdBOF_TC, 0))
  {
    return;
  }
  TestCommandBegin("Set", "");
  {
    _fct_TiTableHeadAssignment();
    _fct_Set(CAN::dbNode::PEPS::PEPS2::SystemPowerMode, "CAN signal \'SystemPowerMode\'", 2LL, "ON");
    _fct_TiTableEnd("1", 0, 0);
  }
  // _ttg_!_3_0_2_17_6
  TestCommandEnd();
  if(_fct_DoStop(EVerdBOF_TC, 0))
  {
    return;
  }
  TestCommandBegin("Wait", "");
  {
    _fct_Wait("1", (int64)(2LL * 1000000000LL), 1000000000, "");
  }
  // _ttg_!_3_0_2_17_7
  TestCommandEnd();
  if(_fct_DoStop(EVerdBOF_TC, 0))
  {
    return;
  }
  {
    CreateTTEIFFunction("check_color_mode_when_ALCMLightLvlSet_actived", 0, 1);
    AddIFParameterInt64(2LL);
    CallInterfaceFunction("check_color_mode_when_ALCMLightLvlSet_actived (color_mode=2)");
    if(_fct_DoStop(EVerdBOF_TC, 0))
    {
      return;
    }
  }
  TestCommandBegin("Set", "");
  {
    _fct_TiTableHeadAssignment();
    _fct_Set(CAN::dbNode::HUT::HUT8::ALCMLightLvlSet, "CAN signal \'ALCMLightLvlSet\'", 10LL, "");
    _fct_TiTableEnd("1", 0, 0);
  }
  // _ttg_!_3_0_2_17_9
  TestCommandEnd();
  if(_fct_DoStop(EVerdBOF_TC, 0))
  {
    return;
  }
  TestCommandBegin("Wait", "");
  {
    _fct_Wait("1", (int64)(2LL * 1000000000LL), 1000000000, "");
  }
  // _ttg_!_3_0_2_17_10
  TestCommandEnd();
  if(_fct_DoStop(EVerdBOF_TC, 0))
  {
    return;
  }
  {
    CreateTTEIFFunction("check_color_mode_when_ALCMLightLvlSet_actived", 0, 1);
    AddIFParameterInt64(2LL);
    CallInterfaceFunction("check_color_mode_when_ALCMLightLvlSet_actived (color_mode=2)");
    if(_fct_DoStop(EVerdBOF_TC, 0))
    {
      return;
    }
  }
}
// _ttg_#_3_0_2_17
// TEST9:When IGN is ON and ambient light is switched on,if the current color is red,short press color switch can not change color;If current color is not red,short press color switch can change color between blue and golden,changing process will ignore short press switch again.
testcase _ttg_tc_tc_3_0_2_19()
{
  TestCaseTitle("", "TEST9:When IGN is ON and ambient light is switched on,if the current color is red,short press color switch can not change color;If current color is not red,short press color switch can change color between blue and golden,changing process will ignore short press switch again.");
  TestCommandBegin("Set", "");
  {
    _fct_TiTableHeadAssignment();
    _fct_Set(CAN::dbNode::BCM::BCM8::DrivingModeReq, "CAN signal \'DrivingModeReq\'", 4LL, "");
    _fct_TiTableEnd("1", 0, 0);
  }
  // _ttg_!_3_0_2_19_2
  TestCommandEnd();
  if(_fct_DoStop(EVerdBOF_TC, 0))
  {
    return;
  }
  TestCommandBegin("Wait", "");
  {
    _fct_Wait("1", (int64)(2LL * 1000000000LL), 1000000000, "");
  }
  // _ttg_!_3_0_2_19_3
  TestCommandEnd();
  if(_fct_DoStop(EVerdBOF_TC, 0))
  {
    return;
  }
  {
    CreateTTEIFFunction("check_color_mode_when_DrivingModeReq_actived", 0, 1);
    AddIFParameterChar("1");
    CallInterfaceFunction("check_color_mode_when_DrivingModeReq_actived (color_should_be=1)");
    if(_fct_DoStop(EVerdBOF_TC, 0))
    {
      return;
    }
  }
  {
    CreateTTEIFFunction("press_pin4_ms_wait_s_for_active", 0, 1);
    AddIFParameterInt64(50LL);
    AddIFParameterInt64(2LL);
    CallInterfaceFunction("press_pin4_ms_wait_s_for_active (press_time=50, wait_for_active_s=2)");
    if(_fct_DoStop(EVerdBOF_TC, 0))
    {
      return;
    }
  }
  {
    CreateTTEIFFunction("check_color_mode_when_ALCMLightLvlSet_actived", 0, 1);
    AddIFParameterInt64(1LL);
    CallInterfaceFunction("check_color_mode_when_ALCMLightLvlSet_actived (color_mode=1)");
    if(_fct_DoStop(EVerdBOF_TC, 0))
    {
      return;
    }
  }
  TestCommandBegin("Set", "");
  {
    _fct_TiTableHeadAssignment();
    _fct_Set(CAN::dbNode::BCM::BCM8::DrivingModeReq, "CAN signal \'DrivingModeReq\'", 0LL, "");
    _fct_TiTableEnd("1", 0, 0);
  }
  // _ttg_!_3_0_2_19_7
  TestCommandEnd();
  if(_fct_DoStop(EVerdBOF_TC, 0))
  {
    return;
  }
  TestCommandBegin("Wait", "");
  {
    _fct_Wait("1", (int64)(2LL * 1000000000LL), 1000000000, "");
  }
  // _ttg_!_3_0_2_19_8
  TestCommandEnd();
  if(_fct_DoStop(EVerdBOF_TC, 0))
  {
    return;
  }
  {
    CreateTTEIFFunction("check_color_mode_when_ALCMLightLvlSet_actived", 0, 1);
    AddIFParameterInt64(2LL);
    CallInterfaceFunction("check_color_mode_when_ALCMLightLvlSet_actived (color_mode=2)");
    if(_fct_DoStop(EVerdBOF_TC, 0))
    {
      return;
    }
  }
  {
    CreateTTEIFFunction("press_pin4_ms_wait_s_for_active", 0, 1);
    AddIFParameterInt64(50LL);
    AddIFParameterInt64(2LL);
    CallInterfaceFunction("press_pin4_ms_wait_s_for_active (press_time=50, wait_for_active_s=2)");
    if(_fct_DoStop(EVerdBOF_TC, 0))
    {
      return;
    }
  }
  {
    CreateTTEIFFunction("check_color_mode_when_ALCMLightLvlSet_actived", 0, 1);
    AddIFParameterInt64(3LL);
    CallInterfaceFunction("check_color_mode_when_ALCMLightLvlSet_actived (color_mode=3)");
    if(_fct_DoStop(EVerdBOF_TC, 0))
    {
      return;
    }
  }
  {
    CreateTTEIFFunction("press_pin4_ms_wait_s_for_active", 0, 1);
    AddIFParameterInt64(50LL);
    AddIFParameterInt64(2LL);
    CallInterfaceFunction("press_pin4_ms_wait_s_for_active (press_time=50, wait_for_active_s=2)");
    if(_fct_DoStop(EVerdBOF_TC, 0))
    {
      return;
    }
  }
  {
    CreateTTEIFFunction("check_color_mode_when_ALCMLightLvlSet_actived", 0, 1);
    AddIFParameterInt64(2LL);
    CallInterfaceFunction("check_color_mode_when_ALCMLightLvlSet_actived (color_mode=2)");
    if(_fct_DoStop(EVerdBOF_TC, 0))
    {
      return;
    }
  }
  TestCommandBegin("Set", "");
  {
    _fct_TiTableHeadAssignment();
    _fct_Set(CAN::dbNode::BCM::BCM1::PosLmpSts, "CAN signal \'PosLmpSts\'", 1LL, "");
    _fct_TiTableEnd("1", 0, 0);
  }
  // _ttg_!_3_0_2_19_14
  TestCommandEnd();
  if(_fct_DoStop(EVerdBOF_TC, 0))
  {
    return;
  }
  TestCommandBegin("Wait", "");
  {
    _fct_Wait("1", (int64)(2LL * 1000000000LL), 1000000000, "");
  }
  // _ttg_!_3_0_2_19_15
  TestCommandEnd();
  if(_fct_DoStop(EVerdBOF_TC, 0))
  {
    return;
  }
  {
    CreateTTEIFFunction("check_color_mode_when_ALCMLightLvlSet_actived", 0, 1);
    AddIFParameterInt64(5LL);
    CallInterfaceFunction("check_color_mode_when_ALCMLightLvlSet_actived (color_mode=5)");
    if(_fct_DoStop(EVerdBOF_TC, 0))
    {
      return;
    }
  }
  TestCommandBegin("Set", "");
  {
    _fct_TiTableHeadAssignment();
    _fct_Set(CAN::dbNode::BCM::BCM1::PosLmpSts, "CAN signal \'PosLmpSts\'", 0LL, "");
    _fct_TiTableEnd("1", 0, 0);
  }
  // _ttg_!_3_0_2_19_17
  TestCommandEnd();
  if(_fct_DoStop(EVerdBOF_TC, 0))
  {
    return;
  }
  TestCommandBegin("Wait", "");
  {
    _fct_Wait("1", (int64)(2LL * 1000000000LL), 1000000000, "");
  }
  // _ttg_!_3_0_2_19_18
  TestCommandEnd();
  if(_fct_DoStop(EVerdBOF_TC, 0))
  {
    return;
  }
  {
    CreateTTEIFFunction("check_color_mode_when_ALCMLightLvlSet_actived", 0, 1);
    AddIFParameterInt64(2LL);
    CallInterfaceFunction("check_color_mode_when_ALCMLightLvlSet_actived (color_mode=2)");
    if(_fct_DoStop(EVerdBOF_TC, 0))
    {
      return;
    }
  }
}
// _ttg_#_3_0_2_19
// TEST1:If long press switch one time,then will remember current color mode and luminance,then will switch off ambient light in 1s by dimming.During dimming off,if short press switch again,then ambient light will be switched on again.
testcase _ttg_tc_tc_3_0_3_2()
{
  TestCaseTitle("", "TEST1:If long press switch one time,then will remember current color mode and luminance,then will switch off ambient light in 1s by dimming.During dimming off,if short press switch again,then ambient light will be switched on again.");
  {
    CreateTTEIFFunction("press_pin4_ms_wait_s_for_active", 0, 1);
    AddIFParameterInt64(900LL);
    AddIFParameterInt64(0.5);
    CallInterfaceFunction("press_pin4_ms_wait_s_for_active (press_time=900, wait_for_active_s=0.5)");
    if(_fct_DoStop(EVerdBOF_TC, 0))
    {
      return;
    }
  }
  {
    CreateTTEIFFunction("press_pin4_ms_wait_s_for_active", 0, 1);
    AddIFParameterInt64(50LL);
    AddIFParameterInt64(2LL);
    CallInterfaceFunction("press_pin4_ms_wait_s_for_active (press_time=50, wait_for_active_s=2)");
    if(_fct_DoStop(EVerdBOF_TC, 0))
    {
      return;
    }
  }
  {
    CreateTTEIFFunction("check_color_mode_when_ALCMLightLvlSet_actived", 0, 1);
    AddIFParameterInt64(2LL);
    CallInterfaceFunction("check_color_mode_when_ALCMLightLvlSet_actived (color_mode=2)");
    if(_fct_DoStop(EVerdBOF_TC, 0))
    {
      return;
    }
  }
  TestCommandBegin("Send", "");
  {
    {
      message CAN::KostiaReqALCM msg;
      message CAN::KostiaReqALCM msgOrig;
      msg = msgOrig;
      _ttg_TestStepInitOk = 1;
      _ttg_TestStepInitOk &= _fct_SetMsgDlc(msg, 8LL);
      if(_ttg_TestStepInitOk)
      {
        _fct_TiTableHeadSend("CAN message \'KostiaReqALCM\' ID = 1394 (0x572) on bus CAN");
        msg.KostiaReqSigALCMByte0.phys = 0x4LL;
        _fct_TiNameOpValue(0, "CAN signal \'KostiaReqSigALCMByte0\'", "=", 0x4LL, "");
        msg.KostiaReqSigALCMByte1.phys = 0LL;
        _fct_TiNameOpValue(0, "CAN signal \'KostiaReqSigALCMByte1\'", "=", 0LL, "");
        msg.KostiaReqSigALCMByte2.phys = 0LL;
        _fct_TiNameOpValue(0, "CAN signal \'KostiaReqSigALCMByte2\'", "=", 0LL, "");
        msg.KostiaReqSigALCMByte3.phys = 0x7LL;
        _fct_TiNameOpValue(0, "CAN signal \'KostiaReqSigALCMByte3\'", "=", 0x7LL, "");
        msg.KostiaReqSigALCMByte4.phys = 0xCLL;
        _fct_TiNameOpValue(0, "CAN signal \'KostiaReqSigALCMByte4\'", "=", 0xCLL, "");
        msg.KostiaReqSigALCMByte5.phys = 0LL;
        _fct_TiNameOpValue(0, "CAN signal \'KostiaReqSigALCMByte5\'", "=", 0LL, "");
        msg.KostiaReqSigALCMByte6.phys = 0LL;
        _fct_TiNameOpValue(0, "CAN signal \'KostiaReqSigALCMByte6\'", "=", 0LL, "");
        msg.KostiaReqSigALCMByte7.phys = 0LL;
        _fct_TiNameOpValue(0, "CAN signal \'KostiaReqSigALCMByte7\'", "=", 0LL, "");
        _fct_TiTableEnd("1", 0, 0);
      }
      if(_ttg_TestStepInitOk)
      {
        output(msg);
      }
    }
  }
  // _ttg_!_3_0_3_2_5
  TestCommandEnd();
  if(_fct_DoStop(EVerdBOF_TC, 0))
  {
    return;
  }
  TestCommandBegin("Wait", "");
  {
    _fct_Wait("1", (int64)(100LL * 1000000LL), 1000000, "");
  }
  // _ttg_!_3_0_3_2_6
  TestCommandEnd();
  if(_fct_DoStop(EVerdBOF_TC, 0))
  {
    return;
  }
  TestCommandBegin("Check", "");
  {
    _fct_TiTableHeadExpected();
    _fct_ChckRep(0, CAN::dbNode::ALCM::KostiaRspALCM::KostiaRspSigALCMByte0, "CAN signal \'KostiaRspSigALCMByte0\'", "==", 0x4LL, "");
    _fct_TiCellResult(((0!=getSignalTime(CAN::dbNode::ALCM::KostiaRspALCM::KostiaRspSigALCMByte0)) && CheckSignalMatch(CAN::dbNode::ALCM::KostiaRspALCM::KostiaRspSigALCMByte0, 0x4LL, "=") == 1));
    _fct_ChckRep(0, CAN::dbNode::ALCM::KostiaRspALCM::KostiaRspSigALCMByte1, "CAN signal \'KostiaRspSigALCMByte1\'", "==", 0x53LL, "");
    _fct_TiCellResult(((0!=getSignalTime(CAN::dbNode::ALCM::KostiaRspALCM::KostiaRspSigALCMByte1)) && CheckSignalMatch(CAN::dbNode::ALCM::KostiaRspALCM::KostiaRspSigALCMByte1, 0x53LL, "=") == 1));
    _fct_ChckRep(0, CAN::dbNode::ALCM::KostiaRspALCM::KostiaRspSigALCMByte2, "CAN signal \'KostiaRspSigALCMByte2\'", "==", 0x57LL, "");
    _fct_TiCellResult(((0!=getSignalTime(CAN::dbNode::ALCM::KostiaRspALCM::KostiaRspSigALCMByte2)) && CheckSignalMatch(CAN::dbNode::ALCM::KostiaRspALCM::KostiaRspSigALCMByte2, 0x57LL, "=") == 1));
    _fct_ChckRep(0, CAN::dbNode::ALCM::KostiaRspALCM::KostiaRspSigALCMByte3, "CAN signal \'KostiaRspSigALCMByte3\'", "==", 0x30LL, "");
    _fct_TiCellResult(((0!=getSignalTime(CAN::dbNode::ALCM::KostiaRspALCM::KostiaRspSigALCMByte3)) && CheckSignalMatch(CAN::dbNode::ALCM::KostiaRspALCM::KostiaRspSigALCMByte3, 0x30LL, "=") == 1));
    _fct_ChckRep(0, CAN::dbNode::ALCM::KostiaRspALCM::KostiaRspSigALCMByte4, "CAN signal \'KostiaRspSigALCMByte4\'", "==", 0x30LL, "");
    _fct_TiCellResult(((0!=getSignalTime(CAN::dbNode::ALCM::KostiaRspALCM::KostiaRspSigALCMByte4)) && CheckSignalMatch(CAN::dbNode::ALCM::KostiaRspALCM::KostiaRspSigALCMByte4, 0x30LL, "=") == 1));
    _fct_ChckRep(0, CAN::dbNode::ALCM::KostiaRspALCM::KostiaRspSigALCMByte5, "CAN signal \'KostiaRspSigALCMByte5\'", "==", 0x32LL, "");
    _fct_TiCellResult(((0!=getSignalTime(CAN::dbNode::ALCM::KostiaRspALCM::KostiaRspSigALCMByte5)) && CheckSignalMatch(CAN::dbNode::ALCM::KostiaRspALCM::KostiaRspSigALCMByte5, 0x32LL, "=") == 1));
    _fct_ChckRep(0, CAN::dbNode::ALCM::KostiaRspALCM::KostiaRspSigALCMByte6, "CAN signal \'KostiaRspSigALCMByte6\'", "==", 0x0LL, "");
    _fct_TiCellResult(((0!=getSignalTime(CAN::dbNode::ALCM::KostiaRspALCM::KostiaRspSigALCMByte6)) && CheckSignalMatch(CAN::dbNode::ALCM::KostiaRspALCM::KostiaRspSigALCMByte6, 0x0LL, "=") == 1));
    _fct_ChckRep(0, CAN::dbNode::ALCM::KostiaRspALCM::KostiaRspSigALCMByte7, "CAN signal \'KostiaRspSigALCMByte7\'", "==", 0x0LL, "");
    _fct_TiCellResult(((0!=getSignalTime(CAN::dbNode::ALCM::KostiaRspALCM::KostiaRspSigALCMByte7)) && CheckSignalMatch(CAN::dbNode::ALCM::KostiaRspALCM::KostiaRspSigALCMByte7, 0x0LL, "=") == 1));
    _fct_TiTableEvaluation("1");
  }
  // _ttg_!_3_0_3_2_7
  TestCommandEnd();
  if(_fct_DoStop(EVerdBOF_TC, 0))
  {
    return;
  }
}
// _ttg_#_3_0_3_2
// Read SW version
testcase _ttg_tc_tc_3_0_4_2()
{
  TestCaseTitle("", "Read SW version");
  TestCommandBegin("Request Response", "Enter Kostia");
  {
    long result;
    result = 0;
    {
      message CAN::KostiaReqALCM msg;
      message CAN::KostiaReqALCM msgOrig;
      msg = msgOrig;
      _ttg_TestStepInitOk = 1;
      _ttg_TestStepInitOk &= _fct_SetMsgDlc(msg, 8LL);
      if(_ttg_TestStepInitOk)
      {
        _fct_TiTableHeadSend("CAN message \'KostiaReqALCM\' ID = 1394 (0x572) on bus CAN");
        msg.KostiaReqSigALCMByte0.phys = 0x1LL;
        _fct_TiNameOpValue(0, "CAN signal \'KostiaReqSigALCMByte0\'", "=", 0x1LL, "");
        msg.KostiaReqSigALCMByte1.phys = 0x4BLL;
        _fct_TiNameOpValue(0, "CAN signal \'KostiaReqSigALCMByte1\'", "=", 0x4BLL, "");
        msg.KostiaReqSigALCMByte2.phys = 0x4FLL;
        _fct_TiNameOpValue(0, "CAN signal \'KostiaReqSigALCMByte2\'", "=", 0x4FLL, "");
        msg.KostiaReqSigALCMByte3.phys = 0x53LL;
        _fct_TiNameOpValue(0, "CAN signal \'KostiaReqSigALCMByte3\'", "=", 0x53LL, "");
        msg.KostiaReqSigALCMByte4.phys = 0x54LL;
        _fct_TiNameOpValue(0, "CAN signal \'KostiaReqSigALCMByte4\'", "=", 0x54LL, "");
        msg.KostiaReqSigALCMByte5.phys = 0x41LL;
        _fct_TiNameOpValue(0, "CAN signal \'KostiaReqSigALCMByte5\'", "=", 0x41LL, "");
        msg.KostiaReqSigALCMByte6.phys = 0x4CLL;
        _fct_TiNameOpValue(0, "CAN signal \'KostiaReqSigALCMByte6\'", "=", 0x4CLL, "");
        msg.KostiaReqSigALCMByte7.phys = 0x50LL;
        _fct_TiNameOpValue(0, "CAN signal \'KostiaReqSigALCMByte7\'", "=", 0x50LL, "");
        _fct_TiTableEnd("Req1", 0, 0);
      }
      if(_ttg_TestStepInitOk)
      {
        output(msg);
      }
    }
    _fct_Wait("Wait", (int64)(1LL * 1000000LL), 1000000, "");
    if((int64)(5000LL * 1000000LL) <= 0)
    {
      testStepErrorInTestSystem(0, "1", "Invalid wait time (<= 0)");
    }
    else
    {
      _ttg_cb_frameCntVar4_3_0_4_2_2_4_0 = 0;
      testJoinMessageEvent(CAN::KostiaRspALCM, "_ttg_callback_requestresponse_3_0_4_2_2_4_0", "CAN message 'KostiaRspALCM' ID = 1395 (0x573) on bus CAN");
      result = testWaitForAllJoinedEventsNS((int64)(5000LL * 1000000LL));
      _fct_TiTableHeadResponse("CAN message \'KostiaRspALCM\' ID = 1395 (0x573) on bus CAN", _ttg_cb_frameCntVar4_3_0_4_2_2_4_0);
      if(_ttg_cb_frameCntVar4_3_0_4_2_2_4_0 != 0)
      {
        _fct_TiNameOpValue(0, "CAN signal \'KostiaRspSigALCMByte0\'", "==", 0x1LL, "");
        _fct_TiCell(_ttg_cb_frmPduVar4_3_0_4_2_2_4_0.KostiaRspSigALCMByte0.phys);
        _fct_TiCellResult((CheckSignalMatch(CAN::dbNode::ALCM::KostiaRspALCM::KostiaRspSigALCMByte0,_ttg_cb_frmPduVar4_3_0_4_2_2_4_0.KostiaRspSigALCMByte0.phys, 0x1LL, "=") == 1));
        _fct_TiNameOpValue(0, "CAN signal \'KostiaRspSigALCMByte1\'", "==", 0x4BLL, "");
        _fct_TiCell(_ttg_cb_frmPduVar4_3_0_4_2_2_4_0.KostiaRspSigALCMByte1.phys);
        _fct_TiCellResult((CheckSignalMatch(CAN::dbNode::ALCM::KostiaRspALCM::KostiaRspSigALCMByte1,_ttg_cb_frmPduVar4_3_0_4_2_2_4_0.KostiaRspSigALCMByte1.phys, 0x4BLL, "=") == 1));
        _fct_TiNameOpValue(0, "CAN signal \'KostiaRspSigALCMByte2\'", "==", 0x4FLL, "");
        _fct_TiCell(_ttg_cb_frmPduVar4_3_0_4_2_2_4_0.KostiaRspSigALCMByte2.phys);
        _fct_TiCellResult((CheckSignalMatch(CAN::dbNode::ALCM::KostiaRspALCM::KostiaRspSigALCMByte2,_ttg_cb_frmPduVar4_3_0_4_2_2_4_0.KostiaRspSigALCMByte2.phys, 0x4FLL, "=") == 1));
        _fct_TiNameOpValue(0, "CAN signal \'KostiaRspSigALCMByte3\'", "==", 0x53LL, "");
        _fct_TiCell(_ttg_cb_frmPduVar4_3_0_4_2_2_4_0.KostiaRspSigALCMByte3.phys);
        _fct_TiCellResult((CheckSignalMatch(CAN::dbNode::ALCM::KostiaRspALCM::KostiaRspSigALCMByte3,_ttg_cb_frmPduVar4_3_0_4_2_2_4_0.KostiaRspSigALCMByte3.phys, 0x53LL, "=") == 1));
        _fct_TiNameOpValue(0, "CAN signal \'KostiaRspSigALCMByte4\'", "==", 0x54LL, "");
        _fct_TiCell(_ttg_cb_frmPduVar4_3_0_4_2_2_4_0.KostiaRspSigALCMByte4.phys);
        _fct_TiCellResult((CheckSignalMatch(CAN::dbNode::ALCM::KostiaRspALCM::KostiaRspSigALCMByte4,_ttg_cb_frmPduVar4_3_0_4_2_2_4_0.KostiaRspSigALCMByte4.phys, 0x54LL, "=") == 1));
        _fct_TiNameOpValue(0, "CAN signal \'KostiaRspSigALCMByte5\'", "==", 0x41LL, "");
        _fct_TiCell(_ttg_cb_frmPduVar4_3_0_4_2_2_4_0.KostiaRspSigALCMByte5.phys);
        _fct_TiCellResult((CheckSignalMatch(CAN::dbNode::ALCM::KostiaRspALCM::KostiaRspSigALCMByte5,_ttg_cb_frmPduVar4_3_0_4_2_2_4_0.KostiaRspSigALCMByte5.phys, 0x41LL, "=") == 1));
        _fct_TiNameOpValue(0, "CAN signal \'KostiaRspSigALCMByte6\'", "==", 0x4CLL, "");
        _fct_TiCell(_ttg_cb_frmPduVar4_3_0_4_2_2_4_0.KostiaRspSigALCMByte6.phys);
        _fct_TiCellResult((CheckSignalMatch(CAN::dbNode::ALCM::KostiaRspALCM::KostiaRspSigALCMByte6,_ttg_cb_frmPduVar4_3_0_4_2_2_4_0.KostiaRspSigALCMByte6.phys, 0x4CLL, "=") == 1));
        _fct_TiNameOpValue(0, "CAN signal \'KostiaRspSigALCMByte7\'", "==", 0x50LL, "");
        _fct_TiCell(_ttg_cb_frmPduVar4_3_0_4_2_2_4_0.KostiaRspSigALCMByte7.phys);
        _fct_TiCellResult((CheckSignalMatch(CAN::dbNode::ALCM::KostiaRspALCM::KostiaRspSigALCMByte7,_ttg_cb_frmPduVar4_3_0_4_2_2_4_0.KostiaRspSigALCMByte7.phys, 0x50LL, "=") == 1));
      }
      _fct_TiTableEnd("Resp1", 0, 0);
    }
    _fct_Verdict_RespParam_wResult(result, 0);
  }
  // _ttg_!_3_0_4_2_2
  TestCommandEnd();
  if(_fct_DoStop(EVerdBOF_TC, 0))
  {
    return;
  }
  TestCommandBegin("Request Response", "");
  {
    long result;
    result = 0;
    {
      message CAN::KostiaReqALCM msg;
      message CAN::KostiaReqALCM msgOrig;
      msg = msgOrig;
      _ttg_TestStepInitOk = 1;
      _ttg_TestStepInitOk &= _fct_SetMsgDlc(msg, 8LL);
      if(_ttg_TestStepInitOk)
      {
        _fct_TiTableHeadSend("CAN message \'KostiaReqALCM\' ID = 1394 (0x572) on bus CAN");
        msg.KostiaReqSigALCMByte0.phys = 0x4LL;
        _fct_TiNameOpValue(0, "CAN signal \'KostiaReqSigALCMByte0\'", "=", 0x4LL, "");
        msg.KostiaReqSigALCMByte1.phys = 0LL;
        _fct_TiNameOpValue(0, "CAN signal \'KostiaReqSigALCMByte1\'", "=", 0LL, "");
        msg.KostiaReqSigALCMByte2.phys = 0LL;
        _fct_TiNameOpValue(0, "CAN signal \'KostiaReqSigALCMByte2\'", "=", 0LL, "");
        msg.KostiaReqSigALCMByte3.phys = 0x7LL;
        _fct_TiNameOpValue(0, "CAN signal \'KostiaReqSigALCMByte3\'", "=", 0x7LL, "");
        msg.KostiaReqSigALCMByte4.phys = 0xCLL;
        _fct_TiNameOpValue(0, "CAN signal \'KostiaReqSigALCMByte4\'", "=", 0xCLL, "");
        msg.KostiaReqSigALCMByte5.phys = 0LL;
        _fct_TiNameOpValue(0, "CAN signal \'KostiaReqSigALCMByte5\'", "=", 0LL, "");
        msg.KostiaReqSigALCMByte6.phys = 0LL;
        _fct_TiNameOpValue(0, "CAN signal \'KostiaReqSigALCMByte6\'", "=", 0LL, "");
        msg.KostiaReqSigALCMByte7.phys = 0LL;
        _fct_TiNameOpValue(0, "CAN signal \'KostiaReqSigALCMByte7\'", "=", 0LL, "");
        _fct_TiTableEnd("Req1", 0, 0);
      }
      if(_ttg_TestStepInitOk)
      {
        output(msg);
      }
    }
    if((int64)(5000LL * 1000000LL) <= 0)
    {
      testStepErrorInTestSystem(0, "1", "Invalid wait time (<= 0)");
    }
    else
    {
      _ttg_cb_frameCntVar5_3_0_4_2_3_3_0 = 0;
      testJoinMessageEvent(CAN::KostiaRspALCM, "_ttg_callback_requestresponse_3_0_4_2_3_3_0", "CAN message 'KostiaRspALCM' ID = 1395 (0x573) on bus CAN");
      result = testWaitForAllJoinedEventsNS((int64)(5000LL * 1000000LL));
      _fct_TiTableHeadResponse("CAN message \'KostiaRspALCM\' ID = 1395 (0x573) on bus CAN", _ttg_cb_frameCntVar5_3_0_4_2_3_3_0);
      if(_ttg_cb_frameCntVar5_3_0_4_2_3_3_0 != 0)
      {
        _fct_TiNameOpValue(0, "CAN signal \'KostiaRspSigALCMByte0\'", ">=", 0LL, "");
        _fct_TiCell(_ttg_cb_frmPduVar5_3_0_4_2_3_3_0.KostiaRspSigALCMByte0.phys);
        _fct_TiCellResult((CheckSignalMatch(CAN::dbNode::ALCM::KostiaRspALCM::KostiaRspSigALCMByte0,_ttg_cb_frmPduVar5_3_0_4_2_3_3_0.KostiaRspSigALCMByte0.phys, 0LL, ">=") == 1));
        _fct_TiNameOpValue(0, "CAN signal \'KostiaRspSigALCMByte1\'", ">=", 0LL, "");
        _fct_TiCell(_ttg_cb_frmPduVar5_3_0_4_2_3_3_0.KostiaRspSigALCMByte1.phys);
        _fct_TiCellResult((CheckSignalMatch(CAN::dbNode::ALCM::KostiaRspALCM::KostiaRspSigALCMByte1,_ttg_cb_frmPduVar5_3_0_4_2_3_3_0.KostiaRspSigALCMByte1.phys, 0LL, ">=") == 1));
        _fct_TiNameOpValue(0, "CAN signal \'KostiaRspSigALCMByte2\'", ">=", 0LL, "");
        _fct_TiCell(_ttg_cb_frmPduVar5_3_0_4_2_3_3_0.KostiaRspSigALCMByte2.phys);
        _fct_TiCellResult((CheckSignalMatch(CAN::dbNode::ALCM::KostiaRspALCM::KostiaRspSigALCMByte2,_ttg_cb_frmPduVar5_3_0_4_2_3_3_0.KostiaRspSigALCMByte2.phys, 0LL, ">=") == 1));
        _fct_TiNameOpValue(0, "CAN signal \'KostiaRspSigALCMByte3\'", ">=", 0LL, "");
        _fct_TiCell(_ttg_cb_frmPduVar5_3_0_4_2_3_3_0.KostiaRspSigALCMByte3.phys);
        _fct_TiCellResult((CheckSignalMatch(CAN::dbNode::ALCM::KostiaRspALCM::KostiaRspSigALCMByte3,_ttg_cb_frmPduVar5_3_0_4_2_3_3_0.KostiaRspSigALCMByte3.phys, 0LL, ">=") == 1));
        _fct_TiNameOpValue(0, "CAN signal \'KostiaRspSigALCMByte4\'", ">=", 0LL, "");
        _fct_TiCell(_ttg_cb_frmPduVar5_3_0_4_2_3_3_0.KostiaRspSigALCMByte4.phys);
        _fct_TiCellResult((CheckSignalMatch(CAN::dbNode::ALCM::KostiaRspALCM::KostiaRspSigALCMByte4,_ttg_cb_frmPduVar5_3_0_4_2_3_3_0.KostiaRspSigALCMByte4.phys, 0LL, ">=") == 1));
        _fct_TiNameOpValue(0, "CAN signal \'KostiaRspSigALCMByte5\'", ">=", 0LL, "");
        _fct_TiCell(_ttg_cb_frmPduVar5_3_0_4_2_3_3_0.KostiaRspSigALCMByte5.phys);
        _fct_TiCellResult((CheckSignalMatch(CAN::dbNode::ALCM::KostiaRspALCM::KostiaRspSigALCMByte5,_ttg_cb_frmPduVar5_3_0_4_2_3_3_0.KostiaRspSigALCMByte5.phys, 0LL, ">=") == 1));
        _fct_TiNameOpValue(0, "CAN signal \'KostiaRspSigALCMByte6\'", ">=", 0LL, "");
        _fct_TiCell(_ttg_cb_frmPduVar5_3_0_4_2_3_3_0.KostiaRspSigALCMByte6.phys);
        _fct_TiCellResult((CheckSignalMatch(CAN::dbNode::ALCM::KostiaRspALCM::KostiaRspSigALCMByte6,_ttg_cb_frmPduVar5_3_0_4_2_3_3_0.KostiaRspSigALCMByte6.phys, 0LL, ">=") == 1));
        _fct_TiNameOpValue(0, "CAN signal \'KostiaRspSigALCMByte7\'", ">=", 0LL, "");
        _fct_TiCell(_ttg_cb_frmPduVar5_3_0_4_2_3_3_0.KostiaRspSigALCMByte7.phys);
        _fct_TiCellResult((CheckSignalMatch(CAN::dbNode::ALCM::KostiaRspALCM::KostiaRspSigALCMByte7,_ttg_cb_frmPduVar5_3_0_4_2_3_3_0.KostiaRspSigALCMByte7.phys, 0LL, ">=") == 1));
      }
      _fct_TiTableEnd("Resp1", 0, 0);
    }
    _fct_Verdict_RespParam_wResult(result, 0);
  }
  // _ttg_!_3_0_4_2_3
  TestCommandEnd();
  if(_fct_DoStop(EVerdBOF_TC, 0))
  {
    return;
  }
}
// _ttg_#_3_0_4_2
dword _ttg_callback_requestresponse_3_0_4_2_2_4_0(message *msgIn)
{
  if(_ttg_cb_frameCntVar4_3_0_4_2_2_4_0 == -1 /*frame found?*/)
  {
    _ttg_cb_frameCntVar4_3_0_4_2_2_4_0 = -1; return 1;
  }
  _ttg_cb_frmPduVar4_3_0_4_2_2_4_0 = msgIn;
  _ttg_cb_frameCntVar4_3_0_4_2_2_4_0++;
  if(msgIn.DLC!=8LL)
  {
    return 0;
  }
  if((CheckSignalMatch(CAN::dbNode::ALCM::KostiaRspALCM::KostiaRspSigALCMByte0,_ttg_cb_frmPduVar4_3_0_4_2_2_4_0.KostiaRspSigALCMByte0.phys, 0x1LL, "=") == 1) && (CheckSignalMatch(CAN::dbNode::ALCM::KostiaRspALCM::KostiaRspSigALCMByte1,_ttg_cb_frmPduVar4_3_0_4_2_2_4_0.KostiaRspSigALCMByte1.phys, 0x4BLL, "=") == 1) && (CheckSignalMatch(CAN::dbNode::ALCM::KostiaRspALCM::KostiaRspSigALCMByte2,_ttg_cb_frmPduVar4_3_0_4_2_2_4_0.KostiaRspSigALCMByte2.phys, 0x4FLL, "=") == 1) && (CheckSignalMatch(CAN::dbNode::ALCM::KostiaRspALCM::KostiaRspSigALCMByte3,_ttg_cb_frmPduVar4_3_0_4_2_2_4_0.KostiaRspSigALCMByte3.phys, 0x53LL, "=") == 1) && (CheckSignalMatch(CAN::dbNode::ALCM::KostiaRspALCM::KostiaRspSigALCMByte4,_ttg_cb_frmPduVar4_3_0_4_2_2_4_0.KostiaRspSigALCMByte4.phys, 0x54LL, "=") == 1) && (CheckSignalMatch(CAN::dbNode::ALCM::KostiaRspALCM::KostiaRspSigALCMByte5,_ttg_cb_frmPduVar4_3_0_4_2_2_4_0.KostiaRspSigALCMByte5.phys, 0x41LL, "=") == 1) && (CheckSignalMatch(CAN::dbNode::ALCM::KostiaRspALCM::KostiaRspSigALCMByte6,_ttg_cb_frmPduVar4_3_0_4_2_2_4_0.KostiaRspSigALCMByte6.phys, 0x4CLL, "=") == 1) && (CheckSignalMatch(CAN::dbNode::ALCM::KostiaRspALCM::KostiaRspSigALCMByte7,_ttg_cb_frmPduVar4_3_0_4_2_2_4_0.KostiaRspSigALCMByte7.phys, 0x50LL, "=") == 1))
  {
    _ttg_cb_frameCntVar4_3_0_4_2_2_4_0 = -1; return 1;
  }
  return 0;
  // _ttg_!_3_0_4_2_2
}
dword _ttg_callback_requestresponse_3_0_4_2_3_3_0(message *msgIn)
{
  if(_ttg_cb_frameCntVar5_3_0_4_2_3_3_0 == -1 /*frame found?*/)
  {
    _ttg_cb_frameCntVar5_3_0_4_2_3_3_0 = -1; return 1;
  }
  _ttg_cb_frmPduVar5_3_0_4_2_3_3_0 = msgIn;
  _ttg_cb_frameCntVar5_3_0_4_2_3_3_0++;
  if((CheckSignalMatch(CAN::dbNode::ALCM::KostiaRspALCM::KostiaRspSigALCMByte0,_ttg_cb_frmPduVar5_3_0_4_2_3_3_0.KostiaRspSigALCMByte0.phys, 0LL, ">=") == 1) && (CheckSignalMatch(CAN::dbNode::ALCM::KostiaRspALCM::KostiaRspSigALCMByte1,_ttg_cb_frmPduVar5_3_0_4_2_3_3_0.KostiaRspSigALCMByte1.phys, 0LL, ">=") == 1) && (CheckSignalMatch(CAN::dbNode::ALCM::KostiaRspALCM::KostiaRspSigALCMByte2,_ttg_cb_frmPduVar5_3_0_4_2_3_3_0.KostiaRspSigALCMByte2.phys, 0LL, ">=") == 1) && (CheckSignalMatch(CAN::dbNode::ALCM::KostiaRspALCM::KostiaRspSigALCMByte3,_ttg_cb_frmPduVar5_3_0_4_2_3_3_0.KostiaRspSigALCMByte3.phys, 0LL, ">=") == 1) && (CheckSignalMatch(CAN::dbNode::ALCM::KostiaRspALCM::KostiaRspSigALCMByte4,_ttg_cb_frmPduVar5_3_0_4_2_3_3_0.KostiaRspSigALCMByte4.phys, 0LL, ">=") == 1) && (CheckSignalMatch(CAN::dbNode::ALCM::KostiaRspALCM::KostiaRspSigALCMByte5,_ttg_cb_frmPduVar5_3_0_4_2_3_3_0.KostiaRspSigALCMByte5.phys, 0LL, ">=") == 1) && (CheckSignalMatch(CAN::dbNode::ALCM::KostiaRspALCM::KostiaRspSigALCMByte6,_ttg_cb_frmPduVar5_3_0_4_2_3_3_0.KostiaRspSigALCMByte6.phys, 0LL, ">=") == 1) && (CheckSignalMatch(CAN::dbNode::ALCM::KostiaRspALCM::KostiaRspSigALCMByte7,_ttg_cb_frmPduVar5_3_0_4_2_3_3_0.KostiaRspSigALCMByte7.phys, 0LL, ">=") == 1))
  {
    _ttg_cb_frameCntVar5_3_0_4_2_3_3_0 = -1; return 1;
  }
  return 0;
  // _ttg_!_3_0_4_2_3
}

// CAN
long _fct_SetMsgByte(message * msg, int64 idx, int64 value)
{ 
  if(_fct_allowedCanMsgIdx(msg,idx))
  {
    msg.byte(idx) = (byte)value;
    return 1;
  }
  else
  {
    testStepErrorInTestSystem(0, "", "Index out of range. Unable to set byte %I64d in message.", idx);
    return 0;
  }
}

long _fct_GetMsgByte(message * msg, int64 idx)
{
  if(_fct_allowedCanMsgIdx(msg,idx))
  {
    return msg.byte(idx);
  }
  testStepErrorInTestSystem(0, "", "Index out of range. Unable to get byte %I64d in message.", idx);
  return -1;
}

long _fct_allowedCanMsgIdx(message * msg, int64 idx)
{
  if (idx < 0)
    return 0;

  // Decision: (s. EVAL00122825): for now we just take the upper limit for CAN-FD (64 Bytes)
  // - this saves effort implementing correct values for msg.EDL/msg.DataLength in CANoe-TFS runtime for checks

  //return idx < (msg.EDL ? 64 : 8); // maybe use msg.DLC/msg.DataLength here? (consider different semantics get/set[user can specify DLC], DB-based/Raw-frames)
  return idx < 64;
}

long _fct_SetMsgDlc(message * msg, int64 dlc)
{
  // Note: we can set a DLC of 8 for CAN, but we cannot set a DLC of 16 for CAN FD!
  if((dlc >= 0) && (dlc <= (msg.EDL ? 15 : 8)))
  {
    msg.dlc = dlc;
    return 1;
  }
  else
  {
    testStepErrorInTestSystem(0, "", "Unable to set DLC=%I64d in message.", dlc);
    return 0;
  }
}


// J1939
long _fct_SetMsgByte(pg * j1939pg, int64 idx, int64 value)
{ 
  // Note: j1939pg.dlc is dynamic from DB -> we check static boundaries based on J1939 spec
  if((idx >= 0) && (idx < 1785))
  {
    j1939pg.byte(idx) = (byte)value;
    return 1;
  }
  else
  {
    testStepErrorInTestSystem(0, "", "Index out of range. Unable to set byte %I64d in pg.", idx);
    return 0;
  }
}

long _fct_GetMsgByte(pg * j1939pg, int64 idx)
{
  if((idx >= 0) && (idx < 1785)) // maybe use j1939pg.dlc here?
  {
    return j1939pg.byte(idx);
  }
  testStepErrorInTestSystem(0, "", "Index out of range. Unable to get byte %I64d in pg.", idx);
  _ttg_TestStepInitOk &= 0;
  return -1;
}

long _fct_SetMsgDlc(pg * j1939pg, int64 dlc)
{
  // Note: we can set a DLC of 8 for CAN, but we cannot set a DLC of 16 for CAN FD!
  if((dlc >= 0) && (dlc <= 1785))
  {
    j1939pg.dlc = dlc;
    return 1;
  }
  else
  {
    testStepErrorInTestSystem(0, "", "Unable to set DLC=%I64d in pg.", dlc);
    return 0;
  }
}


// LIN
long _fct_SetMsgByte(linMessage * msg, int64 idx, int64 value)
{ 
  if((idx >= 0) && (idx < 8LL)) // Note: msg.dlc is dynamic from DB
  {
    msg.byte(idx) = (byte)value;
    return 1;
  }
  else
  {
    testStepErrorInTestSystem(0, "", "Index out of range. Unable to set byte %I64d in LIN frame.", idx);
    return 0;
  }
}

long _fct_GetMsgByte(linMessage * msg, int64 idx)
{
  if((idx >= 0) && (idx < 8LL)) // maybe use msg.dlc here?
  {
    return msg.byte(idx);
  }
  testStepErrorInTestSystem(0, "", "Index out of range. Unable to get byte %I64d in message.", idx);
  return -1;
}

long _fct_SetMsgDlc(linMessage * msg, int64 dlc)
{ 
  if((dlc >= 0) && (dlc <= 8))
  {
    msg.dlc = dlc;
    return 1;
  }
  else
  {
    testStepErrorInTestSystem(0, "", "Unable to set DLC=%I64d in LIN frame.", dlc);
    return 0;
  }
}


// FlexRay
long _fct_SetMsgByte(frFrame * msg, int64 idx, int64 value)
{ 
  if((idx >= 0) && (idx < 254LL))
  {
    msg.byte(idx) = (byte)value;
    return 1;
  }
  else
  {
    testStepErrorInTestSystem(0, "", "Index out of range. Unable to set byte %I64d in message.", idx);
    return 0;
  }
}
long _fct_SetMsgByte(frPDU * msg, int64 idx, int64 value)
{ 
  if((idx >= 0) && (idx < 254LL))
  {
    msg.byte(idx) = (byte)value;
    return 1;
  }
  else
  {
    testStepErrorInTestSystem(0, "", "Index out of range. Unable to set byte %I64d in message.", idx);
    return 0;
  }
}

long _fct_GetMsgByte(frFrame * msg, int64 idx)
{ 
  if((idx >= 0) && (idx < 254LL)) // consider msg.FR_PayloadLength?
  {
    return msg.byte(idx);
  }

  testStepErrorInTestSystem(0, "", "Index out of range. Unable to get byte %I64d in message.", idx);
  return -1;
}
long _fct_GetMsgByte(frPDU * msg, int64 idx)
{ 
  if((idx >= 0) && (idx < 254LL)) // consider msg.FR_PayloadLength?
  {
    return msg.byte(idx);
  }

  testStepErrorInTestSystem(0, "", "Index out of range. Unable to get byte %I64d in message.", idx);
  return -1;
}

long _fct_SetMsgPayloadLen(frFrame * msg, int64 plen)
{
  // Note Thb: FR payload length as 16 bit words (not byte count)
  if((plen >= 0) && (plen <= 128LL))
  {
    msg.FR_PayloadLength = plen;
    return 1;
  }
  else
  {
    testStepErrorInTestSystem(0, "", "Unable to set FR_PayloadLength=%I64d in FlexRay frame.", plen);
    return 0;
  }
}

// report
void _fct_Verdict_RespParam_wResult(long res, long expectTimeout)
{
  char testStepText[256];

  // general error occurred
  if (res < 0)
  {
    switch (res)
    {
      case -1:
      default:
        testStepErrorInTestSystem(0, "Resp", "General error (i.e. functionality not available) occurred waiting for response parameter(s) (code: %d).", res);
        break;

      case -2:
        testStepFail(0, "Resp", "A constraint violation occurred occurred waiting for response parameter(s) (code: %d).", res);
        break;

      case -999: // error value for aborting a condition
        testStepInconclusive(0, "Resp", "Condition has been aborted while waiting for response parameter(s) (code: %d).", res);
        break;
    }
    return;
  }

  if (res == 0)
    snprintf(testStepText, elCount(testStepText), "Timeout occurred waiting for response parameter(s).");
  else
    snprintf(testStepText, elCount(testStepText), "Response received successfully.");

  if(expectTimeout ? (res == 0) : (res > 0))
    testStepPass(0, "Resp", testStepText);
  else
    testStepFail(0, "Resp", testStepText);
}

