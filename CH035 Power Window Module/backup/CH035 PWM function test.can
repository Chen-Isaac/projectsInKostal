/*@!Encoding:936*/
includes
{
  #include "D:\\Isaac\\Library\\vtSystem\\vtSystemSetting.cin"
}

variables
{
  
}

