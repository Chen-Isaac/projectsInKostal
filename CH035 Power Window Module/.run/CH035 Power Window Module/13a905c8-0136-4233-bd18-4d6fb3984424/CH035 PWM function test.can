/*@!Encoding:936*/
includes
{
}

variables
{

}

export void vtSystemPowerSupplyInitSetting (int moduleNo,int outputChannelNo,int interConnectionMode) {
  /*Mode
  0 Internal Power Supply only (mode supint)
  1 Power Supply 1 only (mode sup1)
  2 Power Supply 2 only (mode sup2)
  3 Two independent power supplies for OUT1 and OUT2: internal power supply and power supply 1 (mode supint_sup1)
  4 Two independent power supplies for OUT1 and OUT2: internal power supply and power supply 2 (mode supint_sup2)
  5 Two independent power supplies for OUT1 and OUT2: power supply 1 and internal power supply (mode sup1_supint)
  6 Two independent power supplies for OUT1 and OUT2: power supply 1 and power supply 2 (mode sup1_sup2)
  7 Two independent power supplies for OUT1 and OUT2: power supply 2 and internal power supply (mode sup2_supint)
  8 Two independent power supplies for OUT1 and OUT2: power supply 2 and power supply 1 (mode sup2_sup1)
  9 Power supply 1 and power supply 2 are connected in series (sup_series)
  10 Power supply 1 and power supply 2 are connected parallel (sup_parallel)*/
  char namespace[100];
  snprintf(namespace,elcount(namespace),"VTS::M%d_VT7001",moduleNo);
  vtsSetInterconnectionMode(namespace,interConnectionMode);//sysvar::VTS::M12_VT7001.SetInterconnectionMode(0);//Interconnection settings mode:supint,internal power supply connects to both I1 & I2.
  snprintf(namespace,elcount(namespace),"VTS::M%d_SupInt",moduleNo);
  vtsSetRefVoltageMode(namespace,1);//sysvar::VTS::M12_SupInt.SetRefVoltageMode(1);//M12_SupInt:Output:Ref Voltage mode = constant
  snprintf(namespace,elcount(namespace),"VTS::M%d_Out%d",moduleNo,outputChannelNo);
  sysSetVariableInt(namespace,"Active",1);//@sysvar::VTS::M12_Out2::Active = 1;//M12_Out2:OUT2 pin connects to I2;
}

export void vtSystemOnlyUsingExternalPowerSupplyInitSetting (int moduleNo,int outputChannelNo,int externalPowerInputChannel) {
  /*interConnectionMode
  0 Internal Power Supply only (mode supint)
  1 Power Supply 1 only (mode sup1)
  2 Power Supply 2 only (mode sup2)
  3 Two independent power supplies for OUT1 and OUT2: internal power supply and power supply 1 (mode supint_sup1)
  4 Two independent power supplies for OUT1 and OUT2: internal power supply and power supply 2 (mode supint_sup2)
  5 Two independent power supplies for OUT1 and OUT2: power supply 1 and internal power supply (mode sup1_supint)
  6 Two independent power supplies for OUT1 and OUT2: power supply 1 and power supply 2 (mode sup1_sup2)
  7 Two independent power supplies for OUT1 and OUT2: power supply 2 and internal power supply (mode sup2_supint)
  8 Two independent power supplies for OUT1 and OUT2: power supply 2 and power supply 1 (mode sup2_sup1)
  9 Power supply 1 and power supply 2 are connected in series (sup_series)
  10 Power supply 1 and power supply 2 are connected parallel (sup_parallel)*/
  char namespace[100];
  snprintf(namespace,elcount(namespace),"VTS::M%d_VT7001",moduleNo);
  vtsSetInterconnectionMode(namespace,externalPowerInputChannel);//sysvar::VTS::M12_VT7001.SetInterconnectionMode(1);
  if ((externalPowerInputChannel !=1)&& (externalPowerInputChannel !=2))
    testStepFail("Wrong parameter input","externalPowerInputChannel !=1 && externalPowerInputChannel !=2");  
  else {
    snprintf(namespace,elcount(namespace),"VTS::M%d_Sup%d",moduleNo,externalPowerInputChannel);
    vtsSetRefVoltageMode(namespace,1);//sysvar::VTS::M12_Sup1.SetRefVoltageMode(1);//M12_Sup1 output: Ref Voltage Mode = constant
    vtsSetMaxCurrentMode(namespace,1);//sysvar::VTS::M12_Sup1.SetMaxCurrentMode(1); //max current mode = constant
    snprintf(namespace,elcount(namespace),"VTS::M%d_Out%d",moduleNo,outputChannelNo);
    sysSetVariableInt(namespace,"Active",1);//@sysvar::VTS::M12_Out1::Active = 1;//M12_Out1:OUT1 pin connects to I1;
  }
}

export void vtSystemPowerSupplyVoltSetting (int moduleNo,float volt) {
  char namespace[100];
  snprintf(namespace,elcount(namespace),"VTS::M%d_SupInt",moduleNo);//***need to be updated
  sysSetVariableFloat(namespace,"RefVoltage",volt);
  testWaitForTimeout(1000);
  testStep("set VBAT voltage status","set VBAT voltage = %4.2fV.",volt);
}

export void vtSystemExternalPowerSupplySetting (int moduleNo,int externalPowerInputChannel,float volt,float maxI,int k) {
  char namespace[100];
  snprintf(namespace,elcount(namespace),"VTS::M%d_Sup%d",moduleNo,externalPowerInputChannel);
  sysSetVariableFloat(namespace,"RefVoltage",volt/k);//@sysvar::VTS::M12_Sup1::RefVoltage = 1.0v;
  testStep("set external power supply control voltage","set @sysvar::VTS::M%d_Sup%d::RefVoltage = %2.1fv;.",moduleNo,externalPowerInputChannel,volt/k);
  sysSetVariableFloat(namespace,"MaxCurrent",maxI/k);//@sysvar::VTS::M12_Sup1::MaxCurrent = 2.5;
  testStep("set external power supply control voltage","set @sysvar::VTS::M%d_Sup%d::MaxCurrent = %2.1fv;.",moduleNo,externalPowerInputChannel,maxI/k);
  testWaitForTimeout(1000);
}

export float readVtSystemPowerSupplyVolt (int moduleNo,int outputChannelNo,float highLimitV,float lowLimitV) {
  char namespace[100];
  float readValue;
  snprintf(namespace,elcount(namespace),"VTS::M%d_Out%d",moduleNo,outputChannelNo);
  readValue = sysGetVariableFloat(namespace,"AvgVoltage");
  if ((readValue < lowLimitV) || (readValue > highLimitV)) 
     testStepFail("get VBAT voltage status","VBAT = %4.2fV,out of range [%3.1fV~%3.1fV],",readValue,lowLimitV,highLimitV);
  else
     testStepPass("get VBAT voltage status","VBAT = %4.2fV,in the range [%3.1fV~%3.1fV],",readValue,lowLimitV,highLimitV);
  return readValue;
}

export float readVtSystemPowerSupplyCurrent (int moduleNo,int outputChannelNo,float highLimitA,float lowLimitA,int measureRange) {
  char namespace[100];
  float readValue;
  snprintf(namespace,elcount(namespace),"VTS::M%d_Out%d",moduleNo,outputChannelNo);
  /*Range
  Determines up to which range the automatic measuring range changeover may changes over:
  0: All measuring ranges will be used.
  1: Lowermost used range: 100μA..1mA
  2: Lowermost used range: 1mA..10mA
  3: Lowermost used range: 10mA..100mA
  4: Lowermost used range: 100mA..1A
  5: Lowermost used range: 1A..10A
  6: Lowermost used range: 10A..100A*/
  vtsSetMinCurrentMeasurementRange(namespace,measureRange);//sysvar::VTS::M12_Out1.SetMinCurrentMeasurementRange(0);
  readValue = sysGetVariableFloat(namespace,"AvgCurrent");
  if ((readValue < lowLimitA) || (readValue > highLimitA)) 
     testStepFail("get VBAT current status","VBAT current = %6.3fmA,out of range [%6.3fmA~%6.3fmA],",readValue*1000,lowLimitA*1000,highLimitA*1000);
  else
     testStepPass("get VBAT current status","VBAT current = %6.3fmA,in the range [%6.3fmA~%6.3fmA],",readValue*1000,lowLimitA*1000,highLimitA*1000);  
  return readValue;
}

export void checkProductPwmOutput (int moduleNo,int channelNo,float expectedFreq,float expectedDuty) {
  char namespace[100];
  float pwmFreq;
  float pwmDc;
  snprintf(namespace,elcount(namespace),"VTS::M%d_Ch%d",moduleNo,channelNo);
  pwmFreq = sysGetVariableFloat(namespace,"PWMFreq");
  pwmDc = sysGetVariableFloat(namespace,"PWMDC");
  if ((pwmFreq > expectedFreq*0.995) && (pwmFreq < expectedFreq*1.005))
    testStepPass("check PWM Frequency","PWM output frequency = %4.1fHz",pwmFreq);
  else
    testStepFail("check PWM Frequency","PWM output frequency = %4.1fHz,out of range [%4.1f-%4.1f]Hz.",pwmFreq,expectedFreq*0.995,expectedFreq*1.005);
  if ((pwmDc > expectedDuty-3) && (pwmDc < expectedDuty+3))
    testStepPass("check PWM Duty","PWM output duty is %3.1f%%",pwmDc);
  else
    testStepFail("check PWM Duty","PWM output duty is %3.1f%%,out of range [%3.1f%%-%3.1f%%].",pwmDc,expectedDuty-3,expectedDuty+3);
}

export void setChannelOutputDigitalLevel (int moduleNo,int channelNo,int digitalLevel,char productPinName[]) {
  char namespace[100];
  char level[20];
  snprintf(namespace,elcount(namespace),"VTS::M%d_Ch%d",moduleNo,channelNo);
  sysSetVariableInt(namespace,"RelayVBatt",digitalLevel);
  if (digitalLevel)
    strncpy(level,"high",5);
  else
    strncpy(level,"low",4);
  testStep("VT outputs digital level for product input pin","For pin %s:Module%d channel%d generates %s digital level.",productPinName,moduleNo,channelNo,level);
}

export void setChannelOutputAnalogValue (int moduleNo,int channelNo,float analogValue,char productPinName[]) {
  char namespace[100];
  snprintf(namespace,elcount(namespace),"VTS::M%d_Ch%d",moduleNo,channelNo);
  vtsSetStimulationMode(namespace,0);//sysvar::VTS::M9_Ch5.SetStimulationMode(0);//stim mode inactive
  vtsSetCurveType(namespace,0);//sysvar::VTS::M9_Ch5.SetCurveType(0);//set curve type as constant
  vtsSetPWMVoltageHigh(namespace,analogValue);//sysvar::VTS::M9_Ch5.SetPWMVoltageHigh(random(6)+7);//set voltagelow 7-12
  sysSetVariableInt(namespace,"DigitalOutput",1);//@sysvar::VTS::M9_Ch5::DigitalOutput = 1;//output digital=1
  vtsSetStimulationMode(namespace,1);//sysvar::VTS::M9_Ch5.SetStimulationMode(1);//stim mode as voltage
  testStep("VT outputs analog value for product input pin","For pin %s:Module%d channel%d generates analog voltage: voltage = %3.1fV",productPinName,moduleNo,channelNo,analogValue);
}

export void setChannelOutputPwm (int moduleNo,int channelNo,float pwmFreq,float pwmVoltageLow,float pwmVoltageHigh,float pwmDuty,char productPinName[]) {
  char namespace[100];
  snprintf(namespace,elCount(namespace),"VTS::M%d_Ch%d",moduleNo,channelNo);
  vtsSetStimulationMode(namespace,0);//sysvar::VTS::M9_Ch3.SetStimulationMode(0);//stim mode inactive
  vtsSetPWMVoltageLow(namespace,pwmVoltageLow);//sysvar::VTS::M9_Ch3.SetPWMVoltageLow(random(3)+1);//set voltagelow 1-3
  vtsSetPWMVoltageHigh(namespace,pwmVoltageHigh);//sysvar::VTS::M9_Ch3.SetPWMVoltageHigh(12);//set voltagehigh 7-15 
  vtsSetCurveType(namespace,1);//sysvar::VTS::M9_Ch3.SetCurveType(1);//set curve type as PWM
  sysSetVariableFloat(namespace,"PWMOutputFreq",pwmFreq); //@sysvar::VTS::M9_Ch3::PWMOutputFreq = 100;//PWM output Freq =100Hz
  sysSetVariableFloat(namespace,"PWMOutputDC",pwmDuty);//@sysvar::VTS::M9_Ch3::PWMOutputDC = 10;
  vtsSetStimulationMode(namespace,1);//sysvar::VTS::M9_Ch3.SetStimulationMode(1);//stim mode as voltage
  vtsStartStimulation(namespace);//sysvar::VTS::M9_Ch3.StartStimulation();
  testStep("VT outputs PWM for product input pin","For pin %s:Module%d channel%d generates PWM:Highvolt=%3.1fV,Lowvolt=%3.1fV,Duty=%3.1f%%,Freq=%5.2fHz",productPinName,moduleNo,channelNo,pwmVoltageHigh,pwmVoltageLow,pwmDuty,pwmFreq);
}
