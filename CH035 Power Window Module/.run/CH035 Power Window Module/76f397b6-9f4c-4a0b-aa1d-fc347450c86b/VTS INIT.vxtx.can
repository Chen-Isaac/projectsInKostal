/* !Encoding: 65001  */
// Generated with version 2.0.16.0
variables
{
  // global general purpose buffers
  char _ttg_B[2000];
  char _ttg_BC[2000];
  char _ttg_BR[2000];
  long _ttg_verdict;
  long _ttg_Re;
  long _ttg_TestActionFailCnt;
  long _ttg_TestStepInitOk;
  int64 _ttg_I64;
  double _ttg_Double;
  dword _ttg_gBusContextNew = 0;
  dword _ttg_gBusContextOld = 0;
  int64 _ttg_gBusContextOk = 0;
  // FlexRay configuration
  FRConfiguration _ttg_gFRConfiguration;
  long _ttg_gFRNumberOfStaticSlots[32];
  long _ttg_gFRPayloadLengthStatic[32];
  // globals for user defined variables
  // global declarations
}
void _fct_Wait(char step[], int64 timeInNs, int64 unitInNs, char valueSymbol[])
{
  char b[400];
  if(unitInNs == 1LL)
  {
    if(valueSymbol[0] == 0)
      snprintf(b, elcount(b), "%I64d ns", timeInNs);
    else
      snprintf(b, elcount(b), "%I64d (%s) ns", timeInNs, valueSymbol);
  }
  else if(unitInNs == 1000LL)
  {
    if(valueSymbol[0] == 0)
      snprintf(b, elcount(b), "%.3f us", (1.0 * timeInNs) / unitInNs);
    else
      snprintf(b, elcount(b), "%.3f (%s) us", (1.0 * timeInNs) / unitInNs, valueSymbol);
  }
  else if(unitInNs == 1000000LL)
  {
    if(valueSymbol[0] == 0)
      snprintf(b, elcount(b), "%.3f ms", (1.0 * timeInNs) / unitInNs);
    else
      snprintf(b, elcount(b), "%.3f (%s) ms", (1.0 * timeInNs) / unitInNs, valueSymbol);
  }
  else if(unitInNs == 1000000000LL)
  {
    if(valueSymbol[0] == 0)
      snprintf(b, elcount(b), "%.3f s", (1.0 * timeInNs) / unitInNs);
    else
      snprintf(b, elcount(b), "%.3f (%s) s", (1.0 * timeInNs) / unitInNs, valueSymbol);
  }
  if(timeInNs > 0)
  {
    if(0 == testWaitForTimeoutNS(timeInNs))
      testStepPass(2, step, "Waited for %s", b);
    else
      testStepFail(0, step, "Waited for %s", b);
  }
  else if(timeInNs  == 0)
  {
    // do not wait
    testStepPass(2, step, "Waited for %s", b);
  }
  else
  {
    testStepFail(0, step, "Unable to wait for %s. Please check input parameter.", b);
  }
}

void _fct_CommandVerdict(long verdict)
{
  if(_ttg_verdict == 1) // failed
    return; // setting verdict from 'failed' to 'pass' is not possible
  _ttg_verdict = verdict;
}

int _fct_TcDoBOF()
{
  return TestGetVerdictLastTestCase()==1 && !testIsBreakOnFailDeactivated();
}

int _fct_TsDoBOF()
{
  return TestGetVerdictLastTestSequence()==1 && !testIsBreakOnFailDeactivated();
}

int _fct_LoopIsBlocking()
{ 
  // works for nested loops, too
  dword timeLoopNow, timeLoopOld, cntTimeEqual;
  timeLoopNow = timeNow();
  if(timeLoopNow > timeLoopOld)
  {
    cntTimeEqual = 0;
  }
  else
  {
    ++cntTimeEqual;
    if(cntTimeEqual >= 1000)
    {
      // busy loop detected
      testStepFail(0, "", "Blocking loop detected. Aborted after 1000 cycles have been performed at the same time.");
      return 1;
    }
  }
  timeLoopOld = timeLoopNow;
  return 0;
}

void _fct_CallTsTc(char function[], dword fType, dword isExported, char title[])
{
  CreateTTEIFFunction(function, fType, isExported);
  CallInterfaceFunction(title);
}

void _fct_TestControlStructEnd(long count)
{
  // call TestControlStructEnd count times to close report scope in nested ifs
  long i;
  for(i = 0; i < count; ++i)
    TestControlStructEnd(_ttg_verdict);
}

void _fct_IfTableHead(char inCondition[], int bCondition)
{
  char localBuf[2048];

  snprintf(localBuf, elCount(localBuf), "Condition %s: ", inCondition);
  if(bCondition)
  {
    strncat(localBuf, "true", elCount(localBuf));
  }
  else
  {
    strncat(localBuf, "false", elCount(localBuf));
  }

  _fct_TiTableHeadExpectedEx(localBuf);
}

int _fct_DoElseIf(int bDone)
{
  if(bDone)
  {
    testStep(0, "", "Previous condition matched, skipping block.");
    return 0;
  }
  return 1;
}

int _fct_DoElse(int bDone)
{
  if(bDone)
  {
    testStep(0, "", "Previous condition matched, skipping block.");
    return 0;
  }
  else
  {
    testStep(0, "", "No condition matched, executing 'else' block.");
    return 1;
  }
}
void _fct_TiTableHeadInit()
{
  _ttg_TestActionFailCnt = 0;
}

void _fct_TiTableHeadAssignment()
{
  _fct_TiTableHeadInit();
  _ttg_Re = testInfoTable("Stimulation of values");
  testInfoHeadingBegin(_ttg_Re, 0);
  _fct_TiCell("Symbol");
  _fct_TiCell("Op.");
  _fct_TiCell("Assigned");
  testInfoHeadingEnd(_ttg_Re);
}


void _fct_TiTableFunctionCallReturnValue(char callSig[])
{
  char localBuf[256];
  _fct_TiTableHeadInit();
  snprintf(localBuf, elCount(localBuf), "Function call: %s", callSig);
  _ttg_Re = testInfoTable(localBuf);
  testInfoHeadingBegin(_ttg_Re, 0);
  _fct_TiCell("Symbol");
  _fct_TiCell("Op.");
  _fct_TiCell("Return Value");
  testInfoHeadingEnd(_ttg_Re);
}

void _fct_TiTableWaveformStimulus()
{
  _fct_TiTableHeadInit();
  _ttg_Re = testInfoTable("Stimulation of values with waveform curves");
   testInfoHeadingBegin(_ttg_Re, 0);
   _fct_TiCell("Symbol");
   _fct_TiCell("Stimulated with curve");
   testInfoHeadingEnd(_ttg_Re);
}

void _fct_TiTableHeadSetVariables()
{
  _fct_TiTableHeadInit();
  _ttg_Re = testInfoTable("Setting variable values");
  testInfoHeadingBegin(_ttg_Re, 0);
  _fct_TiCell("Variable");
  _fct_TiCell("Op.");
  _fct_TiCell("Assigned");
  testInfoHeadingEnd(_ttg_Re);
}
void _fct_TiTableHeadReport(char userText[])
{
  _fct_TiTableHeadInit();
  _ttg_Re = testInfoTable(userText);
  testInfoHeadingBegin(_ttg_Re, 0);
  _fct_TiCell("Symbol");
  _fct_TiCell("Value");
  testInfoHeadingEnd(_ttg_Re);
}
void _fct_TiTableHeadSend(char msgDesc[])
{
  char b[200];
  _fct_TiTableHeadInit();
  snprintf(b, elcount(b), "Send %s", msgDesc);
  _ttg_Re = testInfoTable(b);
  testInfoHeadingBegin(_ttg_Re, 0);
  _fct_TiCell("Signal/Byte");
  _fct_TiCell("Op.");
  _fct_TiCell("Assigned");
  testInfoHeadingEnd(_ttg_Re);
}

void _fct_TiTableHeadExpected()
{
  _fct_TiTableHeadExpectedEx("Check of expected values");
}

void _fct_TiTableHeadExpectedEx(char title[])
{
  _fct_TiTableHeadInit();
  _ttg_Re = testInfoTable(title);
  testInfoHeadingBegin(_ttg_Re, 0);
  _fct_TiCell("Symbol");
  _fct_TiCell("Op.");
  _fct_TiCell("Reference Value");
  _fct_TiCell("Actual");
  _fct_TiCell("Result");
  testInfoHeadingEnd(_ttg_Re);
}
void _fct_TiTableHeadResponse(char msgDesc[], int numReceived)
{
  char b[200];
  _fct_TiTableHeadInit();
  if (numReceived == -1)
    snprintf(b, elcount(b), "Response of %s", msgDesc); // maybe received after x MS?
  else
    snprintf(b, elcount(b), "Response of %s (received %d times)", msgDesc, numReceived);
  _ttg_Re = testInfoTable(b);
  testInfoHeadingBegin(_ttg_Re, 0);
  _fct_TiCell("Signal/Byte");
  _fct_TiCell("Op.");
  _fct_TiCell("Reference Value");
  if (numReceived == -1)
    _fct_TiCell("Actual");
  else
    _fct_TiCell("Last Received");
  _fct_TiCell("Result");
  testInfoHeadingEnd(_ttg_Re);
}

void _fct_TiCell(char text[])
{
  testInfoCell(_ttg_Re, text);
}

void _fct_TiCellResult(long condition)
{
  if(condition)
    _fct_TiCell("pass");
  else
  {
    _fct_TiCell("fail");
    ++_ttg_TestActionFailCnt;
  }
}

void _fct_TiCellResultTrueFalse(long condition)
{
  if(condition)
    _fct_TiCell("true");
  else
  {
    _fct_TiCell("false");
    ++_ttg_TestActionFailCnt;
  }
}

void _fct_TiCell(int64 value)
{
  _fct_TiIntCell(value);
}
void _fct_TiIntCell(int64 value)
{
  snprintf(_ttg_BR, elcount(_ttg_BR), "%I64d", value);
  _fct_TiCell(_ttg_BR);
}

void _fct_TiCell(double value)
{
  _fct_TiFloatCell(value);
}
void _fct_TiFloatCell(double value)
{
  snprintf(_ttg_BR, elcount(_ttg_BR), "%.15g", value);
  _fct_TiCell(_ttg_BR);
}

void _fct_TiRow(long indent, char firstCellContent[])
{
  testInfoRow(_ttg_Re, indent, firstCellContent);
}

void _fct_TiWriteByteX(int64 idx, char valueSymbol[], char nameOut[])
{
  if(valueSymbol[0] == 0)
    snprintf(nameOut, elcount(nameOut), "Byte[%I64d]", idx);
  else
    snprintf(nameOut, elcount(nameOut), "Byte[%I64d (%s)]", idx, valueSymbol);
}

void _fct_TiTableEvaluation(char stepIdentifier[])
{
  if(_ttg_TestActionFailCnt > 0)
  {
    testStepFail(0, stepIdentifier, _ttg_Re);
  }
  else
  {
    testStepPass(2, stepIdentifier, _ttg_Re);
  }
}

void _fct_TiTableEnd(char step[])
{
  testStep(2, step, _ttg_Re);
}


// report a byte stream
void _fct_TiCell_Bytes( long handle, BYTE rawBytes[], long count)
{
  char byteDigits[17];
  char byteDump[ 32 * 3 + 15]; // Only print up to 32 bytes in the first step -> also in "min..." below!
  long max;
  long i;
  long p;
  strncpy( byteDigits, "0123456789ABCDEF", 17); // Do explicit copy to prevent "initialized only once" warning

  p = snprintf( byteDump, elcount( byteDump), "[%d] ", count);
  max = _min( 32, count);
  for( i = 0; i < max; ++i)
  {
    byteDump[p++] = byteDigits[rawBytes[i] >> 4];
    byteDump[p++] = byteDigits[rawBytes[i] & 0xF];
    byteDump[p++] = ' ';
  }
  if( max < count)
  {
    byteDump[p++] = '.';
    byteDump[p++] = '.';
    byteDump[p++] = '.';
  }
  byteDump[--p] = 0;

  testInfoCell( handle, byteDump);
}

void _fct_SetBusContext(char bus[], int saveOldBusContext)
{
  _ttg_gBusContextOk = 1;
  _ttg_gBusContextNew = GetBusNameContext(bus);
  if(_ttg_gBusContextNew == 0)
  {
    _ttg_gBusContextOk = 0;
    testStepFail("", "Error: Cannot determine context for bus: %s", bus);
    _ttg_gBusContextOld = 0;
    return;
  }
  if(saveOldBusContext == 1)
  {
    _ttg_gBusContextOld = SetBusContext(_ttg_gBusContextNew);
  }
  else
  {
    SetBusContext(_ttg_gBusContextNew);
  }
}

void _fct_ResetBusContext()
{
  if(_ttg_gBusContextOld > 0)
  {
    SetBusContext(_ttg_gBusContextNew);
  }
}

int _fct_BusContextOk()
{
  return _ttg_gBusContextOk;
}

// _fct_EnsureSymbolName(SysVarFloat)
_fct_EnsureSymbolName(sysvarFloat * sym, char nameIn[], char nameOut[])
{
  if(strlen(nameIn) == 0)
  {
    snprintf(nameOut, elcount(nameOut), "System variable '%s'", sym.Name );
  }
  else { strncpy(nameOut, nameIn, elCount(nameOut)); }
}

// _fct_TiNameOpValue(Float)
_fct_TiNameOpValue(long indent, char nameIn[], char op[], float valueIn, char dstNameIn[])
{
  
  _fct_TiRow(indent, nameIn);
  _fct_TiCell(op);
  if (strlen(dstNameIn) == 0)
  {
    snprintf(_ttg_B, elCount(_ttg_B), "%.15g", valueIn);
  }
  else
  {
    snprintf(_ttg_B, elCount(_ttg_B), "%.15g (%s)", valueIn, dstNameIn);
  }
  _fct_TiCell(_ttg_B);

}

// _fct_TiValueCell(SysVarFloat)
_fct_TiValueCell(sysvarFloat * valueIn)
{
  _fct_TiCell(@valueIn);
}

// _fct_ChckRep(SysVarFloat,Float)
_fct_ChckRep(long indent, sysvarFloat * lSym, char lName[], char operator[], float rSym, char rName[])
{
  char symLNameBuf[256];
  _fct_EnsureSymbolName(lSym,lName,symLNameBuf);
  _fct_TiNameOpValue(indent, symLNameBuf, operator, rSym, rName);
  _fct_TiValueCell(lSym);
}

// _fct_TiNameOpValue(Int64)
_fct_TiNameOpValue(long indent, char nameIn[], char op[], int64 valueIn, char dstNameIn[])
{
  
  _fct_TiRow(indent, nameIn);
  _fct_TiCell(op);
  if (strlen(dstNameIn) == 0)
  {
    snprintf(_ttg_B, elCount(_ttg_B), "%I64d", valueIn);
  }
  else
  {
    snprintf(_ttg_B, elCount(_ttg_B), "%I64d (%s)", valueIn, dstNameIn);
  }
  _fct_TiCell(_ttg_B);

}

// _fct_ChckRep(SysVarFloat,Int64)
_fct_ChckRep(long indent, sysvarFloat * lSym, char lName[], char operator[], int64 rSym, char rName[])
{
  char symLNameBuf[256];
  _fct_EnsureSymbolName(lSym,lName,symLNameBuf);
  _fct_TiNameOpValue(indent, symLNameBuf, operator, rSym, rName);
  _fct_TiValueCell(lSym);
}

// _fct_ReportValue(SysVarFloat)
_fct_ReportValue(long indent, sysvarFloat * valueIn, char nameIn[])
{
  char symNameBuf[256];
  _fct_EnsureSymbolName(valueIn,nameIn,symNameBuf);
  _fct_TiRow(indent, symNameBuf);
  _fct_TiCell(@valueIn);
}

// Test Tree
void _ttg_fct_tt_8_0()
{
  // Init FlexRay configuration
}
// _ttg_#_8_0
// VTS INIT
void _ttg_fct_ts_8_0_0()
{
  _fct_CallTsTc("_ttg_ts_ts_8_0_0",3, 0,"VTS INIT");
}
// _ttg_#_8_0_0
// VTS INIT
testsequence _ttg_ts_ts_8_0_0()
{
  TestCommandBegin("CAPL Inline", "");
  {
    _ttg_fct_caplinline_8_0_0_2();
  }
  // _ttg_!_8_0_0_2
  TestCommandEnd();
  if(_fct_TsDoBOF() || testIsStopRequested())
  {
    return;
  }
  TestCommandBegin("Wait", "");
  {
    _fct_Wait("1", (int64)(300LL * 1000000LL), 1000000, "");
  }
  // _ttg_!_8_0_0_3
  TestCommandEnd();
  if(_fct_TsDoBOF() || testIsStopRequested())
  {
    return;
  }
  TestCommandBegin("Check", "");
  {
    _fct_TiTableHeadExpected();
    _fct_ChckRep(0, sysvarFloat::VTS::M12_Out1::AvgCurrent, "System variable \'M12_Out1::AvgCurrent\'", "<", 0.2, "");
    _fct_TiCellResult((CheckSignalMatch(sysvarFloat::VTS::M12_Out1::AvgCurrent, 0.2, "<") == 1));
    _fct_ChckRep(0, sysvarFloat::VTS::M12_Out1::AvgVoltage, "System variable \'M12_Out1::AvgVoltage\'", ">=", 11.5, "");
    _fct_TiCellResult((CheckSignalMatch(sysvarFloat::VTS::M12_Out1::AvgVoltage, 11.5, ">=") == 1));
    _fct_TiTableEvaluation("1");
  }
  // _ttg_!_8_0_0_4
  TestCommandEnd();
  if(_fct_TsDoBOF() || testIsStopRequested())
  {
    return;
  }
  TestCommandBegin("CANoe Standard Service", "testValidateTesterConfirmation");
  {
    testStepPass(2, "", "Execute testValidateTesterConfirmation(\"当车窗升降电机在自动下降过程中，操作相应的手动上升或下降档，该车窗升降电机将立即停止?\", \"Ready to manually lift up\", 1)");
    testValidateTesterConfirmation("当车窗升降电机在自动下降过程中，操作相应的手动上升或下降档，该车窗升降电机将立即停止?", "Ready to manually lift up", 1LL);
  }
  // _ttg_!_8_0_0_6
  TestCommandEnd();
  if(_fct_TsDoBOF() || testIsStopRequested())
  {
    return;
  }
  TestCommandBegin("CANoe Standard Service", "testValidateTesterConfirmation");
  {
    testStepPass(2, "", "Execute testValidateTesterConfirmation(\"当车窗升降电机在手动下降过程中，操作相应的自动下降档，该车窗升降电机将往自动下降方向运动?\", \"Ready to manually lift down\", 1)");
    testValidateTesterConfirmation("当车窗升降电机在手动下降过程中，操作相应的自动下降档，该车窗升降电机将往自动下降方向运动?", "Ready to manually lift down", 1LL);
  }
  // _ttg_!_8_0_0_7
  TestCommandEnd();
  if(_fct_TsDoBOF() || testIsStopRequested())
  {
    return;
  }
  TestCommandBegin("CANoe Standard Service", "testValidateTesterConfirmation");
  {
    testStepPass(2, "", "Execute testValidateTesterConfirmation(\"当车窗上升到顶部发送堵转时，该车窗升降电机将立即停止?\", \"Press the lift up button and make locked roter situation happens in the top. Don\\'t release the button in the course.\", 1)");
    testValidateTesterConfirmation("当车窗上升到顶部发送堵转时，该车窗升降电机将立即停止?", "Press the lift up button and make locked roter situation happens in the top. Don\'t release the button in the course.", 1LL);
  }
  // _ttg_!_8_0_0_8
  TestCommandEnd();
  if(_fct_TsDoBOF() || testIsStopRequested())
  {
    return;
  }
  TestControlStructBegin("While", "While ( M12_Out1::AvgCurrent>1 )");
  _ttg_verdict = -1;
  {
    // begin of while block
    int bCondition;
    while(1)
    {
      {
        bCondition = (CheckSignalMatch(sysvarFloat::VTS::M12_Out1::AvgCurrent, 1LL, ">") == 1);
      }
      if(_fct_LoopIsBlocking())
      {
        _fct_CommandVerdict(1);
        break;
      }
      if(bCondition== 0)
      {
        break;
      }
      TestControlStructBegin("If", "");
      _ttg_verdict = -1;
      {
        int bCondition, bDone;
        bDone = 0;
        {
          {
            bCondition = (CheckSignalMatch(sysvarFloat::VTS::M12_Out1::AvgCurrent, 14LL, ">") == 1);
          }
          _fct_IfTableHead("( M12_Out1::AvgCurrent>14 )", bCondition);
          _fct_ChckRep(0, sysvarFloat::VTS::M12_Out1::AvgCurrent, "System variable \'M12_Out1::AvgCurrent\'", ">", 14LL, "");
          _fct_TiCellResultTrueFalse((CheckSignalMatch(sysvarFloat::VTS::M12_Out1::AvgCurrent, 14LL, ">") == 1));
          _fct_TiTableEnd("");
          if(bCondition)
          {
            bDone = 1;
            TestCommandBegin("Report", "");
            {
              _fct_TiTableHeadReport("Locked roter situation happened");
              _fct_ReportValue(0, sysvarFloat::VTS::M12_Out1::AvgCurrent, "System variable \'M12_Out1::AvgCurrent\'");
              _fct_TiTableEnd("");
            }
            // _ttg_!_8_0_0_9_3_2
            TestCommandEnd();
            if(_fct_TsDoBOF() || testIsStopRequested())
            {
              _fct_TestControlStructEnd(2);
              return;
            }
            TestControlStructBegin("Break", "");
            _ttg_verdict = -1;
            {
              _fct_TestControlStructEnd(1);
              _fct_TestControlStructEnd(1);
              break;
            }
            // _ttg_!_8_0_0_9_3_3
            _fct_TestControlStructEnd(1);
            if(_fct_TsDoBOF() || testIsStopRequested())
            {
              _fct_TestControlStructEnd(2);
              return;
            }
          }
        }
      }
      // _ttg_!_8_0_0_9_3
      _fct_TestControlStructEnd(1);
      if(_fct_TsDoBOF() || testIsStopRequested())
      {
        _fct_TestControlStructEnd(1);
        return;
      }
      TestCommandBegin("Wait", "");
      {
        _fct_Wait("1", (int64)(100LL * 1000000LL), 1000000, "");
      }
      // _ttg_!_8_0_0_9_4
      TestCommandEnd();
      if(_fct_TsDoBOF() || testIsStopRequested())
      {
        _fct_TestControlStructEnd(1);
        return;
      }
    }
    // end of while block
  }
  // _ttg_!_8_0_0_9
  _fct_TestControlStructEnd(1);
  if(_fct_TsDoBOF() || testIsStopRequested())
  {
    return;
  }
  TestCommandBegin("Wait", "");
  {
    _fct_Wait("1", (int64)(1LL * 1000000000LL), 1000000000, "");
  }
  // _ttg_!_8_0_0_10
  TestCommandEnd();
  if(_fct_TsDoBOF() || testIsStopRequested())
  {
    return;
  }
  TestCommandBegin("Check", "Check if the product output has been shutted down.");
  {
    _fct_TiTableHeadExpected();
    _fct_ChckRep(0, sysvarFloat::VTS::M12_Out1::AvgCurrent, "System variable \'M12_Out1::AvgCurrent\'", "<=", 0.2, "");
    _fct_TiCellResult((CheckSignalMatch(sysvarFloat::VTS::M12_Out1::AvgCurrent, 0.2, "<=") == 1));
    _fct_TiTableEvaluation("1");
  }
  // _ttg_!_8_0_0_11
  TestCommandEnd();
  if(_fct_TsDoBOF() || testIsStopRequested())
  {
    return;
  }
  TestCommandBegin("CANoe Standard Service", "testValidateTesterConfirmation");
  {
    testStepPass(2, "", "Execute testValidateTesterConfirmation(\"当车窗下降到底部发送堵转时，该车窗升降电机将立即停止?\", \"Press the lift down button and make locked roter situation happens in the top. Don\\'t release the button in the course.\", 1)");
    testValidateTesterConfirmation("当车窗下降到底部发送堵转时，该车窗升降电机将立即停止?", "Press the lift down button and make locked roter situation happens in the top. Don\'t release the button in the course.", 1LL);
  }
  // _ttg_!_8_0_0_12
  TestCommandEnd();
  if(_fct_TsDoBOF() || testIsStopRequested())
  {
    return;
  }
  TestControlStructBegin("While", "While ( M12_Out1::AvgCurrent>1 )");
  _ttg_verdict = -1;
  {
    // begin of while block
    int bCondition;
    while(1)
    {
      {
        bCondition = (CheckSignalMatch(sysvarFloat::VTS::M12_Out1::AvgCurrent, 1LL, ">") == 1);
      }
      if(_fct_LoopIsBlocking())
      {
        _fct_CommandVerdict(1);
        break;
      }
      if(bCondition== 0)
      {
        break;
      }
      TestControlStructBegin("If", "");
      _ttg_verdict = -1;
      {
        int bCondition, bDone;
        bDone = 0;
        {
          {
            bCondition = (CheckSignalMatch(sysvarFloat::VTS::M12_Out1::AvgCurrent, 12LL, ">") == 1);
          }
          _fct_IfTableHead("( M12_Out1::AvgCurrent>12 )", bCondition);
          _fct_ChckRep(0, sysvarFloat::VTS::M12_Out1::AvgCurrent, "System variable \'M12_Out1::AvgCurrent\'", ">", 12LL, "");
          _fct_TiCellResultTrueFalse((CheckSignalMatch(sysvarFloat::VTS::M12_Out1::AvgCurrent, 12LL, ">") == 1));
          _fct_TiTableEnd("");
          if(bCondition)
          {
            bDone = 1;
            TestCommandBegin("Report", "");
            {
              _fct_TiTableHeadReport("Locked roter situation happened");
              _fct_ReportValue(0, sysvarFloat::VTS::M12_Out1::AvgCurrent, "System variable \'M12_Out1::AvgCurrent\'");
              _fct_TiTableEnd("");
            }
            // _ttg_!_8_0_0_13_3_2
            TestCommandEnd();
            if(_fct_TsDoBOF() || testIsStopRequested())
            {
              _fct_TestControlStructEnd(2);
              return;
            }
            TestControlStructBegin("Break", "");
            _ttg_verdict = -1;
            {
              _fct_TestControlStructEnd(1);
              _fct_TestControlStructEnd(1);
              break;
            }
            // _ttg_!_8_0_0_13_3_3
            _fct_TestControlStructEnd(1);
            if(_fct_TsDoBOF() || testIsStopRequested())
            {
              _fct_TestControlStructEnd(2);
              return;
            }
          }
        }
      }
      // _ttg_!_8_0_0_13_3
      _fct_TestControlStructEnd(1);
      if(_fct_TsDoBOF() || testIsStopRequested())
      {
        _fct_TestControlStructEnd(1);
        return;
      }
      TestCommandBegin("Wait", "");
      {
        _fct_Wait("1", (int64)(100LL * 1000000LL), 1000000, "");
      }
      // _ttg_!_8_0_0_13_4
      TestCommandEnd();
      if(_fct_TsDoBOF() || testIsStopRequested())
      {
        _fct_TestControlStructEnd(1);
        return;
      }
    }
    // end of while block
  }
  // _ttg_!_8_0_0_13
  _fct_TestControlStructEnd(1);
  if(_fct_TsDoBOF() || testIsStopRequested())
  {
    return;
  }
  TestCommandBegin("Wait", "");
  {
    _fct_Wait("1", (int64)(1LL * 1000000000LL), 1000000000, "");
  }
  // _ttg_!_8_0_0_14
  TestCommandEnd();
  if(_fct_TsDoBOF() || testIsStopRequested())
  {
    return;
  }
  TestCommandBegin("Check", "Check if the product output has been shutted down.");
  {
    _fct_TiTableHeadExpected();
    _fct_ChckRep(0, sysvarFloat::VTS::M12_Out1::AvgCurrent, "System variable \'M12_Out1::AvgCurrent\'", "<=", 0.2, "");
    _fct_TiCellResult((CheckSignalMatch(sysvarFloat::VTS::M12_Out1::AvgCurrent, 0.2, "<=") == 1));
    _fct_TiTableEvaluation("1");
  }
  // _ttg_!_8_0_0_15
  TestCommandEnd();
  if(_fct_TsDoBOF() || testIsStopRequested())
  {
    return;
  }
  TestCommandBegin("CANoe Standard Service", "testValidateTesterConfirmation");
  {
    testStepPass(2, "", "Execute testValidateTesterConfirmation(\"Cut down the connection of power window\", \"Make only power resistor connect with the product output\", 1)");
    testValidateTesterConfirmation("Cut down the connection of power window", "Make only power resistor connect with the product output", 1LL);
  }
  // _ttg_!_8_0_0_17
  TestCommandEnd();
  if(_fct_TsDoBOF() || testIsStopRequested())
  {
    return;
  }
  TestCommandBegin("CANoe Standard Service", "testValidateTesterConfirmation");
  {
    testStepPass(2, "", "Execute testValidateTesterConfirmation(\"Ready to press the lift up button, once you start pressing it,press the ok button on the popup.\", \"Keep the button pressed for 10s\", 1)");
    testValidateTesterConfirmation("Ready to press the lift up button, once you start pressing it,press the ok button on the popup.", "Keep the button pressed for 10s", 1LL);
  }
  // _ttg_!_8_0_0_18
  TestCommandEnd();
  if(_fct_TsDoBOF() || testIsStopRequested())
  {
    return;
  }
  TestCommandBegin("Wait", "");
  {
    _fct_Wait("1", (int64)(10LL * 1000000000LL), 1000000000, "");
  }
  // _ttg_!_8_0_0_19
  TestCommandEnd();
  if(_fct_TsDoBOF() || testIsStopRequested())
  {
    return;
  }
  TestCommandBegin("Check", "Check if the product output has been shutted down.");
  {
    _fct_TiTableHeadExpected();
    _fct_ChckRep(0, sysvarFloat::VTS::M12_Out1::AvgCurrent, "System variable \'M12_Out1::AvgCurrent\'", "<=", 0.2, "");
    _fct_TiCellResult((CheckSignalMatch(sysvarFloat::VTS::M12_Out1::AvgCurrent, 0.2, "<=") == 1));
    _fct_TiTableEvaluation("1");
  }
  // _ttg_!_8_0_0_20
  TestCommandEnd();
  if(_fct_TsDoBOF() || testIsStopRequested())
  {
    return;
  }
  TestCommandBegin("CANoe Standard Service", "testValidateTesterConfirmation");
  {
    testStepPass(2, "", "Execute testValidateTesterConfirmation(\"Stop pressing\", \"Stop pressing the button\", 1)");
    testValidateTesterConfirmation("Stop pressing", "Stop pressing the button", 1LL);
  }
  // _ttg_!_8_0_0_21
  TestCommandEnd();
  if(_fct_TsDoBOF() || testIsStopRequested())
  {
    return;
  }
  TestCommandBegin("CANoe Standard Service", "testValidateTesterConfirmation");
  {
    testStepPass(2, "", "Execute testValidateTesterConfirmation(\"Ready to press the lift down button, once you start pressing it,press the ok button on the popup.\", \"Keep the button pressed for 10s\", 1)");
    testValidateTesterConfirmation("Ready to press the lift down button, once you start pressing it,press the ok button on the popup.", "Keep the button pressed for 10s", 1LL);
  }
  // _ttg_!_8_0_0_22
  TestCommandEnd();
  if(_fct_TsDoBOF() || testIsStopRequested())
  {
    return;
  }
  TestCommandBegin("Wait", "");
  {
    _fct_Wait("1", (int64)(10LL * 1000000000LL), 1000000000, "");
  }
  // _ttg_!_8_0_0_23
  TestCommandEnd();
  if(_fct_TsDoBOF() || testIsStopRequested())
  {
    return;
  }
  TestCommandBegin("Check", "Check if the product output has been shutted down.");
  {
    _fct_TiTableHeadExpected();
    _fct_ChckRep(0, sysvarFloat::VTS::M12_Out1::AvgCurrent, "System variable \'M12_Out1::AvgCurrent\'", "<=", 0.2, "");
    _fct_TiCellResult((CheckSignalMatch(sysvarFloat::VTS::M12_Out1::AvgCurrent, 0.2, "<=") == 1));
    _fct_TiTableEvaluation("1");
  }
  // _ttg_!_8_0_0_24
  TestCommandEnd();
  if(_fct_TsDoBOF() || testIsStopRequested())
  {
    return;
  }
  TestCommandBegin("CANoe Standard Service", "testValidateTesterConfirmation");
  {
    testStepPass(2, "", "Execute testValidateTesterConfirmation(\"Stop pressing\", \"Stop pressing the button\", 1)");
    testValidateTesterConfirmation("Stop pressing", "Stop pressing the button", 1LL);
  }
  // _ttg_!_8_0_0_25
  TestCommandEnd();
  if(_fct_TsDoBOF() || testIsStopRequested())
  {
    return;
  }
}
// _ttg_#_8_0_0
void _ttg_fct_caplinline_8_0_0_2()
{
  {
    sysvar::VTS::M12_VT7001.SetInterconnectionMode(1);
sysvar::VTS::M12_Sup1.SetRefVoltageMode(1);
//sysvar::VTS::M12_Sup1.SetRefVoltageMode(mode, 1);
@sysvar::VTS::M12_Sup1::RefVoltage = 1;
sysvar::VTS::M12_Sup1.SetMaxCurrentMode(1);
// sysvar::VTS::M12_Sup1.SetMaxCurrentMode(mode, 1);
@sysvar::VTS::M12_Sup1::MaxCurrent = 2.5;
sysvar::VTS::M12_Out1.ResetMinMax();
sysvar::VTS::M12_Out1.SetMinCurrentMeasurementRange(4);
@sysvar::VTS::M12_Out1::Active = 1;
  }
}
// _ttg_#_8_0_0_2
