/* !Encoding: 65001  */
// Generated with version 2.0.16.0
variables
{
  // global general purpose buffers
  char _ttg_B[2000];
  char _ttg_BC[2000];
  char _ttg_BR[2000];
  long _ttg_verdict;
  long _ttg_Re;
  long _ttg_TestActionFailCnt;
  long _ttg_TestStepInitOk;
  int64 _ttg_I64;
  double _ttg_Double;
  dword _ttg_gBusContextNew = 0;
  dword _ttg_gBusContextOld = 0;
  int64 _ttg_gBusContextOk = 0;
  // FlexRay configuration
  FRConfiguration _ttg_gFRConfiguration;
  long _ttg_gFRNumberOfStaticSlots[32];
  long _ttg_gFRPayloadLengthStatic[32];
  // globals for user defined variables
  int64 _ttg_var_status_3_1_2_1_2_0;
  int64 _ttg_var_chooseOffMethod_3_1_2_1_2_1;
  int64 _ttg_var_driverDoorStatus_3_1_2_2_2_0;
  int64 _ttg_var_driverDoorOpenMethod_3_1_2_2_2_1;
  int64 _ttg_var_vs_tcu_timeoutBool_3_1_2_3_2_0;
  int64 _ttg_var_WHL_SPD_FL_timeoutBool_3_1_2_3_2_1;
  // global declarations
}
void _fct_Wait(char step[], int64 timeInNs, int64 unitInNs, char valueSymbol[])
{
  char b[400];
  if(unitInNs == 1LL)
  {
    if(valueSymbol[0] == 0)
      snprintf(b, elcount(b), "%I64d ns", timeInNs);
    else
      snprintf(b, elcount(b), "%I64d (%s) ns", timeInNs, valueSymbol);
  }
  else if(unitInNs == 1000LL)
  {
    if(valueSymbol[0] == 0)
      snprintf(b, elcount(b), "%.3f us", (1.0 * timeInNs) / unitInNs);
    else
      snprintf(b, elcount(b), "%.3f (%s) us", (1.0 * timeInNs) / unitInNs, valueSymbol);
  }
  else if(unitInNs == 1000000LL)
  {
    if(valueSymbol[0] == 0)
      snprintf(b, elcount(b), "%.3f ms", (1.0 * timeInNs) / unitInNs);
    else
      snprintf(b, elcount(b), "%.3f (%s) ms", (1.0 * timeInNs) / unitInNs, valueSymbol);
  }
  else if(unitInNs == 1000000000LL)
  {
    if(valueSymbol[0] == 0)
      snprintf(b, elcount(b), "%.3f s", (1.0 * timeInNs) / unitInNs);
    else
      snprintf(b, elcount(b), "%.3f (%s) s", (1.0 * timeInNs) / unitInNs, valueSymbol);
  }
  if(timeInNs > 0)
  {
    if(0 == testWaitForTimeoutNS(timeInNs))
      testStepPass(2, step, "Waited for %s", b);
    else
      testStepFail(0, step, "Waited for %s", b);
  }
  else if(timeInNs  == 0)
  {
    // do not wait
    testStepPass(2, step, "Waited for %s", b);
  }
  else
  {
    testStepFail(0, step, "Unable to wait for %s. Please check input parameter.", b);
  }
}

void _fct_CommandVerdict(long verdict)
{
  if(_ttg_verdict == 1) // failed
    return; // setting verdict from 'failed' to 'pass' is not possible
  _ttg_verdict = verdict;
}

int _fct_TcDoBOF()
{
  return TestGetVerdictLastTestCase()==1 && !testIsBreakOnFailDeactivated();
}

int _fct_TsDoBOF()
{
  return TestGetVerdictLastTestSequence()==1 && !testIsBreakOnFailDeactivated();
}

int _fct_LoopIsBlocking()
{ 
  // works for nested loops, too
  dword timeLoopNow, timeLoopOld, cntTimeEqual;
  timeLoopNow = timeNow();
  if(timeLoopNow > timeLoopOld)
  {
    cntTimeEqual = 0;
  }
  else
  {
    ++cntTimeEqual;
    if(cntTimeEqual >= 1000)
    {
      // busy loop detected
      testStepFail(0, "", "Blocking loop detected. Aborted after 1000 cycles have been performed at the same time.");
      return 1;
    }
  }
  timeLoopOld = timeLoopNow;
  return 0;
}

void _fct_CallTsTc(char function[], dword fType, dword isExported, char title[])
{
  CreateTTEIFFunction(function, fType, isExported);
  CallInterfaceFunction(title);
}

void _fct_TestControlStructEnd(long count)
{
  // call TestControlStructEnd count times to close report scope in nested ifs
  long i;
  for(i = 0; i < count; ++i)
    TestControlStructEnd(_ttg_verdict);
}

void _fct_IfTableHead(char inCondition[], int bCondition)
{
  char localBuf[2048];

  snprintf(localBuf, elCount(localBuf), "Condition %s: ", inCondition);
  if(bCondition)
  {
    strncat(localBuf, "true", elCount(localBuf));
  }
  else
  {
    strncat(localBuf, "false", elCount(localBuf));
  }

  _fct_TiTableHeadExpectedEx(localBuf);
}

int _fct_DoElseIf(int bDone)
{
  if(bDone)
  {
    testStep(0, "", "Previous condition matched, skipping block.");
    return 0;
  }
  return 1;
}

int _fct_DoElse(int bDone)
{
  if(bDone)
  {
    testStep(0, "", "Previous condition matched, skipping block.");
    return 0;
  }
  else
  {
    testStep(0, "", "No condition matched, executing 'else' block.");
    return 1;
  }
}
void _fct_TiTableHeadInit()
{
  _ttg_TestActionFailCnt = 0;
}

void _fct_TiTableHeadAssignment()
{
  _fct_TiTableHeadInit();
  _ttg_Re = testInfoTable("Stimulation of values");
  testInfoHeadingBegin(_ttg_Re, 0);
  _fct_TiCell("Symbol");
  _fct_TiCell("Op.");
  _fct_TiCell("Assigned");
  testInfoHeadingEnd(_ttg_Re);
}


void _fct_TiTableFunctionCallReturnValue(char callSig[])
{
  char localBuf[256];
  _fct_TiTableHeadInit();
  snprintf(localBuf, elCount(localBuf), "Function call: %s", callSig);
  _ttg_Re = testInfoTable(localBuf);
  testInfoHeadingBegin(_ttg_Re, 0);
  _fct_TiCell("Symbol");
  _fct_TiCell("Op.");
  _fct_TiCell("Return Value");
  testInfoHeadingEnd(_ttg_Re);
}

void _fct_TiTableWaveformStimulus()
{
  _fct_TiTableHeadInit();
  _ttg_Re = testInfoTable("Stimulation of values with waveform curves");
   testInfoHeadingBegin(_ttg_Re, 0);
   _fct_TiCell("Symbol");
   _fct_TiCell("Stimulated with curve");
   testInfoHeadingEnd(_ttg_Re);
}

void _fct_TiTableHeadSetVariables()
{
  _fct_TiTableHeadInit();
  _ttg_Re = testInfoTable("Setting variable values");
  testInfoHeadingBegin(_ttg_Re, 0);
  _fct_TiCell("Variable");
  _fct_TiCell("Op.");
  _fct_TiCell("Assigned");
  testInfoHeadingEnd(_ttg_Re);
}
void _fct_TiTableHeadReport(char userText[])
{
  _fct_TiTableHeadInit();
  _ttg_Re = testInfoTable(userText);
  testInfoHeadingBegin(_ttg_Re, 0);
  _fct_TiCell("Symbol");
  _fct_TiCell("Value");
  testInfoHeadingEnd(_ttg_Re);
}
void _fct_TiTableHeadSend(char msgDesc[])
{
  char b[200];
  _fct_TiTableHeadInit();
  snprintf(b, elcount(b), "Send %s", msgDesc);
  _ttg_Re = testInfoTable(b);
  testInfoHeadingBegin(_ttg_Re, 0);
  _fct_TiCell("Signal/Byte");
  _fct_TiCell("Op.");
  _fct_TiCell("Assigned");
  testInfoHeadingEnd(_ttg_Re);
}

void _fct_TiTableHeadExpected()
{
  _fct_TiTableHeadExpectedEx("Check of expected values");
}

void _fct_TiTableHeadExpectedEx(char title[])
{
  _fct_TiTableHeadInit();
  _ttg_Re = testInfoTable(title);
  testInfoHeadingBegin(_ttg_Re, 0);
  _fct_TiCell("Symbol");
  _fct_TiCell("Op.");
  _fct_TiCell("Reference Value");
  _fct_TiCell("Actual");
  _fct_TiCell("Result");
  testInfoHeadingEnd(_ttg_Re);
}
void _fct_TiTableHeadResponse(char msgDesc[], int numReceived)
{
  char b[200];
  _fct_TiTableHeadInit();
  if (numReceived == -1)
    snprintf(b, elcount(b), "Response of %s", msgDesc); // maybe received after x MS?
  else
    snprintf(b, elcount(b), "Response of %s (received %d times)", msgDesc, numReceived);
  _ttg_Re = testInfoTable(b);
  testInfoHeadingBegin(_ttg_Re, 0);
  _fct_TiCell("Signal/Byte");
  _fct_TiCell("Op.");
  _fct_TiCell("Reference Value");
  if (numReceived == -1)
    _fct_TiCell("Actual");
  else
    _fct_TiCell("Last Received");
  _fct_TiCell("Result");
  testInfoHeadingEnd(_ttg_Re);
}

void _fct_TiCell(char text[])
{
  testInfoCell(_ttg_Re, text);
}

void _fct_TiCellResult(long condition)
{
  if(condition)
    _fct_TiCell("pass");
  else
  {
    _fct_TiCell("fail");
    ++_ttg_TestActionFailCnt;
  }
}

void _fct_TiCellResultTrueFalse(long condition)
{
  if(condition)
    _fct_TiCell("true");
  else
  {
    _fct_TiCell("false");
    ++_ttg_TestActionFailCnt;
  }
}

void _fct_TiCell(int64 value)
{
  _fct_TiIntCell(value);
}
void _fct_TiIntCell(int64 value)
{
  snprintf(_ttg_BR, elcount(_ttg_BR), "%I64d", value);
  _fct_TiCell(_ttg_BR);
}

void _fct_TiCell(double value)
{
  _fct_TiFloatCell(value);
}
void _fct_TiFloatCell(double value)
{
  snprintf(_ttg_BR, elcount(_ttg_BR), "%.15g", value);
  _fct_TiCell(_ttg_BR);
}

void _fct_TiRow(long indent, char firstCellContent[])
{
  testInfoRow(_ttg_Re, indent, firstCellContent);
}

void _fct_TiWriteByteX(int64 idx, char valueSymbol[], char nameOut[])
{
  if(valueSymbol[0] == 0)
    snprintf(nameOut, elcount(nameOut), "Byte[%I64d]", idx);
  else
    snprintf(nameOut, elcount(nameOut), "Byte[%I64d (%s)]", idx, valueSymbol);
}

void _fct_TiTableEvaluation(char stepIdentifier[])
{
  if(_ttg_TestActionFailCnt > 0)
  {
    testStepFail(0, stepIdentifier, _ttg_Re);
  }
  else
  {
    testStepPass(2, stepIdentifier, _ttg_Re);
  }
}

void _fct_TiTableEnd(char step[])
{
  testStep(2, step, _ttg_Re);
}


// report a byte stream
void _fct_TiCell_Bytes( long handle, BYTE rawBytes[], long count)
{
  char byteDigits[17];
  char byteDump[ 32 * 3 + 15]; // Only print up to 32 bytes in the first step -> also in "min..." below!
  long max;
  long i;
  long p;
  strncpy( byteDigits, "0123456789ABCDEF", 17); // Do explicit copy to prevent "initialized only once" warning

  p = snprintf( byteDump, elcount( byteDump), "[%d] ", count);
  max = _min( 32, count);
  for( i = 0; i < max; ++i)
  {
    byteDump[p++] = byteDigits[rawBytes[i] >> 4];
    byteDump[p++] = byteDigits[rawBytes[i] & 0xF];
    byteDump[p++] = ' ';
  }
  if( max < count)
  {
    byteDump[p++] = '.';
    byteDump[p++] = '.';
    byteDump[p++] = '.';
  }
  byteDump[--p] = 0;

  testInfoCell( handle, byteDump);
}

void _fct_SetBusContext(char bus[], int saveOldBusContext)
{
  _ttg_gBusContextOk = 1;
  _ttg_gBusContextNew = GetBusNameContext(bus);
  if(_ttg_gBusContextNew == 0)
  {
    _ttg_gBusContextOk = 0;
    testStepFail("", "Error: Cannot determine context for bus: %s", bus);
    _ttg_gBusContextOld = 0;
    return;
  }
  if(saveOldBusContext == 1)
  {
    _ttg_gBusContextOld = SetBusContext(_ttg_gBusContextNew);
  }
  else
  {
    SetBusContext(_ttg_gBusContextNew);
  }
}

void _fct_ResetBusContext()
{
  if(_ttg_gBusContextOld > 0)
  {
    SetBusContext(_ttg_gBusContextNew);
  }
}

int _fct_BusContextOk()
{
  return _ttg_gBusContextOk;
}

// _fct_TiNameOpValue(Int64)
_fct_TiNameOpValue(long indent, char nameIn[], char op[], int64 valueIn, char dstNameIn[])
{
  
  _fct_TiRow(indent, nameIn);
  _fct_TiCell(op);
  if (strlen(dstNameIn) == 0)
  {
    snprintf(_ttg_B, elCount(_ttg_B), "%I64d", valueIn);
  }
  else
  {
    snprintf(_ttg_B, elCount(_ttg_B), "%I64d (%s)", valueIn, dstNameIn);
  }
  _fct_TiCell(_ttg_B);

}

// _fct_TiValueCell(Int64)
_fct_TiValueCell(int64 valueIn)
{
  _fct_TiCell(valueIn);
}

// _fct_ChckRep(Int64,Int64)
_fct_ChckRep(long indent, int64 lSym, char lName[], char operator[], int64 rSym, char rName[])
{
  _fct_TiNameOpValue(indent, lName, operator, rSym, rName);
  _fct_TiValueCell(lSym);
}

// _fct_EnsureSymbolName(Signal)
_fct_EnsureSymbolName(signal * sym, char nameIn[], char nameOut[])
{
  if(strlen(nameIn) == 0)
  {
    long i, len, pos;
    strncpy(nameOut, sym.name, elcount(nameOut));
    len = strlen(nameOut);
    // find last separator ':'
    pos = 0;
    for(i = len; i > 0; --i)
    {
	    if(nameOut[i] == ':')
	    {
	      pos = i;
        break;
      }
    }
    if(pos > 0 && pos != len)
    {
      char sigNameOnly[200];
      substr_cpy_off(sigNameOnly, 0, sym.name, pos+1, -1, elcount(sigNameOnly));
      snprintf(nameOut, elcount(nameOut), "Signal '%s'", sigNameOnly);
    }
  }
  else { strncpy(nameOut, nameIn, elCount(nameOut)); }
}

// _fct_Set(Signal,Int64)
_fct_Set(signal * dst, char dstName[], int64 src, char srcName[])
{
  char symDstBuf[256];
  _fct_EnsureSymbolName(dst,dstName,symDstBuf);
  $dst.phys = src;
  if(0 == getSignalTime(dst))
  {
    snprintf(_ttg_B, elcount(_ttg_B), "%s not online yet", symDstBuf);
    strncpy(symDstBuf, _ttg_B, elcount(symDstBuf));
  }
  _fct_TiNameOpValue(0, symDstBuf, "=", src, srcName);
}

// _fct_EnsureSymbolName(SysVarFloat)
_fct_EnsureSymbolName(sysvarFloat * sym, char nameIn[], char nameOut[])
{
  if(strlen(nameIn) == 0)
  {
    snprintf(nameOut, elcount(nameOut), "System variable '%s'", sym.Name );
  }
  else { strncpy(nameOut, nameIn, elCount(nameOut)); }
}

// _fct_TiNameOpValue(String)
_fct_TiNameOpValue(long indent, char nameIn[], char op[], char valueIn[], char dstNameIn[])
{
  
  _fct_TiRow(indent, nameIn);
  _fct_TiCell(op);
  if (strlen(dstNameIn) == 0)
  {
    snprintf(_ttg_B, elCount(_ttg_B), "%s", valueIn);
  }
  else
  {
    snprintf(_ttg_B, elCount(_ttg_B), "%s (%s)", valueIn, dstNameIn);
  }
  _fct_TiCell(_ttg_B);

}

// _fct_TiValueCell(SysVarFloat)
_fct_TiValueCell(sysvarFloat * valueIn)
{
  _fct_TiCell(@valueIn);
}

// _fct_ChckRep(SysVarFloat,String)
_fct_ChckRep(long indent, sysvarFloat * lSym, char lName[], char operator[], char rSym[], char rName[])
{
  char symLNameBuf[256];
  _fct_EnsureSymbolName(lSym,lName,symLNameBuf);
  _fct_TiNameOpValue(indent, symLNameBuf, operator, rSym, rName);
  _fct_TiValueCell(lSym);
}

void _ttg_fct_setIgnStatus_3_1_2_0(int64 _ttg_var_ignStatus_3_1_2_0_1_0)
{
  TestCommandBegin("CAPL Inline", "stim mode inactive");
  {
    _ttg_fct_caplinline_3_1_2_0_2();
  }
  // _ttg_!_3_1_2_0_2
  TestCommandEnd();
  TestControlStructBegin("If", "");
  _ttg_verdict = -1;
  {
    int bCondition, bDone;
    bDone = 0;
    {
      {
        bCondition = (_ttg_var_ignStatus_3_1_2_0_1_0==0LL);
      }
      _fct_IfTableHead("( ignStatus==0 )", bCondition);
      _fct_ChckRep(0, _ttg_var_ignStatus_3_1_2_0_1_0, "Variable \'ignStatus\'", "==", 0LL, "");
      _fct_TiCellResultTrueFalse((_ttg_var_ignStatus_3_1_2_0_1_0==0LL));
      _fct_TiTableEnd("");
      if(bCondition)
      {
        bDone = 1;
        TestCommandBegin("CAPL Inline", "IGN connects to GND");
        {
          _ttg_fct_caplinline_3_1_2_0_3_2();
        }
        // _ttg_!_3_1_2_0_3_2
        TestCommandEnd();
      }
    }
    // _ttg_!_3_1_2_0_3
    _fct_TestControlStructEnd(1);
    TestControlStructBegin("Else", "");
    _ttg_verdict = -1;
    {
      if(_fct_DoElse(bDone))
      {
        bDone = 1;
        TestCommandBegin("CAPL Inline", "IGN connects to BATT");
        {
          _ttg_fct_caplinline_3_1_2_0_4_1();
        }
        // _ttg_!_3_1_2_0_4_1
        TestCommandEnd();
      }
    }
  }
  // _ttg_!_3_1_2_0_4
  _fct_TestControlStructEnd(1);
}
// _ttg_#_3_1_2_0
void _ttg_fct_setAccStatus_3_1_2_1(int64 _ttg_var_accStatus_3_1_2_1_1_0)
{
  {
    // Variables
    _ttg_var_status_3_1_2_1_2_0 = 0LL;
    _ttg_I64 = _ttg_var_status_3_1_2_1_2_0;
    snprintf(_ttg_B, 2000, "%I64d", _ttg_I64);
    TestReportVariableDefinition("status", "int", _ttg_B);
    _ttg_var_chooseOffMethod_3_1_2_1_2_1 = 0LL;
    _ttg_I64 = _ttg_var_chooseOffMethod_3_1_2_1_2_1;
    snprintf(_ttg_B, 2000, "%I64d", _ttg_I64);
    TestReportVariableDefinition("chooseOffMethod", "int", _ttg_B);
  }
  TestCommandBegin("CAPL Inline", "stim mode inactive");
  {
    _ttg_fct_caplinline_3_1_2_1_3();
  }
  // _ttg_!_3_1_2_1_3
  TestCommandEnd();
  TestControlStructBegin("If", "");
  _ttg_verdict = -1;
  {
    int bCondition, bDone;
    bDone = 0;
    {
      {
        bCondition = (_ttg_var_accStatus_3_1_2_1_1_0==0LL);
      }
      _fct_IfTableHead("( accStatus==0 )", bCondition);
      _fct_ChckRep(0, _ttg_var_accStatus_3_1_2_1_1_0, "Variable \'accStatus\'", "==", 0LL, "");
      _fct_TiCellResultTrueFalse((_ttg_var_accStatus_3_1_2_1_1_0==0LL));
      _fct_TiTableEnd("");
      if(bCondition)
      {
        bDone = 1;
        TestCommandBegin("CAPL Inline", "set a random chooseOffMethod value");
        {
          _ttg_fct_caplinline_3_1_2_1_4_2();
        }
        // _ttg_!_3_1_2_1_4_2
        TestCommandEnd();
        TestControlStructBegin("If", "");
        _ttg_verdict = -1;
        {
          int bCondition, bDone;
          bDone = 0;
          {
            {
              bCondition = (_ttg_var_chooseOffMethod_3_1_2_1_2_1==0LL);
            }
            _fct_IfTableHead("( chooseOffMethod==0 )", bCondition);
            _fct_ChckRep(0, _ttg_var_chooseOffMethod_3_1_2_1_2_1, "Variable \'chooseOffMethod\'", "==", 0LL, "");
            _fct_TiCellResultTrueFalse((_ttg_var_chooseOffMethod_3_1_2_1_2_1==0LL));
            _fct_TiTableEnd("");
            if(bCondition)
            {
              bDone = 1;
              TestCommandBegin("CAPL Inline", "ACC connects to GND");
              {
                _ttg_fct_caplinline_3_1_2_1_4_3_2();
              }
              // _ttg_!_3_1_2_1_4_3_2
              TestCommandEnd();
            }
          }
          // _ttg_!_3_1_2_1_4_3
          _fct_TestControlStructEnd(1);
          TestControlStructBegin("Else", "");
          _ttg_verdict = -1;
          {
            if(_fct_DoElse(bDone))
            {
              bDone = 1;
              TestCommandBegin("CAPL Inline", "set status as ACC OFF");
              {
                _ttg_fct_caplinline_3_1_2_1_4_4_1();
              }
              // _ttg_!_3_1_2_1_4_4_1
              TestCommandEnd();
              TestCommandBegin("Set", "");
              {
                _fct_TiTableHeadAssignment();
                _fct_Set(HKMC_LH_SBW::dbNode::CGW::CGW1::CF_Gway_IGNSw, "CAN signal \'CF_Gway_IGNSw\'", _ttg_var_status_3_1_2_1_2_0, "status");
                _fct_TiTableEnd("1");
              }
              // _ttg_!_3_1_2_1_4_4_2
              TestCommandEnd();
            }
          }
        }
        // _ttg_!_3_1_2_1_4_4
        _fct_TestControlStructEnd(1);
      }
    }
    // _ttg_!_3_1_2_1_4
    _fct_TestControlStructEnd(1);
    TestControlStructBegin("Else", "");
    _ttg_verdict = -1;
    {
      if(_fct_DoElse(bDone))
      {
        bDone = 1;
        TestCommandBegin("CAPL Inline", "ACC connects to BATT");
        {
          _ttg_fct_caplinline_3_1_2_1_5_1();
        }
        // _ttg_!_3_1_2_1_5_1
        TestCommandEnd();
        TestCommandBegin("CAPL Inline", "set status as ACC or IG");
        {
          _ttg_fct_caplinline_3_1_2_1_5_2();
        }
        // _ttg_!_3_1_2_1_5_2
        TestCommandEnd();
        TestCommandBegin("Set", "");
        {
          _fct_TiTableHeadAssignment();
          _fct_Set(HKMC_LH_SBW::dbNode::CGW::CGW1::CF_Gway_IGNSw, "CAN signal \'CF_Gway_IGNSw\'", _ttg_var_status_3_1_2_1_2_0, "status");
          _fct_TiTableEnd("1");
        }
        // _ttg_!_3_1_2_1_5_3
        TestCommandEnd();
      }
    }
  }
  // _ttg_!_3_1_2_1_5
  _fct_TestControlStructEnd(1);
}
// _ttg_#_3_1_2_1
void _ttg_fct_setDriverDoorStatus_3_1_2_2(int64 _ttg_var_driverDoorOpen_3_1_2_2_1_0)
{
  {
    // Variables
    _ttg_var_driverDoorStatus_3_1_2_2_2_0 = 0LL;
    _ttg_I64 = _ttg_var_driverDoorStatus_3_1_2_2_2_0;
    snprintf(_ttg_B, 2000, "%I64d", _ttg_I64);
    TestReportVariableDefinition("driverDoorStatus", "int", _ttg_B);
    _ttg_var_driverDoorOpenMethod_3_1_2_2_2_1 = 0LL;
    _ttg_I64 = _ttg_var_driverDoorOpenMethod_3_1_2_2_2_1;
    snprintf(_ttg_B, 2000, "%I64d", _ttg_I64);
    TestReportVariableDefinition("driverDoorOpenMethod", "int", _ttg_B);
  }
  TestCommandBegin("CAPL Inline", "stim mode inactive");
  {
    _ttg_fct_caplinline_3_1_2_2_3();
  }
  // _ttg_!_3_1_2_2_3
  TestCommandEnd();
  TestControlStructBegin("If", "");
  _ttg_verdict = -1;
  {
    int bCondition, bDone;
    bDone = 0;
    {
      {
        bCondition = (_ttg_var_driverDoorOpen_3_1_2_2_1_0==0LL);
      }
      _fct_IfTableHead("( driverDoorOpen==0 )", bCondition);
      _fct_ChckRep(0, _ttg_var_driverDoorOpen_3_1_2_2_1_0, "Variable \'driverDoorOpen\'", "==", 0LL, "");
      _fct_TiCellResultTrueFalse((_ttg_var_driverDoorOpen_3_1_2_2_1_0==0LL));
      _fct_TiTableEnd("");
      if(bCondition)
      {
        bDone = 1;
        TestCommandBegin("CAPL Inline", "Set driver door hard wire float");
        {
          _ttg_fct_caplinline_3_1_2_2_4_2();
        }
        // _ttg_!_3_1_2_2_4_2
        TestCommandEnd();
        TestCommandBegin("CAPL Inline", "Set driver door status as not open");
        {
          _ttg_fct_caplinline_3_1_2_2_4_3();
        }
        // _ttg_!_3_1_2_2_4_3
        TestCommandEnd();
        TestCommandBegin("Set", "");
        {
          _fct_TiTableHeadAssignment();
          _fct_Set(HKMC_LH_SBW::dbNode::CGW::CGW1::CF_Gway_DrvDrSw, "CAN signal \'CF_Gway_DrvDrSw\'", 0LL, "Colse");
          _fct_TiTableEnd("1");
        }
        // _ttg_!_3_1_2_2_4_4
        TestCommandEnd();
      }
    }
    // _ttg_!_3_1_2_2_4
    _fct_TestControlStructEnd(1);
    TestControlStructBegin("Else", "");
    _ttg_verdict = -1;
    {
      if(_fct_DoElse(bDone))
      {
        bDone = 1;
        TestCommandBegin("CAPL Inline", "set a random driverDoorOpenMethod value");
        {
          _ttg_fct_caplinline_3_1_2_2_5_1();
        }
        // _ttg_!_3_1_2_2_5_1
        TestCommandEnd();
        TestControlStructBegin("If", "");
        _ttg_verdict = -1;
        {
          int bCondition, bDone;
          bDone = 0;
          {
            {
              bCondition = (_ttg_var_driverDoorOpenMethod_3_1_2_2_2_1==0LL);
            }
            _fct_IfTableHead("( driverDoorOpenMethod==0 )", bCondition);
            _fct_ChckRep(0, _ttg_var_driverDoorOpenMethod_3_1_2_2_2_1, "Variable \'driverDoorOpenMethod\'", "==", 0LL, "");
            _fct_TiCellResultTrueFalse((_ttg_var_driverDoorOpenMethod_3_1_2_2_2_1==0LL));
            _fct_TiTableEnd("");
            if(bCondition)
            {
              bDone = 1;
              TestCommandBegin("CAPL Inline", "DOOR_OPEN connects to GND");
              {
                _ttg_fct_caplinline_3_1_2_2_5_2_2();
              }
              // _ttg_!_3_1_2_2_5_2_2
              TestCommandEnd();
            }
          }
          // _ttg_!_3_1_2_2_5_2
          _fct_TestControlStructEnd(1);
          TestControlStructBegin("Else", "");
          _ttg_verdict = -1;
          {
            if(_fct_DoElse(bDone))
            {
              bDone = 1;
              TestCommandBegin("Set", "");
              {
                _fct_TiTableHeadAssignment();
                _fct_Set(HKMC_LH_SBW::dbNode::CGW::CGW1::CF_Gway_DrvDrSw, "CAN signal \'CF_Gway_DrvDrSw\'", 1LL, "");
                _fct_TiTableEnd("1");
              }
              // _ttg_!_3_1_2_2_5_3_1
              TestCommandEnd();
            }
          }
        }
        // _ttg_!_3_1_2_2_5_3
        _fct_TestControlStructEnd(1);
      }
    }
  }
  // _ttg_!_3_1_2_2_5
  _fct_TestControlStructEnd(1);
}
// _ttg_#_3_1_2_2
void _ttg_fct_setVehicleSpeed_3_1_2_3(int64 _ttg_var_vehicleSpeedSignalStatus_3_1_2_3_1_0)
{
  {
    // Variables
    _ttg_var_vs_tcu_timeoutBool_3_1_2_3_2_0 = 0LL;
    _ttg_I64 = _ttg_var_vs_tcu_timeoutBool_3_1_2_3_2_0;
    snprintf(_ttg_B, 2000, "%I64d", _ttg_I64);
    TestReportVariableDefinition("vs_tcu_timeoutBool", "int", _ttg_B);
    _ttg_var_WHL_SPD_FL_timeoutBool_3_1_2_3_2_1 = 0LL;
    _ttg_I64 = _ttg_var_WHL_SPD_FL_timeoutBool_3_1_2_3_2_1;
    snprintf(_ttg_B, 2000, "%I64d", _ttg_I64);
    TestReportVariableDefinition("WHL_SPD_FL_timeoutBool", "int", _ttg_B);
  }
  TestControlStructBegin("If", "");
  _ttg_verdict = -1;
  {
    int bCondition, bDone;
    bDone = 0;
    {
      {
        bCondition = (_ttg_var_vehicleSpeedSignalStatus_3_1_2_3_1_0==0LL);
      }
      _fct_IfTableHead("( vehicleSpeedSignalStatus==0 )", bCondition);
      _fct_ChckRep(0, _ttg_var_vehicleSpeedSignalStatus_3_1_2_3_1_0, "Variable \'vehicleSpeedSignalStatus\'", "==", 0LL, "");
      _fct_TiCellResultTrueFalse((_ttg_var_vehicleSpeedSignalStatus_3_1_2_3_1_0==0LL));
      _fct_TiTableEnd("");
      if(bCondition)
      {
        bDone = 1;
        TestCommandBegin("CAPL Inline", "");
        {
          _ttg_fct_caplinline_3_1_2_3_3_3();
        }
        // _ttg_!_3_1_2_3_3_3
        TestCommandEnd();
        TestControlStructBegin("If", "");
        _ttg_verdict = -1;
        {
          int bCondition, bDone;
          bDone = 0;
          {
            {
              bCondition = (_ttg_var_vs_tcu_timeoutBool_3_1_2_3_2_0==0LL);
            }
            _fct_IfTableHead("( vs_tcu_timeoutBool==0 )", bCondition);
            _fct_ChckRep(0, _ttg_var_vs_tcu_timeoutBool_3_1_2_3_2_0, "Variable \'vs_tcu_timeoutBool\'", "==", 0LL, "");
            _fct_TiCellResultTrueFalse((_ttg_var_vs_tcu_timeoutBool_3_1_2_3_2_0==0LL));
            _fct_TiTableEnd("");
            if(bCondition)
            {
              bDone = 1;
              TestCommandBegin("Set", "");
              {
                _fct_TiTableHeadAssignment();
                _fct_Set(HKMC_LH_SBW::dbNode::TCU::TCU12::VS_TCU, "CAN signal \'VS_TCU\'", 0xFFLL, "");
                _fct_TiTableEnd("1");
              }
              // _ttg_!_3_1_2_3_3_4_2
              TestCommandEnd();
            }
          }
          // _ttg_!_3_1_2_3_3_4
          _fct_TestControlStructEnd(1);
          TestControlStructBegin("Else", "");
          _ttg_verdict = -1;
          {
            if(_fct_DoElse(bDone))
            {
              bDone = 1;
            }
          }
        }
        // _ttg_!_3_1_2_3_3_5
        _fct_TestControlStructEnd(1);
        TestControlStructBegin("If", "");
        _ttg_verdict = -1;
        {
          int bCondition, bDone;
          bDone = 0;
          {
            {
              bCondition = (_ttg_var_WHL_SPD_FL_timeoutBool_3_1_2_3_2_1==0LL);
            }
            _fct_IfTableHead("( WHL_SPD_FL_timeoutBool==0 )", bCondition);
            _fct_ChckRep(0, _ttg_var_WHL_SPD_FL_timeoutBool_3_1_2_3_2_1, "Variable \'WHL_SPD_FL_timeoutBool\'", "==", 0LL, "");
            _fct_TiCellResultTrueFalse((_ttg_var_WHL_SPD_FL_timeoutBool_3_1_2_3_2_1==0LL));
            _fct_TiTableEnd("");
            if(bCondition)
            {
              bDone = 1;
              TestCommandBegin("Set", "");
              {
                _fct_TiTableHeadAssignment();
                _fct_Set(HKMC_LH_SBW::dbNode::ESC::WHL_SPD11::WHL_SPD_FL, "CAN signal \'WHL_SPD_FL\'", 0x3FFFLL, "");
                _fct_TiTableEnd("1");
              }
              // _ttg_!_3_1_2_3_3_6_2
              TestCommandEnd();
            }
          }
        }
        // _ttg_!_3_1_2_3_3_6
        _fct_TestControlStructEnd(1);
      }
    }
  }
  // _ttg_!_3_1_2_3_3
  _fct_TestControlStructEnd(1);
}
// _ttg_#_3_1_2_3
// Test Tree
void _ttg_fct_tt_3_0()
{
  // Init FlexRay configuration
}
// _ttg_#_3_0
// Power supply initialization
void _ttg_fct_ts_3_0_0()
{
  _fct_CallTsTc("_ttg_ts_ts_3_0_0",3, 0,"Power supply initialization");
}
// _ttg_#_3_0_0
void _ttg_fct_caplinline_3_1_2_0_2()
{
  {
    sysvar::VTS::M9_Ch4.SetStimulationMode(0);//stim mode inactive

  }
}
// _ttg_#_3_1_2_0_2
void _ttg_fct_caplinline_3_1_2_0_3_2()
{
  {
    sysvar::VTS::M9_Ch4.SetPWMVoltageLow(random(4));//set voltagelow 0-4
@sysvar::VTS::M9_Ch4::DigitalOutput = 0;//output digital=0
sysvar::VTS::M9_Ch4.SetStimulationMode(1);////stim mode as voltage

  }
}
// _ttg_#_3_1_2_0_3_2
void _ttg_fct_caplinline_3_1_2_0_4_1()
{
  {
    sysvar::VTS::M9_Ch4.SetPWMVoltageHigh(random(5)+7);//set voltagelow 7-12
@sysvar::VTS::M9_Ch4::DigitalOutput = 1;//output digital=1
sysvar::VTS::M9_Ch4.SetStimulationMode(1);////stim mode as voltage
  }
}
// _ttg_#_3_1_2_0_4_1
void _ttg_fct_caplinline_3_1_2_1_3()
{
  {
    sysvar::VTS::M9_Ch5.SetStimulationMode(0);//stim mode inactive
  }
}
// _ttg_#_3_1_2_1_3
void _ttg_fct_caplinline_3_1_2_1_4_2()
{
  int64 chooseOffMethod;
  chooseOffMethod = _ttg_var_chooseOffMethod_3_1_2_1_2_1;
  {
    chooseOffMethod=random(1);
  }
  _ttg_var_chooseOffMethod_3_1_2_1_2_1 = chooseOffMethod;
}
// _ttg_#_3_1_2_1_4_2
void _ttg_fct_caplinline_3_1_2_1_4_3_2()
{
  {
    sysvar::VTS::M9_Ch5.SetPWMVoltageLow(random(4));//set voltagelow 0-4
@sysvar::VTS::M9_Ch5::DigitalOutput = 0;//output digital=0
sysvar::VTS::M9_Ch5.SetStimulationMode(1);////stim mode as voltage
  }
}
// _ttg_#_3_1_2_1_4_3_2
void _ttg_fct_caplinline_3_1_2_1_4_4_1()
{
  int64 status;
  status = _ttg_var_status_3_1_2_1_2_0;
  {
    status=random(1);
status=status*(random(3)+4)+(1-status)*random(1);
  }
  _ttg_var_status_3_1_2_1_2_0 = status;
}
// _ttg_#_3_1_2_1_4_4_1
void _ttg_fct_caplinline_3_1_2_1_5_1()
{
  {
    sysvar::VTS::M9_Ch5.SetPWMVoltageHigh(random(5)+7);//set voltagelow 7-12
@sysvar::VTS::M9_Ch5::DigitalOutput = 1;//output digital=1
sysvar::VTS::M9_Ch5.SetStimulationMode(1);////stim mode as voltage
  }
}
// _ttg_#_3_1_2_1_5_1
void _ttg_fct_caplinline_3_1_2_1_5_2()
{
  int64 status;
  status = _ttg_var_status_3_1_2_1_2_0;
  {
    status=random(1)+2;
  }
  _ttg_var_status_3_1_2_1_2_0 = status;
}
// _ttg_#_3_1_2_1_5_2
void _ttg_fct_caplinline_3_1_2_2_3()
{
  {
    sysvar::VTS::M9_Ch8.SetStimulationMode(0);//stim mode inactive
  }
}
// _ttg_#_3_1_2_2_3
void _ttg_fct_caplinline_3_1_2_2_4_2()
{
  {
    @sysvar::VTS::M9_Ch8::RelayGnd = 0;
  }
}
// _ttg_#_3_1_2_2_4_2
void _ttg_fct_caplinline_3_1_2_2_4_3()
{
  int64 driverDoorStatus;
  driverDoorStatus = _ttg_var_driverDoorStatus_3_1_2_2_2_0;
  {
    driverDoorStatus=random(1);
driverDoorStatus=driverDoorStatus*(random(1)+2);
  }
  _ttg_var_driverDoorStatus_3_1_2_2_2_0 = driverDoorStatus;
}
// _ttg_#_3_1_2_2_4_3
void _ttg_fct_caplinline_3_1_2_2_5_1()
{
  int64 driverDoorOpenMethod;
  driverDoorOpenMethod = _ttg_var_driverDoorOpenMethod_3_1_2_2_2_1;
  {
    driverDoorOpenMethod=random(1);
  }
  _ttg_var_driverDoorOpenMethod_3_1_2_2_2_1 = driverDoorOpenMethod;
}
// _ttg_#_3_1_2_2_5_1
void _ttg_fct_caplinline_3_1_2_2_5_2_2()
{
  {
    @sysvar::VTS::M9_Ch8::RelayGnd = 1;
  }
}
// _ttg_#_3_1_2_2_5_2_2
void _ttg_fct_caplinline_3_1_2_3_3_3()
{
  int64 vs_tcu_timeoutBool;
  vs_tcu_timeoutBool = _ttg_var_vs_tcu_timeoutBool_3_1_2_3_2_0;
  {
    vs_tcu_timeoutBool=random(1);
  }
  _ttg_var_vs_tcu_timeoutBool_3_1_2_3_2_0 = vs_tcu_timeoutBool;
}
// _ttg_#_3_1_2_3_3_3
void _ttg_fct_caplinline_3_0_0_2()
{
  {
    sysvar::VTS::M12_VT7001.SetInterconnectionMode(0);
sysvar::VTS::M12_SupInt.SetRefVoltageMode(1);
@sysvar::VTS::M12_Out2::Active = 1;
@sysvar::VTS::M12_SupInt::RefVoltage = 12;
  }
}
// _ttg_#_3_0_0_2
// Power supply initialization
testsequence _ttg_ts_ts_3_0_0()
{
  TestCommandBegin("CAPL Inline", "Initialize VT system,make VT internal power supply voltage output equals 12V");
  {
    _ttg_fct_caplinline_3_0_0_2();
  }
  // _ttg_!_3_0_0_2
  TestCommandEnd();
  if(_fct_TsDoBOF() || testIsStopRequested())
  {
    return;
  }
  TestCommandBegin("Wait", "Wait for power supply initialization complete");
  {
    _fct_Wait("1", (int64)(300LL * 1000000LL), 1000000, "");
  }
  // _ttg_!_3_0_0_3
  TestCommandEnd();
  if(_fct_TsDoBOF() || testIsStopRequested())
  {
    return;
  }
  TestCommandBegin("Check", "");
  {
    _fct_TiTableHeadExpected();
    _fct_ChckRep(0, sysvarFloat::VTS::M12_Out2::AvgVoltage, "System variable \'M12_Out2::AvgVoltage\'", "Range", "11.5..12.5", "");
    _fct_TiCellResult(((@sysvarFloat::VTS::M12_Out2::AvgVoltage>=11.5) && (@sysvarFloat::VTS::M12_Out2::AvgVoltage<=12.5)));
    _fct_ChckRep(0, sysvarFloat::VTS::M12_Out2::AvgCurrent, "System variable \'M12_Out2::AvgCurrent\'", "Range", "0.001..0.1", "");
    _fct_TiCellResult(((@sysvarFloat::VTS::M12_Out2::AvgCurrent>=0.001) && (@sysvarFloat::VTS::M12_Out2::AvgCurrent<=0.1)));
    _fct_TiTableEvaluation("1");
  }
  // _ttg_!_3_0_0_4
  TestCommandEnd();
  if(_fct_TsDoBOF() || testIsStopRequested())
  {
    return;
  }
  TestCommandBegin("CANoe Standard Service", "testValidateTesterConfirmation");
  {
    testStepPass(2, "", "Execute testValidateTesterConfirmation(\"for 3.5.2 debug\", \"\", 1)");
    testValidateTesterConfirmation("for 3.5.2 debug", "", 1LL);
  }
  // _ttg_!_3_0_0_5
  TestCommandEnd();
  if(_fct_TsDoBOF() || testIsStopRequested())
  {
    return;
  }
}
// _ttg_#_3_0_0
