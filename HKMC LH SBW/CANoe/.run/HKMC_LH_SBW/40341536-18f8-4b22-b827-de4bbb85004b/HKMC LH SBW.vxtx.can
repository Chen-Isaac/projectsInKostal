/* !Encoding: 65001  */
// Generated with version 2.0.49.1
variables
{
  // global general purpose buffers
  char _ttg_B[2000];
  char _ttg_Z[2000];
  char _ttg_BR[2000];
  long _ttg_verdict;
  long _ttg_Re;
  long _ttg_TestActionFailCnt;
  long _ttg_TestStepInitOk;
  int64 _ttg_I64;
  double _ttg_Double;
  dword _ttg_gBusContextNew = 0;
  dword _ttg_gBusContextOld = 0;
  int64 _ttg_gBusContextOk = 0;
  // enums
  enum EVerdBOF
  {
    EVerdBOF_None = 0,
    EVerdBOF_TC = 1,
    EVerdBOF_TS = 2
  }
  ;
  // FlexRay configuration
  FRConfiguration _ttg_gFRConfiguration;
  long _ttg_gFRNumberOfStaticSlots[32];
  long _ttg_gFRPayloadLengthStatic[32];
  // globals for user defined variables
  double _ttg_var_errorcode_6_1_1_1_2_0;
  double _ttg_var_errorcode_6_1_1_3_2_0;
  double _ttg_var_errorcode_6_1_1_4_2_0;
  double _ttg_var_errorcode_6_1_1_6_2_0;
  double _ttg_var_errorcode_6_1_1_8_2_0;
  double _ttg_var_errorcode_6_1_1_9_2_0;
  // global declarations
  int64 _ttg_I0;
}
void _fct_Wait(char step[], int64 timeInNs, int64 unitInNs, char valueSymbol[])
{
  char b[400];
  double timeValueByUnit;

  timeValueByUnit = (double)timeInNs / (double)unitInNs;

  if(unitInNs == 1LL)
  {
    if(valueSymbol[0] == 0)
      snprintf(b, elcount(b), "%I64d ns", timeInNs);
    else
      snprintf(b, elcount(b), "%I64d (%s) ns", timeInNs, valueSymbol);
  }
  else if(unitInNs == 1000LL)
  {
    if(valueSymbol[0] == 0)
      snprintf(b, elcount(b), "%.3f us", timeValueByUnit);
    else
      snprintf(b, elcount(b), "%.3f (%s) us", timeValueByUnit, valueSymbol);
  }
  else if(unitInNs == 1000000LL)
  {
    if(valueSymbol[0] == 0)
      snprintf(b, elcount(b), "%.3f ms", timeValueByUnit);
    else
      snprintf(b, elcount(b), "%.3f (%s) ms", timeValueByUnit, valueSymbol);
  }
  else if(unitInNs == 1000000000LL)
  {
    if(valueSymbol[0] == 0)
      snprintf(b, elcount(b), "%.3f s", timeValueByUnit);
    else
      snprintf(b, elcount(b), "%.3f (%s) s", timeValueByUnit, valueSymbol);
  }
  else
    testStepErrorInTestSystem(0, step, "Internal error: invalid time unit: %I64d", unitInNs);

  if(timeInNs > 0)
  {
    if(0 == testWaitForTimeoutNS(timeInNs))
      testStep(2, step, "Waited for %s", b);
    else
      testStepErrorInTestSystem(0, step, "Waited for %s", b);
  }
  else if(timeInNs  == 0)
  {
    // do not wait
    testStep(2, step, "Waited for %s", b);
  }
  else
  {
    testStepErrorInTestSystem(0, step, "Unable to wait for %s. Please check input parameter.", b);
  }
}

void _fct_CommandVerdict(long verdict)
{
  if(_ttg_verdict == 1) // failed
    return; // setting verdict from 'failed' to 'pass' is not possible
  _ttg_verdict = verdict;
}

int _fct_DoStop(enum EVerdBOF verdictSource, int doBreakOnFail)
{
  long verdict;

  switch (verdictSource)
  {
    case EVerdBOF_TC: verdict = TestGetVerdictLastTestCase(); break;
    case EVerdBOF_TS: verdict = TestGetVerdictLastTestSequence(); break;
    default: verdict = 0; break; // Note: error in test system will only be checked inside TS/TC body
  }

  if (doBreakOnFail && verdict == 1 /*fail*/ && !testIsBreakOnFailDeactivated())
    return 1; // stop execution because current verdict is 'Fail'

  if (testIsStopRequested() /*user pressed stop button*/ || verdict == 4 /*error in testsystem*/)
    return 1; // stop execution

  return 0;
}

int _fct_LoopIsBlocking()
{ 
  // works for nested loops, too
  dword timeLoopNow, timeLoopOld, cntTimeEqual;
  timeLoopNow = timeNow();
  if(timeLoopNow > timeLoopOld)
  {
    cntTimeEqual = 0;
  }
  else
  {
    ++cntTimeEqual;
    if(cntTimeEqual >= 1000)
    {
      // busy loop detected
      testStepErrorInTestSystem(0, "", "Blocking loop detected. Aborted after 1000 cycles have been performed at the same time.");
      return 1;
    }
  }
  timeLoopOld = timeLoopNow;
  return 0;
}

void _fct_CallTsTc(char function[], dword fType, dword isExported, char title[])
{
  CreateTTEIFFunction(function, fType, isExported);
  CallInterfaceFunction(title);
}

void _fct_TestControlStructEnd(long count)
{
  // call TestControlStructEnd count times to close report scope in nested ifs
  long i;
  for(i = 0; i < count; ++i)
    TestControlStructEnd(_ttg_verdict);
}

void _fct_ConditionTableHead(char inCondition[], int bCondition)
{
  char localBuf[2048];

  snprintf(localBuf, elCount(localBuf), "%s: ", inCondition);
  if(bCondition)
    strncat(localBuf, "true", elCount(localBuf));
  else
    strncat(localBuf, "false", elCount(localBuf));

  _fct_TiTableHeadExpectedEx(localBuf);
}

int _fct_DoElseIf(int bDone)
{
  if(bDone)
  {
    testStep(0, "", "Previous condition matched, skipping block.");
    return 0;
  }
  return 1;
}

int _fct_DoElse(int bDone)
{
  if(bDone)
  {
    testStep(0, "", "Previous condition matched, skipping block.");
    return 0;
  }
  else
  {
    testStep(0, "", "No condition matched, executing 'else' block.");
    return 1;
  }
}

// compare byte sequences - returns:
// == 0 if byte sequences match 
// != 0 otherwise
long _fct_CompareBytes(byte leftSide[], long leftSideCnt, byte rightSide[], long rightSideCnt)
{
  DWORD i;

  if (leftSideCnt > elCount(leftSide) || rightSideCnt > elCount(rightSide))
  {
    testStepErrorInTestSystem("_fct_CompareBytes: The buffer itself is not large enough, this should not happen!");
    return -1;
  }

  if (leftSideCnt != rightSideCnt)
    return leftSideCnt - rightSideCnt;

  for (i = 0; i < leftSideCnt; i++)
  {
    if (leftSide[i] != rightSide[i])
      return leftSide[i] - rightSide[i];
  }

  return 0; // sequences match
}

long _fct_AssignBytes(byte destination[], long destCnt, byte source[], long sourceCnt)
{
  long count;
  count = _min(destCnt, sourceCnt);
  memcpy(destination, source, count);
  return count;
}

// Note EVAL00136179: convert 32 bit system variables to 64 bit values (value coherence for signed64/unsigned64 CAPL function overloads)
int64 _SVC(sysvarInt *svi)
{
  dword _32BitUs;
  
  // Note: if we have a unsigned 32 bit sysvar, we need to convert it to a unsigned 32 bit integer first,
  // before converting to 64 bit signed integer. Otherwise CAPL will interpret the SV value as signed and extend it to 64 bit,
  // which will result in wrong values (above 2^31).
  if (!IsSVSigned(svi))
  {
    _32BitUs = @svi;
    return (int64)_32BitUs;
  }
  
  return (int64)@svi;
}

void _fct_TiTableHeadInit()
{
  _ttg_TestActionFailCnt = 0;
}

void _fct_TiTableHeadAssignment()
{
  _fct_TiTableHeadInit();
  _ttg_Re = testInfoTable("Stimulation of values");
  testInfoHeadingBegin(_ttg_Re, 0);
  _fct_TiCell("Symbol");
  _fct_TiCell("Op.");
  _fct_TiCell("Assigned");
  testInfoHeadingEnd(_ttg_Re);
}


void _fct_TiTableFunctionCallReturnValue(char callSig[])
{
  char localBuf[256];
  _fct_TiTableHeadInit();
  snprintf(localBuf, elCount(localBuf), "Function call: %s", callSig);
  _ttg_Re = testInfoTable(localBuf);
  testInfoHeadingBegin(_ttg_Re, 0);
  _fct_TiCell("Symbol");
  _fct_TiCell("Op.");
  _fct_TiCell("Return Value");
  testInfoHeadingEnd(_ttg_Re);
}

void _fct_TiTableWaveformStimulus()
{
  _fct_TiTableHeadInit();
  _ttg_Re = testInfoTable("Stimulation of values with waveform curves");
   testInfoHeadingBegin(_ttg_Re, 0);
   _fct_TiCell("Symbol");
   _fct_TiCell("Stimulated with curve");
   testInfoHeadingEnd(_ttg_Re);
}

void _fct_TiTableHeadSetVariables()
{
  _fct_TiTableHeadInit();
  _ttg_Re = testInfoTable("Setting variable values");
  testInfoHeadingBegin(_ttg_Re, 0);
  _fct_TiCell("Variable");
  _fct_TiCell("Op.");
  _fct_TiCell("Assigned");
  testInfoHeadingEnd(_ttg_Re);
}
void _fct_TiTableHeadReport(char userText[])
{
  _fct_TiTableHeadInit();
  _ttg_Re = testInfoTable(userText);
  testInfoHeadingBegin(_ttg_Re, 0);
  _fct_TiCell("Symbol");
  _fct_TiCell("Value");
  testInfoHeadingEnd(_ttg_Re);
}
void _fct_TiTableHeadSend(char msgDesc[])
{
  char b[256];
  _fct_TiTableHeadInit();
  snprintf(b, elcount(b), "Send %s", msgDesc);
  _ttg_Re = testInfoTable(b);
  testInfoHeadingBegin(_ttg_Re, 0);
  _fct_TiCell("Signal/Byte");
  _fct_TiCell("Op.");
  _fct_TiCell("Assigned");
  testInfoHeadingEnd(_ttg_Re);
}
void _fct_TiTableHeadAwaitSigAv(char text[])
{
  _fct_TiTableHeadInit();
  _ttg_Re = testInfoTable(text);
  testInfoHeadingBegin(_ttg_Re, 0);
  _fct_TiCell("Signal/Node");
  _fct_TiCell("State");
  //_fct_TiCell("Last on Bus");
  _fct_TiCell("Result");
  testInfoHeadingEnd(_ttg_Re);
}
void _fct_TiSignalsAvRow(long indent, long eventId, char reportIdent[]/*, Signal *s*/)
{
  _fct_TiRow(indent, reportIdent);

  if (eventId >= 0)
  {
    if (eventId == 0) // already on bus
    {
      _fct_TiCell("already online");
      //_fct_TiCell(getSignalTime(s));
      _fct_TiCellResult(1);
    }
    else
    {
      int64 time;
      long occurred;
      occurred = testGetJoinedEventOccured(eventId, time);
      if (occurred)
        _fct_TiCell("online");
      else
        _fct_TiCell("not online yet");
      //_fct_TiCell(getSignalTime(s));
      _fct_TiCellResult(occurred);
    }
  }
  else
  { // note: this is a test environment error ...
    _fct_TiCell("-");
    //_fct_TiCell("-");
    _fct_TiCellResult(0);
  }
}

void _fct_TiTableHeadExpected()
{
  _fct_TiTableHeadExpectedEx("Check of expected values");
}

void _fct_TiTableHeadExpectedEx(char title[])
{
  _fct_TiTableHeadInit();
  _ttg_Re = testInfoTable(title);
  testInfoHeadingBegin(_ttg_Re, 0);
  _fct_TiCell("Symbol");
  _fct_TiCell("Op.");
  _fct_TiCell("Reference Value");
  _fct_TiCell("Actual");
  _fct_TiCell("Result");
  testInfoHeadingEnd(_ttg_Re);
}

void _fct_TiTableHeadResponse(char msgDesc[], int numReceived)
{
  char b[200];
  _fct_TiTableHeadInit();
  if (numReceived == -1)
    snprintf(b, elcount(b), "Response of %s", msgDesc); // maybe received after x MS?
  else
    snprintf(b, elcount(b), "Response of %s (received %d times)", msgDesc, numReceived);
  _ttg_Re = testInfoTable(b);
  testInfoHeadingBegin(_ttg_Re, 0);
  _fct_TiCell("Signal/Byte");
  _fct_TiCell("Op.");
  _fct_TiCell("Reference Value");
  if (numReceived == -1)
    _fct_TiCell("Actual");
  else
    _fct_TiCell("Last Received");
  _fct_TiCell("Result");
  testInfoHeadingEnd(_ttg_Re);
}

void _fct_TiCell(char text[])
{
  testInfoCell(_ttg_Re, text);
}

void _fct_TiCellResult(long condition)
{
  if(condition)
    _fct_TiCell("pass");
  else
  {
    _fct_TiCell("fail");
    ++_ttg_TestActionFailCnt;
  }
}

void _fct_TiCellResultTrueFalse(long condition)
{
  if(condition)
    _fct_TiCell("true");
  else
  {
    _fct_TiCell("false");
    ++_ttg_TestActionFailCnt;
  }
}

void _fct_TiCell(int64 value)
{
  _fct_TiIntCell(value);
}
void _fct_TiIntCell(int64 value)
{
  snprintf(_ttg_BR, elcount(_ttg_BR), "%I64d", value);
  _fct_TiCell(_ttg_BR);
}
void _fct_TiUIntCell(qword value)
{
  snprintf(_ttg_BR, elcount(_ttg_BR), "%I64u", value);
  _fct_TiCell(_ttg_BR);
}

void _fct_TiCell(double value)
{
  _fct_TiFloatCell(value);
}
void _fct_TiFloatCell(double value)
{
  snprintf(_ttg_BR, elcount(_ttg_BR), "%.15g", value);
  _fct_TiCell(_ttg_BR);
}

void _fct_TiRow(long indent, char firstCellContent[])
{
  testInfoRow(_ttg_Re, indent, firstCellContent);
}

void _fct_TiWriteByteX(int64 idx, char valueSymbol[], char nameOut[])
{
  if(valueSymbol[0] == 0)
    snprintf(nameOut, elcount(nameOut), "Byte[%I64d]", idx);
  else
    snprintf(nameOut, elcount(nameOut), "Byte[%I64d (%s)]", idx, valueSymbol);
}

void _fct_TiTableEvaluation(char stepIdentifier[])
{
  if(_ttg_TestActionFailCnt > 0)
  {
    testStepFail(0, stepIdentifier, _ttg_Re);
  }
  else
  {
    testStepPass(2, stepIdentifier, _ttg_Re);
  }
}

void _fct_TiTableEnd(char step[], long result, long restriction)
{
  testStep(2, step, _ttg_Re, result, restriction);
}

// write a byte stream as hex tuples into a given buffer ([size] 00 01 A0 ... )
void _fct_TiWriteHexDataToStrBuf(char strBuf[], byte data[], long dataCnt)
{
  char tmp[16];
  long limit, i;

  const long dataMaxDisplayCnt = 32;

  snprintf(strBuf, elcount(strBuf), "[%d] ", dataCnt);
  limit = _min(dataMaxDisplayCnt, dataCnt);

  // if we have more than 'maxCount' bytes ... print first 'maxCount-1' bytes, followed by "..." and the last byte of the sequence
  if (dataCnt > dataMaxDisplayCnt)
    limit--;

  for (i = 0; i < limit; i++)
  {
    if (i == 0)
      snprintf(tmp, elCount(tmp), "%02X", (int)data[i]);
    else
      snprintf(tmp, elCount(tmp), " %02X", (int)data[i]);

    strncat(strBuf, tmp, elCount(strBuf));
  }

  if (dataCnt > dataMaxDisplayCnt)
  {
    snprintf(tmp, elCount(tmp), "... %02X", (int)data[dataCnt - 1]);
    strncat(strBuf, tmp, elCount(strBuf));
  }
}

void _fct_TiCell(byte rawBytes[], long count)
{
  const long dataMaxDisplayCnt = 32; // see _fct_TiWriteHexDataToStrBuf()
  char byteDump[dataMaxDisplayCnt * 3 + 15]; // Only print up to 'maxCount' bytes in the first step -> also in "min..." below!

  _fct_TiWriteHexDataToStrBuf(byteDump, rawBytes, count);

  _fct_TiCell(byteDump);
}
void _fct_TiCellUpdateOccurred(dword updated)
{
  if (updated == 1)
    _fct_TiCell("");
  else
    _fct_TiCell("(no update)");
}
void _fct_TiTableHeadExpectedUpdateOccurred(char title[])
{
  _fct_TiTableHeadInit();
  _ttg_Re = testInfoTable(title);
  testInfoHeadingBegin(_ttg_Re, 0);
  _fct_TiCell("Symbol");
  _fct_TiCell("Op.");
  _fct_TiCell("Reference Value");
  _fct_TiCell("Actual");
  _fct_TiCell(""); // empty cell to report updates
  _fct_TiCell("Result");
  testInfoHeadingEnd(_ttg_Re);
}
void _fct_SetBusContext(char bus[], int saveOldBusContext)
{
  _ttg_gBusContextOk = 1;
  _ttg_gBusContextNew = GetBusNameContext(bus);
  if(_ttg_gBusContextNew == 0)
  {
    _ttg_gBusContextOk = 0;
    testStepErrorInTestSystem("", "Error: Cannot determine context for bus: %s", bus);
    _ttg_gBusContextOld = 0;
    return;
  }
  if(saveOldBusContext == 1)
  {
    _ttg_gBusContextOld = SetBusContext(_ttg_gBusContextNew);
  }
  else
  {
    SetBusContext(_ttg_gBusContextNew);
  }
}

void _fct_ResetBusContext()
{
  if(_ttg_gBusContextOld > 0)
  {
    SetBusContext(_ttg_gBusContextNew);
  }
}

int _fct_BusContextOk()
{
  return _ttg_gBusContextOk;
}


// _fct_EnsureSymbolName(Signal)
_fct_EnsureSymbolName(signal * sym, char nameIn[], char nameOut[])
{
  if(strlen(nameIn) == 0)
  {
    long i, len, pos;
    strncpy(nameOut, sym.name, elcount(nameOut));
    len = strlen(nameOut);
    // find last separator ':'
    pos = 0;
    for(i = len; i > 0; --i)
    {
      if(nameOut[i] == ':')
      {
        pos = i;
        break;
      }
    }
    if(pos > 0 && pos != len)
    {
      char sigNameOnly[200];
      substr_cpy_off(sigNameOnly, 0, sym.name, pos+1, -1, elcount(sigNameOnly));
      snprintf(nameOut, elcount(nameOut), "Signal '%s'", sigNameOnly);
    }
  }
  else { strncpy(nameOut, nameIn, elCount(nameOut)); }
}

// _fct_TiNameOpValue(Int64)
_fct_TiNameOpValue(long indent, char nameIn[], char op[], int64 valueIn, char dstNameIn[])
{
  
  _fct_TiRow(indent, nameIn);
  _fct_TiCell(op);
  if (strlen(dstNameIn) == 0)
  {
    snprintf(_ttg_BR, elCount(_ttg_BR), "%I64d", valueIn);
  }
  else
  {
    snprintf(_ttg_BR, elCount(_ttg_BR), "%I64d (%s)", valueIn, dstNameIn);
  }
  _fct_TiCell(_ttg_BR);
}
_fct_TiNameOpValue(long indent, char nameIn[], char op[], qword valueIn, char dstNameIn[])
{
  
  _fct_TiRow(indent, nameIn);
  _fct_TiCell(op);
  if (strlen(dstNameIn) == 0)
  {
    snprintf(_ttg_BR, elCount(_ttg_BR), "%I64u", valueIn);
  }
  else
  {
    snprintf(_ttg_BR, elCount(_ttg_BR), "%I64u (%s)", valueIn, dstNameIn);
  }
  _fct_TiCell(_ttg_BR);
}

// _fct_TiValueCell(Signal)
_fct_TiValueCell(signal * valueIn)
{
  if (0 == getSignalTime(valueIn))
    _fct_TiCell("not online yet");
  else
  _fct_TiCell($valueIn.phys);
}

// _fct_ChckRep(Signal,Int64,Unspecified)
_fct_ChckRep(long indent, signal * lSym, char lName[], char operator[], int64 rSym, char rName[])
{
  char symLNameBuf[256];
  _fct_EnsureSymbolName(lSym, lName, symLNameBuf);
  _fct_TiNameOpValue(indent, symLNameBuf, operator, rSym, rName);
  _fct_TiValueCell(lSym);
}
_fct_ChckRep(long indent, signal * lSym, char lName[], char operator[], qword rSym, char rName[])
{
  char symLNameBuf[256];
  _fct_EnsureSymbolName(lSym, lName, symLNameBuf);
  _fct_TiNameOpValue(indent, symLNameBuf, operator, rSym, rName);
  _fct_TiValueCell(lSym);
}

// Test Tree
void _ttg_fct_tt_6_0()
{
  // Init FlexRay configuration
}
// _ttg_#_6_0
// Test preparation:Power supply initialization
void _ttg_fct_ts_6_0_0()
{
  _fct_CallTsTc("_ttg_ts_ts_6_0_0",3, 0,"Test preparation:Power supply initialization");
}
// _ttg_#_6_0_0
// 11.5.1 P switch handling
void _ttg_fct_ts_6_0_1()
{
  _fct_CallTsTc("_ttg_ts_ts_6_0_1",3, 0,"11.5.1 P switch handling");
}
// _ttg_#_6_0_1
// 11.6.3 CF_Lvr_BkeAct for Brake
void _ttg_fct_capltestcase_6_0_2_1()
{
  CreateCaplIFFunction("checkCF_Lvr_BkeActForBrake", 1);
  CallInterfaceFunction("11.6.3 CF_Lvr_BkeAct for Brake");
}
// _ttg_#_6_0_2_1
// 11.6.4 Valid P Switch Press
void _ttg_fct_tc_6_0_2_2()
{
  _fct_CallTsTc("_ttg_tc_tc_6_0_2_2",1, 0,"11.6.4 Valid P Switch Press");
}
// _ttg_#_6_0_2_2
// 11.6.5 Valid P-Release Switch Press
void _ttg_fct_tc_6_0_2_3()
{
  _fct_CallTsTc("_ttg_tc_tc_6_0_2_3",1, 0,"11.6.5 Valid P-Release Switch Press");
}
// _ttg_#_6_0_2_3
// 11.6 Brake Input Handling
void _ttg_fct_tfix_cleanup_6_0_2()
{
}
// _ttg_#_6_0_2
// 12.5.2 Sending Gear Position Pattern Sequence
void _ttg_fct_capltestcase_6_0_3_2()
{
  CreateCaplIFFunction("sendingGearPositionPatternSequence", 1);
  CallInterfaceFunction("12.5.2 Sending Gear Position Pattern Sequence");
}
// _ttg_#_6_0_3_2
// 12.5.2 Sending Gear Position Pattern Sequence
void _ttg_fct_tfix_cleanup_6_0_3()
{
}
// _ttg_#_6_0_3
// 12.6 Unlock Switch Handling
void _ttg_fct_ts_6_0_4()
{
  _fct_CallTsTc("_ttg_ts_ts_6_0_4",3, 0,"12.6 Unlock Switch Handling");
}
// _ttg_#_6_0_4
// a. Door Open Auto P Mode:If either door is open(Level B), vehicle stop, gear D or R and brake on to off, then SBW shall send P signal
void _ttg_fct_tttestcaselist_6_0_5_1()
{
  CallTTETCList("_ttg_fct_doorOpenAutoPMode_a_6_1_1_0", "6,6", "_ttg_list_tttestcaselist_6_0_5_1", 0);
}
// _ttg_#_6_0_5_1
// b. Door Open Auto P Mode:If either door is open (Level A), vehicle stop, gear P or N and detecting position D or R, then SBW shall send warning message (CF_Lvr_ShtErrinf -> bit4)
void _ttg_fct_tttestcaselist_6_0_5_2()
{
  CallTTETCList("_ttg_fct_doorOpenAutoPMode_b_6_1_1_1", "6,6", "_ttg_list_tttestcaselist_6_0_5_2", 0);
}
// _ttg_#_6_0_5_2
// c. Door Open Auto P Mode:If either door is open (Level A), vehicle stop, gear D or R and detecting position P or N, then SBW shall send detecting position to TCU.
void _ttg_fct_tttestcaselist_6_0_5_3()
{
  CallTTETCList("_ttg_fct_doorOpenAutoPMode_c_6_1_1_2", "6,6", "_ttg_list_tttestcaselist_6_0_5_3", 0);
}
// _ttg_#_6_0_5_3
// d. Door Open Auto P Mode:If either door is open (Level A), vehicle stop, gear D and detecting position R, then SBW shall send warning message (CF_Lvr_ShtErrinf -> bit4)
void _ttg_fct_tttestcaselist_6_0_5_4()
{
  CallTTETCList("_ttg_fct_doorOpenAutoPMode_d_6_1_1_3", "6", "_ttg_list_tttestcaselist_6_0_5_4", 0);
}
// _ttg_#_6_0_5_4
// e. Door Open Auto P Mode:If either door is open (Level A), vehicle stop, gear R and detecting position D, then SBW shall send warning message (CF_Lvr_ShtErrinf -> bit4)
void _ttg_fct_tttestcaselist_6_0_5_5()
{
  CallTTETCList("_ttg_fct_doorOpenAutoPMode_e_6_1_1_4", "6", "_ttg_list_tttestcaselist_6_0_5_5", 0);
}
// _ttg_#_6_0_5_5
// 12.7.1.1 Door Open Auto P Mode
void _ttg_fct_tfix_cleanup_6_0_5()
{
}
// _ttg_#_6_0_5
// a. If driver seat belt is off, vehicle stop, gear D or R and brake on to off, then SBW send P signal.
void _ttg_fct_tttestcaselist_6_0_6_1()
{
  CallTTETCList("_ttg_fct_driverSeatBeltOffAutoP_a_6_1_1_5", "6,6", "_ttg_list_tttestcaselist_6_0_6_1", 0);
}
// _ttg_#_6_0_6_1
// b. If driver seat belt is off, vehicle stop, gear P or N and detecting position D or R, then SBW shall send warning message (CF_Lvr_ShtErrinf -> bit5)
void _ttg_fct_tttestcaselist_6_0_6_2()
{
  CallTTETCList("_ttg_fct_driverSeatBeltOffAutoP_b_6_1_1_6", "6,6", "_ttg_list_tttestcaselist_6_0_6_2", 0);
}
// _ttg_#_6_0_6_2
// c. If driver seat belt is off, vehicle stop, gear D or R and detecting position P or N, then SBW shall send detecting position to TCU
void _ttg_fct_tttestcaselist_6_0_6_3()
{
  CallTTETCList("_ttg_fct_driverSeatBeltOffAutoP_c_6_1_1_7", "6,6", "_ttg_list_tttestcaselist_6_0_6_3", 0);
}
// _ttg_#_6_0_6_3
// d. If driver seat belt is off, vehicle stop, gear D and detecting position R, then SBW shall send warning message (CF_Lvr_ShtErrinf -> bit5)
void _ttg_fct_tttestcaselist_6_0_6_4()
{
  CallTTETCList("_ttg_fct_driverSeatBeltOffAutoP_d_6_1_1_8", "6", "_ttg_list_tttestcaselist_6_0_6_4", 0);
}
// _ttg_#_6_0_6_4
// e. If driver seat belt is off, vehicle stop, gear R and detecting position D, then SBW shall send warning message (CF_Lvr_ShtErrinf -> bit5)
void _ttg_fct_tttestcaselist_6_0_6_5()
{
  CallTTETCList("_ttg_fct_driverSeatBeltOffAutoP_e_6_1_1_9", "6", "_ttg_list_tttestcaselist_6_0_6_5", 0);
}
// _ttg_#_6_0_6_5
// 12.7.1.2 Driver Seat Belt OFF Auto P
void _ttg_fct_tfix_cleanup_6_0_6()
{
}
// _ttg_#_6_0_6
// a. Set Auto N Mode
void _ttg_fct_tttestcaselist_6_0_7_1()
{
  CallTTETCList("_ttg_fct_setAutoNMode_6_1_1_10", "6", "_ttg_list_tttestcaselist_6_0_7_1", 0);
}
// _ttg_#_6_0_7_1
// b. Test auto N mode after mode set
void _ttg_fct_tttestcaselist_6_0_7_2()
{
  CallTTETCList("_ttg_fct_testAutoNModeAfterModeSet_6_1_1_11", "6", "_ttg_list_tttestcaselist_6_0_7_2", 0);
}
// _ttg_#_6_0_7_2
// c. Mode Reset
void _ttg_fct_tc_6_0_7_3()
{
  _fct_CallTsTc("_ttg_tc_tc_6_0_7_3",1, 0,"c. Mode Reset");
}
// _ttg_#_6_0_7_3
// d. Test auto N mode inactive after mode reset
void _ttg_fct_tttestcaselist_6_0_7_4()
{
  CallTTETCList("_ttg_fct_testAutoNModeInactiveAfterModeReset_6_1_1_12", "6", "_ttg_list_tttestcaselist_6_0_7_4", 0);
}
// _ttg_#_6_0_7_4
// 12.7.1.3 Auto N Mode
void _ttg_fct_tfix_cleanup_6_0_7()
{
}
// _ttg_#_6_0_7
// 13.3 Backlight Illumination
void _ttg_fct_tc_6_0_8_1()
{
  _fct_CallTsTc("_ttg_tc_tc_6_0_8_1",1, 0,"13.3 Backlight Illumination");
}
// _ttg_#_6_0_8_1
// 13.4.1.a The indicators should be controlled according to the Vehicle gear position sent by TCU when IG is ON. If the Vehicle gear position is fault,SBW shall turn off all the indicators.
void _ttg_fct_capltestcaselist_6_0_8_2()
{
  CallCaplTCList("setIndicatorByVehicleGearPosSentByTCU", "I", "_ttg_list_capltestcaselist_6_0_8_2");
}
// _ttg_#_6_0_8_2
// 13.4.1.b The indicators should be controlled according to PRA position when IG OFF. While PRA is at P position, SBW shall light P indicator. While PRA is at Not P position, SBW shall light N indicator.
void _ttg_fct_tttestcaselist_6_0_8_3()
{
  CallTTETCList("_ttg_fct_checkIndicatorAccordingToPRAPos_6_1_1_20", "6", "_ttg_list_tttestcaselist_6_0_8_3", 0);
}
// _ttg_#_6_0_8_3
// 13.4.2.2-13.4.2.4 Operation:timeout mode,day mode,night mode
void _ttg_fct_tc_6_0_8_4()
{
  _fct_CallTsTc("_ttg_tc_tc_6_0_8_4",1, 0,"13.4.2.2-13.4.2.4 Operation:timeout mode,day mode,night mode");
}
// _ttg_#_6_0_8_4
// 13.4.2.5 Operation:blinking Mode
void _ttg_fct_tttestcaselist_6_0_8_5()
{
  CallTTETCList("_ttg_fct_checkIndicatorBlinkingMode_6_1_1_21", "6", "_ttg_list_tttestcaselist_6_0_8_5", 0);
}
// _ttg_#_6_0_8_5
// 13 Illumination Control
void _ttg_fct_tfix_cleanup_6_0_8()
{
}
// _ttg_#_6_0_8
// 15.3.1.a IG ON Mode: If PRA positon is not P and Gear changes to NOT N position, SBW shall operate PRA to P Position.
void _ttg_fct_tttestcaselist_6_0_9_1()
{
  CallTTETCList("_ttg_fct_iGOnMode_a_6_1_1_13", "6,6", "_ttg_list_tttestcaselist_6_0_9_1", 0);
}
// _ttg_#_6_0_9_1
// 15.3.1.b IG ON Mode: If P Switch pressed ON while IGN ON and vehicle stop, SBW shall operate PRA to P position.
void _ttg_fct_tc_6_0_9_2()
{
  _fct_CallTsTc("_ttg_tc_tc_6_0_9_2",1, 0,"15.3.1.b IG ON Mode: If P Switch pressed ON while IGN ON and vehicle stop, SBW shall operate PRA to P position.");
}
// _ttg_#_6_0_9_2
// 15.3.1.1.a TCU OFF: When last gear is D,SBW shall operate PRA to Not P position.
void _ttg_fct_tttestcaselist_6_0_9_3()
{
  CallTTETCList("_ttg_fct_testPRAUnderTcuOffwithLastGearD_6_1_1_16", "6", "_ttg_list_tttestcaselist_6_0_9_3", 0);
}
// _ttg_#_6_0_9_3
// 15.3.1.1.b-c TCU OFF: When last gear is P,R or N SBW shall keep PRA in P position.After PRA is operated from Not P Position to P position, SBW should not operate PRA again while keep in TCU OFF condition unless IGN OFF to ON again.
void _ttg_fct_tttestcaselist_6_0_9_4()
{
  CallTTETCList("_ttg_fct_testPRAUnderTcuOffwithLastGearPRorN_6_1_1_17", "6", "_ttg_list_tttestcaselist_6_0_9_4", 0);
}
// _ttg_#_6_0_9_4
// 15.3.1.1.d TCU OFF: When P switch is pressed when vehicle is stopped, SBW shall operate PRA to P position
void _ttg_fct_tc_6_0_9_5()
{
  _fct_CallTsTc("_ttg_tc_tc_6_0_9_5",1, 0,"15.3.1.1.d TCU OFF: When P switch is pressed when vehicle is stopped, SBW shall operate PRA to P position");
}
// _ttg_#_6_0_9_5
// 15.3.1.2.c TCU Request: During the activating to Not P position by receiving CF_Tcu_PrelReq = 0x1 from TCU, if receiving the CF_Tcu_PrelReq = 0x0 from TCU, then SBW shall operate PRA to P position immediately.
void _ttg_fct_tc_6_0_9_6()
{
  _fct_CallTsTc("_ttg_tc_tc_6_0_9_6",1, 0,"15.3.1.2.c TCU Request: During the activating to Not P position by receiving CF_Tcu_PrelReq = 0x1 from TCU, if receiving the CF_Tcu_PrelReq = 0x0 from TCU, then SBW shall operate PRA to P position immediately.");
}
// _ttg_#_6_0_9_6
// 15.3.1.2.d TCU Request: Otherwise SBW shall ignore TCU request, without any PRA operation.
void _ttg_fct_tc_6_0_9_7()
{
  _fct_CallTsTc("_ttg_tc_tc_6_0_9_7",1, 0,"15.3.1.2.d TCU Request: Otherwise SBW shall ignore TCU request, without any PRA operation.");
}
// _ttg_#_6_0_9_7
// 15.3.1.3 Recovery TCU OFF at Vehicle Driving
void _ttg_fct_tttestcaselist_6_0_9_8()
{
  CallTTETCList("_ttg_fct_recoveryTcuOffAtVehicleDriving_6_1_1_14", "6", "_ttg_list_tttestcaselist_6_0_9_8", 0);
}
// _ttg_#_6_0_9_8
// 15.3.1.4 Recovery TCU OFF at Vehicle Stop
void _ttg_fct_tttestcaselist_6_0_9_9()
{
  CallTTETCList("_ttg_fct_recoveryTcuOffAtVehicleStop_6_1_1_15", "6", "_ttg_list_tttestcaselist_6_0_9_9", 0);
}
// _ttg_#_6_0_9_9
// 15.3.1 PRA Logic: IG ON Mode
void _ttg_fct_tfix_cleanup_6_0_9()
{
}
// _ttg_#_6_0_9
// testPRAUnderIGOffMode
void _ttg_fct_tttestcaselist_6_0_10_1()
{
  CallTTETCList("_ttg_fct_testPRAUnderIGOffMode_6_1_1_18", "6", "_ttg_list_tttestcaselist_6_0_10_1", 0);
}
// _ttg_#_6_0_10_1
// 15.3.2 PRA Logic: IG OFF Mode
void _ttg_fct_tfix_cleanup_6_0_10()
{
}
// _ttg_#_6_0_10
// 15.3.3.a Gear N IG OFF Mode: SBW shall initially keep PRA to Not P position unless below condition happened.
void _ttg_fct_tc_6_0_11_1()
{
  _fct_CallTsTc("_ttg_tc_tc_6_0_11_1",1, 0,"15.3.3.a Gear N IG OFF Mode: SBW shall initially keep PRA to Not P position unless below condition happened.");
}
// _ttg_#_6_0_11_1
// 15.3.3.b Gear N IG OFF Mode: While timeout, SBW shall operate PRA to P position
void _ttg_fct_tc_6_0_11_2()
{
  _fct_CallTsTc("_ttg_tc_tc_6_0_11_2",1, 0,"15.3.3.b Gear N IG OFF Mode: While timeout, SBW shall operate PRA to P position");
}
// _ttg_#_6_0_11_2
// 15.3.3 Gear N IG OFF Mode
void _ttg_fct_tfix_cleanup_6_0_11()
{
}
// _ttg_#_6_0_11
// 15.3.4 N Park Mode
void _ttg_fct_tttestcaselist_6_0_12_1()
{
  CallTTETCList("_ttg_fct_testPRAUnderNParkMode_6_1_1_19", "6", "_ttg_list_tttestcaselist_6_0_12_1", 0);
}
// _ttg_#_6_0_12_1
// 15.3.4 N Park Mode
void _ttg_fct_tfix_cleanup_6_0_12()
{
}
// _ttg_#_6_0_12
// 15.3.5.a Manual Release Function: The manual release function is only allowed in below condition:N Park Mode (PRA Not P Position) -> Pressed P switch (PRA P Position)
void _ttg_fct_tttestcaselist_6_0_13_1()
{
  CallTTETCList("_ttg_fct_manualReleaseFunction_a_6_1_1_22", "6", "_ttg_list_tttestcaselist_6_0_13_1", 0);
}
// _ttg_#_6_0_13_1
// 15.3.5.b Manual Release Function: When IG ON, if driver do manual release, Waits 4 seconds, SBW shall operate PRA to P position.
void _ttg_fct_tc_6_0_13_2()
{
  _fct_CallTsTc("_ttg_tc_tc_6_0_13_2",1, 0,"15.3.5.b Manual Release Function: When IG ON, if driver do manual release, Waits 4 seconds, SBW shall operate PRA to P position.");
}
// _ttg_#_6_0_13_2
// 15.3.5.d Manual Release Function: If Driver Door open in Standby mode, SBW shall not allowed the manual release. If driver do the manual release, SBW shall waits 4 seconds, then operate PRA to P position.
void _ttg_fct_tttestcaselist_6_0_13_3()
{
  CallTTETCList("_ttg_fct_manualReleaseFunction_d_6_1_1_23", "6", "_ttg_list_tttestcaselist_6_0_13_3", 0);
}
// _ttg_#_6_0_13_3
// 15.3.5 Manual Release Function
void _ttg_fct_tfix_cleanup_6_0_13()
{
}
// _ttg_#_6_0_13
// 15.3.6 TCU Eol Complete
void _ttg_fct_ts_6_0_14()
{
  _fct_CallTsTc("_ttg_ts_ts_6_0_14",3, 0,"15.3.6 TCU Eol Complete");
}
// _ttg_#_6_0_14
// 15.3.7.c Limp-Home function: IGN ON and PRA is not P position within low voltage range (8v-8.5v), then SBW shall operate PRA to P position.
void _ttg_fct_tc_6_0_15_1()
{
  _fct_CallTsTc("_ttg_tc_tc_6_0_15_1",1, 0,"15.3.7.c Limp-Home function: IGN ON and PRA is not P position within low voltage range (8v-8.5v), then SBW shall operate PRA to P position.");
}
// _ttg_#_6_0_15_1
// 15.3.7.a IGN OFF and Determine a low voltage range (8v – 8.5v) and execute an operation command of “P” or “Not P” to PRA depending on the input of valid P switch press and valid P-Release switch press.
void _ttg_fct_tc_6_0_15_2()
{
  _fct_CallTsTc("_ttg_tc_tc_6_0_15_2",1, 0,"15.3.7.a IGN OFF and Determine a low voltage range (8v – 8.5v) and execute an operation command of “P” or “Not P” to PRA depending on the input of valid P switch press and valid P-Release switch press.");
}
// _ttg_#_6_0_15_2
// 15.3.7 Limp-Home function
void _ttg_fct_tfix_cleanup_6_0_15()
{
}
// _ttg_#_6_0_15
// 15.3.8 PRA Disable Voltage
void _ttg_fct_ts_6_0_16()
{
  _fct_CallTsTc("_ttg_ts_ts_6_0_16",3, 0,"15.3.8 PRA Disable Voltage");
}
// _ttg_#_6_0_16
// try
void _ttg_fct_ts_6_0_17()
{
  _fct_CallTsTc("_ttg_ts_ts_6_0_17",3, 0,"try");
}
// _ttg_#_6_0_17
// Test Sequence
void _ttg_fct_ts_6_0_18()
{
  _fct_CallTsTc("_ttg_ts_ts_6_0_18",3, 0,"Test Sequence");
}
// _ttg_#_6_0_18
// P position
void _ttg_fct_tc_6_0_19_1()
{
  _fct_CallTsTc("_ttg_tc_tc_6_0_19_1",1, 0,"P position");
}
// _ttg_#_6_0_19_1
// Not P position
void _ttg_fct_tc_6_0_19_2()
{
  _fct_CallTsTc("_ttg_tc_tc_6_0_19_2",1, 0,"Not P position");
}
// _ttg_#_6_0_19_2
// confirm PRA position
void _ttg_fct_tfix_cleanup_6_0_19()
{
}
// _ttg_#_6_0_19
// Test completion:shutdown the power
void _ttg_fct_ts_6_0_20()
{
  _fct_CallTsTc("_ttg_ts_ts_6_0_20",3, 0,"Test completion:shutdown the power");
}
// _ttg_#_6_0_20
// try ig on
void _ttg_fct_ts_6_0_21()
{
  _fct_CallTsTc("_ttg_ts_ts_6_0_21",3, 0,"try ig on");
}
// _ttg_#_6_0_21
// try DTC
void _ttg_fct_ts_6_0_22()
{
  _fct_CallTsTc("_ttg_ts_ts_6_0_22",3, 0,"try DTC");
}
// _ttg_#_6_0_22
// readSwVer ()
void _ttg_fct_capltestcase_6_0_23_1()
{
  CreateCaplIFFunction("readSwVer", 1);
  CallInterfaceFunction("readSwVer ()");
}
// _ttg_#_6_0_23_1
// Setup Initialization & Power On
void _ttg_fct_tfix_cleanup_6_0_23()
{
}
// _ttg_#_6_0_23
testcase _ttg_fct_doorOpenAutoPMode_a_6_1_1_0(int64 _ttg_var_canSigTimeoutBool_6_1_1_0_1_0, int64 _ttg_var_vehicleGearPosStatus_6_1_1_0_1_1)
{
  {
    // Preparation
    _ttg_fct_preparation_6_1_1_0_2(_ttg_var_canSigTimeoutBool_6_1_1_0_1_0, _ttg_var_vehicleGearPosStatus_6_1_1_0_1_1);
    if(_fct_DoStop(EVerdBOF_TC, 1))
    {
      return;
    }
  }
  {
    CreateCaplIFFunction("openDoorAccordingToLevel", 0);
    _ttg_I0 = 'b';
    AddIFParameterInt(_ttg_I0);
    CallInterfaceFunction("make a door open(Level B)");
    if(_fct_DoStop(EVerdBOF_TC, 1))
    {
      return;
    }
  }
  {
    CreateCaplIFFunction("setVehicleSpeed", 0);
    AddIFParameterInt(1LL);
    AddIFParameterInt(1LL);
    CallInterfaceFunction("make vehicle stop");
    if(_fct_DoStop(EVerdBOF_TC, 1))
    {
      return;
    }
  }
  TestCommandBegin("Wait", "");
  {
    _fct_Wait("1", (int64)(1LL * 1000000000LL), 1000000000, "");
  }
  // _ttg_!_6_1_1_0_7
  TestCommandEnd();
  if(_fct_DoStop(EVerdBOF_TC, 1))
  {
    return;
  }
  {
    CreateCaplIFFunction("setVehicleGearPos", 0);
    AddIFParameterInt(1LL);
    AddIFParameterInt(_ttg_var_canSigTimeoutBool_6_1_1_0_1_0);
    AddIFParameterInt(_ttg_var_vehicleGearPosStatus_6_1_1_0_1_1);
    CallInterfaceFunction("set gear D or R");
    if(_fct_DoStop(EVerdBOF_TC, 1))
    {
      return;
    }
  }
  TestCommandBegin("Wait", "");
  {
    _fct_Wait("1", (int64)(1LL * 1000000000LL), 1000000000, "");
  }
  // _ttg_!_6_1_1_0_10
  TestCommandEnd();
  if(_fct_DoStop(EVerdBOF_TC, 1))
  {
    return;
  }
  {
    CreateCaplIFFunction("setBrakeStatus", 0);
    AddIFParameterInt(1LL);
    CallInterfaceFunction("set brake on");
    if(_fct_DoStop(EVerdBOF_TC, 1))
    {
      return;
    }
  }
  TestCommandBegin("Wait", "");
  {
    _fct_Wait("1", (int64)(1LL * 1000000000LL), 1000000000, "");
  }
  // _ttg_!_6_1_1_0_14
  TestCommandEnd();
  if(_fct_DoStop(EVerdBOF_TC, 1))
  {
    return;
  }
  {
    CreateCaplIFFunction("setBrakeStatus", 0);
    AddIFParameterInt(0LL);
    CallInterfaceFunction("set brake off");
    if(_fct_DoStop(EVerdBOF_TC, 1))
    {
      return;
    }
  }
  TestCommandBegin("Await Value Match", "");
  {
    dword eventTable[2];
    long ret, setfailed; setfailed = 0;
    if((int64)(103LL * 1000000LL) < 0)
    {
      testStepErrorInTestSystem(0, "1", "Invalid wait time (< 0)");
    }
    else
    {
      eventTable[0] = testJoinSignal(HKMC_LH_SBW::dbNode::LVR::LVR11::CF_Lvr_PosInf, "_ttg_callback_awaitvaluematch_6_1_1_0_16_2", "CAN signal \'CF_Lvr_PosInf\'", 0);
      setfailed |= eventTable[0] < 0;
      eventTable[1] = testJoinSignal(HKMC_LH_SBW::dbNode::LVR::LVR11::CF_Lvr_PosCpl, "_ttg_callback_awaitvaluematch_6_1_1_0_16_3", "CAN signal \'CF_Lvr_PosCpl\'", 0);
      setfailed |= eventTable[1] < 0;
      if(setfailed != 0)
      {
        testStepErrorInTestSystem(0, "1", "Unable to set value condition(s)");
      }
      ret = testWaitForAllJoinedEventsNS((int64)(103LL * 1000000LL));
      if(setfailed == 0)
      {
        if(ret > 0)
        {
          testStepPass(2, "1", "Waited for occurrence of 2 value condition(s).");
        }
        else
        {
          testStepFail(0, "1", "Waited for occurrence of 2 value condition(s).");
        }
        _fct_TiTableHeadExpectedEx("");
        _fct_ChckRep(0, HKMC_LH_SBW::dbNode::LVR::LVR11::CF_Lvr_PosInf, "CAN signal \'CF_Lvr_PosInf\'", "==", 1LL, "");
        _fct_TiCellResult(((0!=getSignalTime(HKMC_LH_SBW::dbNode::LVR::LVR11::CF_Lvr_PosInf)) && CheckSignalMatch(HKMC_LH_SBW::dbNode::LVR::LVR11::CF_Lvr_PosInf, 1LL, "=") == 1));
        _fct_ChckRep(0, HKMC_LH_SBW::dbNode::LVR::LVR11::CF_Lvr_PosCpl, "CAN signal \'CF_Lvr_PosCpl\'", "==", 14LL, "");
        _fct_TiCellResult(((0!=getSignalTime(HKMC_LH_SBW::dbNode::LVR::LVR11::CF_Lvr_PosCpl)) && CheckSignalMatch(HKMC_LH_SBW::dbNode::LVR::LVR11::CF_Lvr_PosCpl, 14LL, "=") == 1));
        _fct_TiTableEnd("", 0, 0);
      }
    }
  }
  // _ttg_!_6_1_1_0_16
  TestCommandEnd();
  if(_fct_DoStop(EVerdBOF_TC, 1))
  {
    return;
  }
  TestCommandBegin("CAPL Inline", "capture CF_Lvr_PosInf ,CF_Lvr_PosCpl after brake on to off");
  {
    _ttg_fct_caplinline_6_1_1_0_17();
  }
  // _ttg_!_6_1_1_0_17
  TestCommandEnd();
  if(_fct_DoStop(EVerdBOF_TC, 1))
  {
    return;
  }
}
// _ttg_#_6_1_1_0
testcase _ttg_fct_doorOpenAutoPMode_b_6_1_1_1(int64 _ttg_var_canSigTimeoutBool_6_1_1_1_1_0, int64 _ttg_var_vehicleGearPosStatus_6_1_1_1_1_1)
{
  {
    // Variables
    _ttg_var_errorcode_6_1_1_1_2_0 = 0LL;
    snprintf(_ttg_B, 2000, "%I64d", 0LL);
    TestReportVariableDefinition("errorcode", "float", _ttg_B);
  }
  {
    // Preparation
    _ttg_fct_preparation_6_1_1_1_3(_ttg_var_canSigTimeoutBool_6_1_1_1_1_0, _ttg_var_vehicleGearPosStatus_6_1_1_1_1_1);
    if(_fct_DoStop(EVerdBOF_TC, 1))
    {
      return;
    }
  }
  {
    CreateCaplIFFunction("openDoorAccordingToLevel", 0);
    _ttg_I0 = 'a';
    AddIFParameterInt(_ttg_I0);
    CallInterfaceFunction("make a door open(Level A)");
    if(_fct_DoStop(EVerdBOF_TC, 1))
    {
      return;
    }
  }
  {
    CreateCaplIFFunction("setVehicleSpeed", 0);
    AddIFParameterInt(1LL);
    AddIFParameterInt(1LL);
    CallInterfaceFunction("make vehicle stop");
    if(_fct_DoStop(EVerdBOF_TC, 1))
    {
      return;
    }
  }
  TestCommandBegin("Wait", "");
  {
    _fct_Wait("1", (int64)(1LL * 1000000000LL), 1000000000, "");
  }
  // _ttg_!_6_1_1_1_8
  TestCommandEnd();
  if(_fct_DoStop(EVerdBOF_TC, 1))
  {
    return;
  }
  {
    CreateCaplIFFunction("setVehicleGearPos", 0);
    AddIFParameterInt(1LL);
    AddIFParameterInt(_ttg_var_canSigTimeoutBool_6_1_1_1_1_0);
    AddIFParameterInt(_ttg_var_vehicleGearPosStatus_6_1_1_1_1_1);
    CallInterfaceFunction("set gear P or N");
    if(_fct_DoStop(EVerdBOF_TC, 1))
    {
      return;
    }
  }
  TestCommandBegin("Wait", "");
  {
    _fct_Wait("1", (int64)(1LL * 1000000000LL), 1000000000, "");
  }
  // _ttg_!_6_1_1_1_11
  TestCommandEnd();
  if(_fct_DoStop(EVerdBOF_TC, 1))
  {
    return;
  }
  TestCommandBegin("CAPL Inline", "record initial errorcode");
  {
    _ttg_fct_caplinline_6_1_1_1_14();
  }
  // _ttg_!_6_1_1_1_14
  TestCommandEnd();
  if(_fct_DoStop(EVerdBOF_TC, 1))
  {
    return;
  }
  TestCommandBegin("CANoe Standard Service", "handle lever at position D or R (click ok first then operate lever)");
  {
    testStep(2, "", "Execute testValidateTesterConfirmation(\"handle lever at position D or R (click ok first then operate lever)\", \"Operate lever\", 1)");
    testValidateTesterConfirmation("handle lever at position D or R (click ok first then operate lever)", "Operate lever", 1LL);
  }
  // _ttg_!_6_1_1_1_15
  TestCommandEnd();
  if(_fct_DoStop(EVerdBOF_TC, 1))
  {
    return;
  }
  {
    CreateCaplIFFunction("checkWarningMessage", 0);
    AddIFParameterInt(4LL);
    AddIFParameterDWord(_ttg_var_errorcode_6_1_1_1_2_0);
    CallInterfaceFunction("check CF_Lvr_ShfErrinf -> bit4");
    if(_fct_DoStop(EVerdBOF_TC, 1))
    {
      return;
    }
  }
  TestCommandBegin("CAPL Inline", "capture CF_Lvr_ShfErrinf after detecting position D or R");
  {
    _ttg_fct_caplinline_6_1_1_1_17();
  }
  // _ttg_!_6_1_1_1_17
  TestCommandEnd();
  if(_fct_DoStop(EVerdBOF_TC, 1))
  {
    return;
  }
}
// _ttg_#_6_1_1_1
testcase _ttg_fct_doorOpenAutoPMode_c_6_1_1_2(int64 _ttg_var_canSigTimeoutBool_6_1_1_2_1_0, int64 _ttg_var_vehicleGearPosStatus_6_1_1_2_1_1)
{
  {
    // Preparation
    _ttg_fct_preparation_6_1_1_2_2(_ttg_var_canSigTimeoutBool_6_1_1_2_1_0, _ttg_var_vehicleGearPosStatus_6_1_1_2_1_1);
    if(_fct_DoStop(EVerdBOF_TC, 1))
    {
      return;
    }
  }
  {
    CreateCaplIFFunction("openDoorAccordingToLevel", 0);
    _ttg_I0 = 'a';
    AddIFParameterInt(_ttg_I0);
    CallInterfaceFunction("make a door open(Level A)");
    if(_fct_DoStop(EVerdBOF_TC, 1))
    {
      return;
    }
  }
  {
    CreateCaplIFFunction("setVehicleSpeed", 0);
    AddIFParameterInt(1LL);
    AddIFParameterInt(1LL);
    CallInterfaceFunction("make vehicle stop");
    if(_fct_DoStop(EVerdBOF_TC, 1))
    {
      return;
    }
  }
  TestCommandBegin("Wait", "");
  {
    _fct_Wait("1", (int64)(1LL * 1000000000LL), 1000000000, "");
  }
  // _ttg_!_6_1_1_2_7
  TestCommandEnd();
  if(_fct_DoStop(EVerdBOF_TC, 1))
  {
    return;
  }
  {
    CreateCaplIFFunction("setVehicleGearPos", 0);
    AddIFParameterInt(1LL);
    AddIFParameterInt(_ttg_var_canSigTimeoutBool_6_1_1_2_1_0);
    AddIFParameterInt(_ttg_var_vehicleGearPosStatus_6_1_1_2_1_1);
    CallInterfaceFunction("set gear D or R");
    if(_fct_DoStop(EVerdBOF_TC, 1))
    {
      return;
    }
  }
  TestCommandBegin("Wait", "");
  {
    _fct_Wait("1", (int64)(1LL * 1000000000LL), 1000000000, "");
  }
  // _ttg_!_6_1_1_2_10
  TestCommandEnd();
  if(_fct_DoStop(EVerdBOF_TC, 1))
  {
    return;
  }
  {
    CreateCaplIFFunction("parkSwitchPress", 0);
    AddIFParameterInt(1LL);
    AddIFParameterChar("12.7.1.1.c detecting position P.png");
    CallInterfaceFunction("detecting position P");
    if(_fct_DoStop(EVerdBOF_TC, 1))
    {
      return;
    }
  }
  TestCommandBegin("Wait", "");
  {
    _fct_Wait("1", (int64)(1LL * 1000000000LL), 1000000000, "");
  }
  // _ttg_!_6_1_1_2_14
  TestCommandEnd();
  if(_fct_DoStop(EVerdBOF_TC, 1))
  {
    return;
  }
  TestCommandBegin("CANoe Standard Service", "detecting position Nr");
  {
    testStep(2, "", "Execute testValidateTesterConfirmation(\"handle lever at position Nr\", \"Operate lever\", 1)");
    testValidateTesterConfirmation("handle lever at position Nr", "Operate lever", 1LL);
  }
  // _ttg_!_6_1_1_2_16
  TestCommandEnd();
  if(_fct_DoStop(EVerdBOF_TC, 1))
  {
    return;
  }
  {
    CreateCaplIFFunction("checkLeverPositionSendToTcu", 0);
    AddIFParameterInt(3LL);
    CallInterfaceFunction("checkLeverPositionSendToTcu (vehicleGearPosStatus=3)");
    if(_fct_DoStop(EVerdBOF_TC, 1))
    {
      return;
    }
  }
  TestCommandBegin("Wait", "");
  {
    _fct_Wait("1", (int64)(1LL * 1000000000LL), 1000000000, "");
  }
  // _ttg_!_6_1_1_2_18
  TestCommandEnd();
  if(_fct_DoStop(EVerdBOF_TC, 1))
  {
    return;
  }
  TestCommandBegin("CANoe Standard Service", "detecting position Nd");
  {
    testStep(2, "", "Execute testValidateTesterConfirmation(\"handle lever at position Nd\", \"Operate lever\", 1)");
    testValidateTesterConfirmation("handle lever at position Nd", "Operate lever", 1LL);
  }
  // _ttg_!_6_1_1_2_20
  TestCommandEnd();
  if(_fct_DoStop(EVerdBOF_TC, 1))
  {
    return;
  }
  {
    CreateCaplIFFunction("checkLeverPositionSendToTcu", 0);
    AddIFParameterInt(4LL);
    CallInterfaceFunction("checkLeverPositionSendToTcu (vehicleGearPosStatus=4)");
    if(_fct_DoStop(EVerdBOF_TC, 1))
    {
      return;
    }
  }
}
// _ttg_#_6_1_1_2
testcase _ttg_fct_doorOpenAutoPMode_d_6_1_1_3(int64 _ttg_var_canSigTimeoutBool_6_1_1_3_1_0)
{
  {
    // Variables
    _ttg_var_errorcode_6_1_1_3_2_0 = 0LL;
    snprintf(_ttg_B, 2000, "%I64d", 0LL);
    TestReportVariableDefinition("errorcode", "float", _ttg_B);
  }
  {
    // Preparation
    _ttg_fct_preparation_6_1_1_3_3(_ttg_var_canSigTimeoutBool_6_1_1_3_1_0);
    if(_fct_DoStop(EVerdBOF_TC, 1))
    {
      return;
    }
  }
  {
    CreateCaplIFFunction("openDoorAccordingToLevel", 0);
    _ttg_I0 = 'a';
    AddIFParameterInt(_ttg_I0);
    CallInterfaceFunction("make a door open(Level A)");
    if(_fct_DoStop(EVerdBOF_TC, 1))
    {
      return;
    }
  }
  {
    CreateCaplIFFunction("setVehicleSpeed", 0);
    AddIFParameterInt(1LL);
    AddIFParameterInt(1LL);
    CallInterfaceFunction("make vehicle stop");
    if(_fct_DoStop(EVerdBOF_TC, 1))
    {
      return;
    }
  }
  TestCommandBegin("Wait", "");
  {
    _fct_Wait("1", (int64)(1LL * 1000000000LL), 1000000000, "");
  }
  // _ttg_!_6_1_1_3_9
  TestCommandEnd();
  if(_fct_DoStop(EVerdBOF_TC, 1))
  {
    return;
  }
  {
    CreateCaplIFFunction("setVehicleGearPos", 0);
    AddIFParameterInt(1LL);
    AddIFParameterInt(_ttg_var_canSigTimeoutBool_6_1_1_3_1_0);
    AddIFParameterInt(4LL);
    CallInterfaceFunction("set gear D");
    if(_fct_DoStop(EVerdBOF_TC, 1))
    {
      return;
    }
  }
  TestCommandBegin("Wait", "");
  {
    _fct_Wait("1", (int64)(1LL * 1000000000LL), 1000000000, "");
  }
  // _ttg_!_6_1_1_3_12
  TestCommandEnd();
  if(_fct_DoStop(EVerdBOF_TC, 1))
  {
    return;
  }
  TestCommandBegin("CAPL Inline", "record initial errorcode");
  {
    _ttg_fct_caplinline_6_1_1_3_15();
  }
  // _ttg_!_6_1_1_3_15
  TestCommandEnd();
  if(_fct_DoStop(EVerdBOF_TC, 1))
  {
    return;
  }
  TestCommandBegin("CANoe Standard Service", "handle lever at position R");
  {
    testStep(2, "", "Execute testValidateTesterConfirmation(\"handle lever at position R\", \"Operate lever\", 1)");
    testValidateTesterConfirmation("handle lever at position R", "Operate lever", 1LL);
  }
  // _ttg_!_6_1_1_3_16
  TestCommandEnd();
  if(_fct_DoStop(EVerdBOF_TC, 1))
  {
    return;
  }
  {
    CreateCaplIFFunction("checkWarningMessage", 0);
    AddIFParameterInt(4LL);
    AddIFParameterDWord(_ttg_var_errorcode_6_1_1_3_2_0);
    CallInterfaceFunction("check CF_Lvr_ShfErrinf -> bit4");
    if(_fct_DoStop(EVerdBOF_TC, 1))
    {
      return;
    }
  }
  TestCommandBegin("CAPL Inline", "capture CF_Lvr_ShfErrinf after detecting position R");
  {
    _ttg_fct_caplinline_6_1_1_3_18();
  }
  // _ttg_!_6_1_1_3_18
  TestCommandEnd();
  if(_fct_DoStop(EVerdBOF_TC, 1))
  {
    return;
  }
}
// _ttg_#_6_1_1_3
testcase _ttg_fct_doorOpenAutoPMode_e_6_1_1_4(int64 _ttg_var_canSigTimeoutBool_6_1_1_4_1_0)
{
  {
    // Variables
    _ttg_var_errorcode_6_1_1_4_2_0 = 0LL;
    snprintf(_ttg_B, 2000, "%I64d", 0LL);
    TestReportVariableDefinition("errorcode", "float", _ttg_B);
  }
  {
    // Preparation
    _ttg_fct_preparation_6_1_1_4_3(_ttg_var_canSigTimeoutBool_6_1_1_4_1_0);
    if(_fct_DoStop(EVerdBOF_TC, 1))
    {
      return;
    }
  }
  {
    CreateCaplIFFunction("openDoorAccordingToLevel", 0);
    _ttg_I0 = 'a';
    AddIFParameterInt(_ttg_I0);
    CallInterfaceFunction("make a door open(Level A)");
    if(_fct_DoStop(EVerdBOF_TC, 1))
    {
      return;
    }
  }
  {
    CreateCaplIFFunction("setVehicleSpeed", 0);
    AddIFParameterInt(1LL);
    AddIFParameterInt(1LL);
    CallInterfaceFunction("make vehicle stop");
    if(_fct_DoStop(EVerdBOF_TC, 1))
    {
      return;
    }
  }
  TestCommandBegin("Wait", "");
  {
    _fct_Wait("1", (int64)(1LL * 1000000000LL), 1000000000, "");
  }
  // _ttg_!_6_1_1_4_8
  TestCommandEnd();
  if(_fct_DoStop(EVerdBOF_TC, 1))
  {
    return;
  }
  {
    CreateCaplIFFunction("setVehicleGearPos", 0);
    AddIFParameterInt(1LL);
    AddIFParameterInt(_ttg_var_canSigTimeoutBool_6_1_1_4_1_0);
    AddIFParameterInt(2LL);
    CallInterfaceFunction("set gear R");
    if(_fct_DoStop(EVerdBOF_TC, 1))
    {
      return;
    }
  }
  TestCommandBegin("Wait", "");
  {
    _fct_Wait("1", (int64)(1LL * 1000000000LL), 1000000000, "");
  }
  // _ttg_!_6_1_1_4_11
  TestCommandEnd();
  if(_fct_DoStop(EVerdBOF_TC, 1))
  {
    return;
  }
  TestCommandBegin("CAPL Inline", "record initial errorcode");
  {
    _ttg_fct_caplinline_6_1_1_4_14();
  }
  // _ttg_!_6_1_1_4_14
  TestCommandEnd();
  if(_fct_DoStop(EVerdBOF_TC, 1))
  {
    return;
  }
  TestCommandBegin("CANoe Standard Service", "handle lever at position D");
  {
    testStep(2, "", "Execute testValidateTesterConfirmation(\"handle lever at position D\", \"Operate lever\", 1)");
    testValidateTesterConfirmation("handle lever at position D", "Operate lever", 1LL);
  }
  // _ttg_!_6_1_1_4_15
  TestCommandEnd();
  if(_fct_DoStop(EVerdBOF_TC, 1))
  {
    return;
  }
  {
    CreateCaplIFFunction("checkWarningMessage", 0);
    AddIFParameterInt(4LL);
    AddIFParameterDWord(_ttg_var_errorcode_6_1_1_4_2_0);
    CallInterfaceFunction("check CF_Lvr_ShfErrinf -> bit4");
    if(_fct_DoStop(EVerdBOF_TC, 1))
    {
      return;
    }
  }
  TestCommandBegin("CAPL Inline", "capture CF_Lvr_ShfErrinf after detecting position D");
  {
    _ttg_fct_caplinline_6_1_1_4_17();
  }
  // _ttg_!_6_1_1_4_17
  TestCommandEnd();
  if(_fct_DoStop(EVerdBOF_TC, 1))
  {
    return;
  }
}
// _ttg_#_6_1_1_4
testcase _ttg_fct_driverSeatBeltOffAutoP_a_6_1_1_5(int64 _ttg_var_canSigTimeoutBool_6_1_1_5_1_0, int64 _ttg_var_vehicleGearPosStatus_6_1_1_5_1_1)
{
  {
    // Preparation
    _ttg_fct_preparation_6_1_1_5_2(_ttg_var_canSigTimeoutBool_6_1_1_5_1_0, _ttg_var_vehicleGearPosStatus_6_1_1_5_1_1);
    if(_fct_DoStop(EVerdBOF_TC, 1))
    {
      return;
    }
  }
  TestCommandBegin("CAPL Inline", "driver seat belt is off");
  {
    _ttg_fct_caplinline_6_1_1_5_4();
  }
  // _ttg_!_6_1_1_5_4
  TestCommandEnd();
  if(_fct_DoStop(EVerdBOF_TC, 1))
  {
    return;
  }
  {
    CreateCaplIFFunction("setVehicleSpeed", 0);
    AddIFParameterInt(1LL);
    AddIFParameterInt(1LL);
    CallInterfaceFunction("make vehicle stop");
    if(_fct_DoStop(EVerdBOF_TC, 1))
    {
      return;
    }
  }
  TestCommandBegin("Wait", "");
  {
    _fct_Wait("1", (int64)(1LL * 1000000000LL), 1000000000, "");
  }
  // _ttg_!_6_1_1_5_7
  TestCommandEnd();
  if(_fct_DoStop(EVerdBOF_TC, 1))
  {
    return;
  }
  {
    CreateCaplIFFunction("setVehicleGearPos", 0);
    AddIFParameterInt(1LL);
    AddIFParameterInt(_ttg_var_canSigTimeoutBool_6_1_1_5_1_0);
    AddIFParameterInt(_ttg_var_vehicleGearPosStatus_6_1_1_5_1_1);
    CallInterfaceFunction("set gear D or R");
    if(_fct_DoStop(EVerdBOF_TC, 1))
    {
      return;
    }
  }
  TestCommandBegin("Wait", "");
  {
    _fct_Wait("1", (int64)(1LL * 1000000000LL), 1000000000, "");
  }
  // _ttg_!_6_1_1_5_10
  TestCommandEnd();
  if(_fct_DoStop(EVerdBOF_TC, 1))
  {
    return;
  }
  {
    CreateCaplIFFunction("setBrakeStatus", 0);
    AddIFParameterInt(1LL);
    CallInterfaceFunction("set brake on");
    if(_fct_DoStop(EVerdBOF_TC, 1))
    {
      return;
    }
  }
  TestCommandBegin("Wait", "");
  {
    _fct_Wait("1", (int64)(1LL * 1000000000LL), 1000000000, "");
  }
  // _ttg_!_6_1_1_5_14
  TestCommandEnd();
  if(_fct_DoStop(EVerdBOF_TC, 1))
  {
    return;
  }
  {
    CreateCaplIFFunction("setBrakeStatus", 0);
    AddIFParameterInt(0LL);
    CallInterfaceFunction("set brake off");
    if(_fct_DoStop(EVerdBOF_TC, 1))
    {
      return;
    }
  }
  TestCommandBegin("Await Value Match", "");
  {
    dword eventTable[2];
    long ret, setfailed; setfailed = 0;
    if((int64)(103LL * 1000000LL) < 0)
    {
      testStepErrorInTestSystem(0, "1", "Invalid wait time (< 0)");
    }
    else
    {
      eventTable[0] = testJoinSignal(HKMC_LH_SBW::dbNode::LVR::LVR11::CF_Lvr_PosInf, "_ttg_callback_awaitvaluematch_6_1_1_5_16_2", "CAN signal \'CF_Lvr_PosInf\'", 0);
      setfailed |= eventTable[0] < 0;
      eventTable[1] = testJoinSignal(HKMC_LH_SBW::dbNode::LVR::LVR11::CF_Lvr_PosCpl, "_ttg_callback_awaitvaluematch_6_1_1_5_16_3", "CAN signal \'CF_Lvr_PosCpl\'", 0);
      setfailed |= eventTable[1] < 0;
      if(setfailed != 0)
      {
        testStepErrorInTestSystem(0, "1", "Unable to set value condition(s)");
      }
      ret = testWaitForAllJoinedEventsNS((int64)(103LL * 1000000LL));
      if(setfailed == 0)
      {
        if(ret > 0)
        {
          testStepPass(2, "1", "Waited for occurrence of 2 value condition(s).");
        }
        else
        {
          testStepFail(0, "1", "Waited for occurrence of 2 value condition(s).");
        }
        _fct_TiTableHeadExpectedEx("");
        _fct_ChckRep(0, HKMC_LH_SBW::dbNode::LVR::LVR11::CF_Lvr_PosInf, "CAN signal \'CF_Lvr_PosInf\'", "==", 1LL, "");
        _fct_TiCellResult(((0!=getSignalTime(HKMC_LH_SBW::dbNode::LVR::LVR11::CF_Lvr_PosInf)) && CheckSignalMatch(HKMC_LH_SBW::dbNode::LVR::LVR11::CF_Lvr_PosInf, 1LL, "=") == 1));
        _fct_ChckRep(0, HKMC_LH_SBW::dbNode::LVR::LVR11::CF_Lvr_PosCpl, "CAN signal \'CF_Lvr_PosCpl\'", "==", 14LL, "");
        _fct_TiCellResult(((0!=getSignalTime(HKMC_LH_SBW::dbNode::LVR::LVR11::CF_Lvr_PosCpl)) && CheckSignalMatch(HKMC_LH_SBW::dbNode::LVR::LVR11::CF_Lvr_PosCpl, 14LL, "=") == 1));
        _fct_TiTableEnd("", 0, 0);
      }
    }
  }
  // _ttg_!_6_1_1_5_16
  TestCommandEnd();
  if(_fct_DoStop(EVerdBOF_TC, 1))
  {
    return;
  }
  TestCommandBegin("CAPL Inline", "capture CF_Lvr_PosInf ,CF_Lvr_PosCpl after brake on to off");
  {
    _ttg_fct_caplinline_6_1_1_5_17();
  }
  // _ttg_!_6_1_1_5_17
  TestCommandEnd();
  if(_fct_DoStop(EVerdBOF_TC, 1))
  {
    return;
  }
}
// _ttg_#_6_1_1_5
testcase _ttg_fct_driverSeatBeltOffAutoP_b_6_1_1_6(int64 _ttg_var_canSigTimeoutBool_6_1_1_6_1_0, int64 _ttg_var_vehicleGearPosStatus_6_1_1_6_1_1)
{
  {
    // Variables
    _ttg_var_errorcode_6_1_1_6_2_0 = 0LL;
    snprintf(_ttg_B, 2000, "%I64d", 0LL);
    TestReportVariableDefinition("errorcode", "float", _ttg_B);
  }
  {
    // Preparation
    _ttg_fct_preparation_6_1_1_6_3(_ttg_var_canSigTimeoutBool_6_1_1_6_1_0, _ttg_var_vehicleGearPosStatus_6_1_1_6_1_1);
    if(_fct_DoStop(EVerdBOF_TC, 1))
    {
      return;
    }
  }
  TestCommandBegin("CAPL Inline", "driver seat belt is off");
  {
    _ttg_fct_caplinline_6_1_1_6_5();
  }
  // _ttg_!_6_1_1_6_5
  TestCommandEnd();
  if(_fct_DoStop(EVerdBOF_TC, 1))
  {
    return;
  }
  {
    CreateCaplIFFunction("setVehicleSpeed", 0);
    AddIFParameterInt(1LL);
    AddIFParameterInt(1LL);
    CallInterfaceFunction("make vehicle stop");
    if(_fct_DoStop(EVerdBOF_TC, 1))
    {
      return;
    }
  }
  TestCommandBegin("Wait", "");
  {
    _fct_Wait("1", (int64)(1LL * 1000000000LL), 1000000000, "");
  }
  // _ttg_!_6_1_1_6_8
  TestCommandEnd();
  if(_fct_DoStop(EVerdBOF_TC, 1))
  {
    return;
  }
  {
    CreateCaplIFFunction("setVehicleGearPos", 0);
    AddIFParameterInt(1LL);
    AddIFParameterInt(_ttg_var_canSigTimeoutBool_6_1_1_6_1_0);
    AddIFParameterInt(_ttg_var_vehicleGearPosStatus_6_1_1_6_1_1);
    CallInterfaceFunction("set gear P or N");
    if(_fct_DoStop(EVerdBOF_TC, 1))
    {
      return;
    }
  }
  TestCommandBegin("Wait", "");
  {
    _fct_Wait("1", (int64)(1LL * 1000000000LL), 1000000000, "");
  }
  // _ttg_!_6_1_1_6_12
  TestCommandEnd();
  if(_fct_DoStop(EVerdBOF_TC, 1))
  {
    return;
  }
  TestCommandBegin("CAPL Inline", "record initial errorcode");
  {
    _ttg_fct_caplinline_6_1_1_6_14();
  }
  // _ttg_!_6_1_1_6_14
  TestCommandEnd();
  if(_fct_DoStop(EVerdBOF_TC, 1))
  {
    return;
  }
  TestCommandBegin("CANoe Standard Service", "handle lever at position D or R (click ok first then operate lever)");
  {
    testStep(2, "", "Execute testValidateTesterConfirmation(\"handle lever at position D or R (click ok first then operate lever)\", \"Operate lever\", 1)");
    testValidateTesterConfirmation("handle lever at position D or R (click ok first then operate lever)", "Operate lever", 1LL);
  }
  // _ttg_!_6_1_1_6_15
  TestCommandEnd();
  if(_fct_DoStop(EVerdBOF_TC, 1))
  {
    return;
  }
  {
    CreateCaplIFFunction("checkWarningMessage", 0);
    AddIFParameterInt(5LL);
    AddIFParameterDWord(_ttg_var_errorcode_6_1_1_6_2_0);
    CallInterfaceFunction("check CF_Lvr_ShfErrinf -> bit5");
    if(_fct_DoStop(EVerdBOF_TC, 1))
    {
      return;
    }
  }
  TestCommandBegin("CAPL Inline", "capture CF_Lvr_ShfErrinf after detecting position D or R");
  {
    _ttg_fct_caplinline_6_1_1_6_17();
  }
  // _ttg_!_6_1_1_6_17
  TestCommandEnd();
  if(_fct_DoStop(EVerdBOF_TC, 1))
  {
    return;
  }
}
// _ttg_#_6_1_1_6
testcase _ttg_fct_driverSeatBeltOffAutoP_c_6_1_1_7(int64 _ttg_var_canSigTimeoutBool_6_1_1_7_1_0, int64 _ttg_var_vehicleGearPosStatus_6_1_1_7_1_1)
{
  {
    // Preparation
    _ttg_fct_preparation_6_1_1_7_2(_ttg_var_canSigTimeoutBool_6_1_1_7_1_0, _ttg_var_vehicleGearPosStatus_6_1_1_7_1_1);
    if(_fct_DoStop(EVerdBOF_TC, 1))
    {
      return;
    }
  }
  TestCommandBegin("CAPL Inline", "driver seat belt is off");
  {
    _ttg_fct_caplinline_6_1_1_7_4();
  }
  // _ttg_!_6_1_1_7_4
  TestCommandEnd();
  if(_fct_DoStop(EVerdBOF_TC, 1))
  {
    return;
  }
  {
    CreateCaplIFFunction("setVehicleSpeed", 0);
    AddIFParameterInt(1LL);
    AddIFParameterInt(1LL);
    CallInterfaceFunction("make vehicle stop");
    if(_fct_DoStop(EVerdBOF_TC, 1))
    {
      return;
    }
  }
  TestCommandBegin("Wait", "");
  {
    _fct_Wait("1", (int64)(1LL * 1000000000LL), 1000000000, "");
  }
  // _ttg_!_6_1_1_7_8
  TestCommandEnd();
  if(_fct_DoStop(EVerdBOF_TC, 1))
  {
    return;
  }
  {
    CreateCaplIFFunction("setVehicleGearPos", 0);
    AddIFParameterInt(1LL);
    AddIFParameterInt(_ttg_var_canSigTimeoutBool_6_1_1_7_1_0);
    AddIFParameterInt(_ttg_var_vehicleGearPosStatus_6_1_1_7_1_1);
    CallInterfaceFunction("set gear D or R");
    if(_fct_DoStop(EVerdBOF_TC, 1))
    {
      return;
    }
  }
  TestCommandBegin("Wait", "");
  {
    _fct_Wait("1", (int64)(1LL * 1000000000LL), 1000000000, "");
  }
  // _ttg_!_6_1_1_7_11
  TestCommandEnd();
  if(_fct_DoStop(EVerdBOF_TC, 1))
  {
    return;
  }
  {
    CreateCaplIFFunction("parkSwitchPress", 0);
    AddIFParameterInt(1LL);
    AddIFParameterChar("12.7.1.2.c make a valid P press.png");
    CallInterfaceFunction("make a valid P press");
    if(_fct_DoStop(EVerdBOF_TC, 1))
    {
      return;
    }
  }
  TestCommandBegin("Wait", "");
  {
    _fct_Wait("1", (int64)(1LL * 1000000000LL), 1000000000, "");
  }
  // _ttg_!_6_1_1_7_15
  TestCommandEnd();
  if(_fct_DoStop(EVerdBOF_TC, 1))
  {
    return;
  }
  TestCommandBegin("CANoe Standard Service", "handle lever at position Nr");
  {
    testStep(2, "", "Execute testValidateTesterConfirmation(\"handle lever at position Nr\", \"Operate lever\", 1)");
    testValidateTesterConfirmation("handle lever at position Nr", "Operate lever", 1LL);
  }
  // _ttg_!_6_1_1_7_17
  TestCommandEnd();
  if(_fct_DoStop(EVerdBOF_TC, 1))
  {
    return;
  }
  {
    CreateCaplIFFunction("checkLeverPositionSendToTcu", 0);
    AddIFParameterInt(3LL);
    CallInterfaceFunction("checkLeverPositionSendToTcu (vehicleGearPosStatus=3)");
    if(_fct_DoStop(EVerdBOF_TC, 1))
    {
      return;
    }
  }
  TestCommandBegin("Wait", "");
  {
    _fct_Wait("1", (int64)(1LL * 1000000000LL), 1000000000, "");
  }
  // _ttg_!_6_1_1_7_19
  TestCommandEnd();
  if(_fct_DoStop(EVerdBOF_TC, 1))
  {
    return;
  }
  TestCommandBegin("CANoe Standard Service", "handle lever at position Nd");
  {
    testStep(2, "", "Execute testValidateTesterConfirmation(\"handle lever at position Nd\", \"Operate lever\", 1)");
    testValidateTesterConfirmation("handle lever at position Nd", "Operate lever", 1LL);
  }
  // _ttg_!_6_1_1_7_21
  TestCommandEnd();
  if(_fct_DoStop(EVerdBOF_TC, 1))
  {
    return;
  }
  {
    CreateCaplIFFunction("checkLeverPositionSendToTcu", 0);
    AddIFParameterInt(4LL);
    CallInterfaceFunction("checkLeverPositionSendToTcu (vehicleGearPosStatus=4)");
    if(_fct_DoStop(EVerdBOF_TC, 1))
    {
      return;
    }
  }
}
// _ttg_#_6_1_1_7
testcase _ttg_fct_driverSeatBeltOffAutoP_d_6_1_1_8(int64 _ttg_var_canSigTimeoutBool_6_1_1_8_1_0)
{
  {
    // Variables
    _ttg_var_errorcode_6_1_1_8_2_0 = 0LL;
    snprintf(_ttg_B, 2000, "%I64d", 0LL);
    TestReportVariableDefinition("errorcode", "float", _ttg_B);
  }
  {
    // Preparation
    _ttg_fct_preparation_6_1_1_8_3(_ttg_var_canSigTimeoutBool_6_1_1_8_1_0);
    if(_fct_DoStop(EVerdBOF_TC, 1))
    {
      return;
    }
  }
  TestCommandBegin("CAPL Inline", "driver seat belt is off");
  {
    _ttg_fct_caplinline_6_1_1_8_5();
  }
  // _ttg_!_6_1_1_8_5
  TestCommandEnd();
  if(_fct_DoStop(EVerdBOF_TC, 1))
  {
    return;
  }
  {
    CreateCaplIFFunction("setVehicleSpeed", 0);
    AddIFParameterInt(1LL);
    AddIFParameterInt(1LL);
    CallInterfaceFunction("make vehicle stop");
    if(_fct_DoStop(EVerdBOF_TC, 1))
    {
      return;
    }
  }
  TestCommandBegin("Wait", "");
  {
    _fct_Wait("1", (int64)(1LL * 1000000000LL), 1000000000, "");
  }
  // _ttg_!_6_1_1_8_9
  TestCommandEnd();
  if(_fct_DoStop(EVerdBOF_TC, 1))
  {
    return;
  }
  {
    CreateCaplIFFunction("setVehicleGearPos", 0);
    AddIFParameterInt(1LL);
    AddIFParameterInt(_ttg_var_canSigTimeoutBool_6_1_1_8_1_0);
    AddIFParameterInt(4LL);
    CallInterfaceFunction("set gear D");
    if(_fct_DoStop(EVerdBOF_TC, 1))
    {
      return;
    }
  }
  TestCommandBegin("CAPL Inline", "record initial errorcode");
  {
    _ttg_fct_caplinline_6_1_1_8_14();
  }
  // _ttg_!_6_1_1_8_14
  TestCommandEnd();
  if(_fct_DoStop(EVerdBOF_TC, 1))
  {
    return;
  }
  TestCommandBegin("CANoe Standard Service", "handle lever at position R");
  {
    testStep(2, "", "Execute testValidateTesterConfirmation(\"handle lever at position R\", \"Operate lever\", 1)");
    testValidateTesterConfirmation("handle lever at position R", "Operate lever", 1LL);
  }
  // _ttg_!_6_1_1_8_15
  TestCommandEnd();
  if(_fct_DoStop(EVerdBOF_TC, 1))
  {
    return;
  }
  {
    CreateCaplIFFunction("checkWarningMessage", 0);
    AddIFParameterInt(5LL);
    AddIFParameterDWord(_ttg_var_errorcode_6_1_1_8_2_0);
    CallInterfaceFunction("check CF_Lvr_ShfErrinf -> bit5");
    if(_fct_DoStop(EVerdBOF_TC, 1))
    {
      return;
    }
  }
  TestCommandBegin("CAPL Inline", "capture CF_Lvr_ShfErrinf after detecting position R");
  {
    _ttg_fct_caplinline_6_1_1_8_17();
  }
  // _ttg_!_6_1_1_8_17
  TestCommandEnd();
  if(_fct_DoStop(EVerdBOF_TC, 1))
  {
    return;
  }
}
// _ttg_#_6_1_1_8
testcase _ttg_fct_driverSeatBeltOffAutoP_e_6_1_1_9(int64 _ttg_var_canSigTimeoutBool_6_1_1_9_1_0)
{
  {
    // Variables
    _ttg_var_errorcode_6_1_1_9_2_0 = 0LL;
    snprintf(_ttg_B, 2000, "%I64d", 0LL);
    TestReportVariableDefinition("errorcode", "float", _ttg_B);
  }
  {
    // Preparation
    _ttg_fct_preparation_6_1_1_9_3(_ttg_var_canSigTimeoutBool_6_1_1_9_1_0);
    if(_fct_DoStop(EVerdBOF_TC, 1))
    {
      return;
    }
  }
  TestCommandBegin("CAPL Inline", "driver seat belt is off");
  {
    _ttg_fct_caplinline_6_1_1_9_5();
  }
  // _ttg_!_6_1_1_9_5
  TestCommandEnd();
  if(_fct_DoStop(EVerdBOF_TC, 1))
  {
    return;
  }
  {
    CreateCaplIFFunction("setVehicleSpeed", 0);
    AddIFParameterInt(1LL);
    AddIFParameterInt(1LL);
    CallInterfaceFunction("make vehicle stop");
    if(_fct_DoStop(EVerdBOF_TC, 1))
    {
      return;
    }
  }
  TestCommandBegin("Wait", "");
  {
    _fct_Wait("1", (int64)(1LL * 1000000000LL), 1000000000, "");
  }
  // _ttg_!_6_1_1_9_8
  TestCommandEnd();
  if(_fct_DoStop(EVerdBOF_TC, 1))
  {
    return;
  }
  {
    CreateCaplIFFunction("setVehicleGearPos", 0);
    AddIFParameterInt(1LL);
    AddIFParameterInt(_ttg_var_canSigTimeoutBool_6_1_1_9_1_0);
    AddIFParameterInt(2LL);
    CallInterfaceFunction("set gear R");
    if(_fct_DoStop(EVerdBOF_TC, 1))
    {
      return;
    }
  }
  TestCommandBegin("Wait", "");
  {
    _fct_Wait("1", (int64)(1LL * 1000000000LL), 1000000000, "");
  }
  // _ttg_!_6_1_1_9_11
  TestCommandEnd();
  if(_fct_DoStop(EVerdBOF_TC, 1))
  {
    return;
  }
  TestCommandBegin("CAPL Inline", "record initial errorcode");
  {
    _ttg_fct_caplinline_6_1_1_9_14();
  }
  // _ttg_!_6_1_1_9_14
  TestCommandEnd();
  if(_fct_DoStop(EVerdBOF_TC, 1))
  {
    return;
  }
  TestCommandBegin("CANoe Standard Service", "handle lever at position D");
  {
    testStep(2, "", "Execute testValidateTesterConfirmation(\"handle lever at position D\", \"Operate lever\", 1)");
    testValidateTesterConfirmation("handle lever at position D", "Operate lever", 1LL);
  }
  // _ttg_!_6_1_1_9_15
  TestCommandEnd();
  if(_fct_DoStop(EVerdBOF_TC, 1))
  {
    return;
  }
  {
    CreateCaplIFFunction("checkWarningMessage", 0);
    AddIFParameterInt(5LL);
    AddIFParameterDWord(_ttg_var_errorcode_6_1_1_9_2_0);
    CallInterfaceFunction("check CF_Lvr_ShfErrinf -> bit5");
    if(_fct_DoStop(EVerdBOF_TC, 1))
    {
      return;
    }
  }
  TestCommandBegin("CAPL Inline", "capture CF_Lvr_ShfErrinf after detecting position D");
  {
    _ttg_fct_caplinline_6_1_1_9_17();
  }
  // _ttg_!_6_1_1_9_17
  TestCommandEnd();
  if(_fct_DoStop(EVerdBOF_TC, 1))
  {
    return;
  }
}
// _ttg_#_6_1_1_9
testcase _ttg_fct_setAutoNMode_6_1_1_10(int64 _ttg_var_canSigTimeoutBool_6_1_1_10_1_0)
{
  {
    CreateCaplIFFunction("setAutoNModeWhenIGNOn", 0);
    AddIFParameterInt(_ttg_var_canSigTimeoutBool_6_1_1_10_1_0);
    CallInterfaceFunction("setAutoNModeWhenIGNOn (canSigTimeoutBool=canSigTimeoutBool)");
    if(_fct_DoStop(EVerdBOF_TC, 1))
    {
      return;
    }
  }
  TestCommandBegin("Wait", "");
  {
    _fct_Wait("1", (int64)(3LL * 1000000000LL), 1000000000, "");
  }
  // _ttg_!_6_1_1_10_3
  TestCommandEnd();
  if(_fct_DoStop(EVerdBOF_TC, 1))
  {
    return;
  }
  {
    CreateCaplIFFunction("setIgnStatus", 0);
    AddIFParameterInt(1LL);
    CallInterfaceFunction("IGN ON");
    if(_fct_DoStop(EVerdBOF_TC, 1))
    {
      return;
    }
  }
}
// _ttg_#_6_1_1_10
testcase _ttg_fct_testAutoNModeAfterModeSet_6_1_1_11(int64 _ttg_var_canSigTimeoutBool_6_1_1_11_1_0)
{
  {
    // Preparation
    _ttg_fct_preparation_6_1_1_11_2(_ttg_var_canSigTimeoutBool_6_1_1_11_1_0);
    if(_fct_DoStop(EVerdBOF_TC, 1))
    {
      return;
    }
  }
  {
    CreateCaplIFFunction("setAutoNModeTestConditionAfterModeActived", 0);
    AddIFParameterInt(_ttg_var_canSigTimeoutBool_6_1_1_11_1_0);
    CallInterfaceFunction("setAutoNModeTestConditionAfterModeActived (canSigTimeoutBool=canSigTimeoutBool)");
    if(_fct_DoStop(EVerdBOF_TC, 1))
    {
      return;
    }
  }
  TestCommandBegin("CAPL Inline", "check auto N function");
  {
    _ttg_fct_caplinline_6_1_1_11_4();
  }
  // _ttg_!_6_1_1_11_4
  TestCommandEnd();
  if(_fct_DoStop(EVerdBOF_TC, 1))
  {
    return;
  }
  TestCommandBegin("Wait", "Keep brake on for 3s, then go to make brake off.");
  {
    _fct_Wait("1", (int64)(3LL * 1000000000LL), 1000000000, "");
  }
  // _ttg_!_6_1_1_11_5
  TestCommandEnd();
  if(_fct_DoStop(EVerdBOF_TC, 1))
  {
    return;
  }
  {
    CreateCaplIFFunction("setBrakeStatus", 0);
    AddIFParameterInt(0LL);
    CallInterfaceFunction("set brake off");
    if(_fct_DoStop(EVerdBOF_TC, 1))
    {
      return;
    }
  }
  TestCommandBegin("CAPL Inline", "check if CF_Lvr_PosInf = D after auto N & brake off");
  {
    _ttg_fct_caplinline_6_1_1_11_7();
  }
  // _ttg_!_6_1_1_11_7
  TestCommandEnd();
  if(_fct_DoStop(EVerdBOF_TC, 1))
  {
    return;
  }
}
// _ttg_#_6_1_1_11
testcase _ttg_fct_testAutoNModeInactiveAfterModeReset_6_1_1_12(int64 _ttg_var_canSigTimeoutBool_6_1_1_12_1_0)
{
  {
    CreateCaplIFFunction("setAutoNModeTestConditionAfterModeActived", 0);
    AddIFParameterInt(_ttg_var_canSigTimeoutBool_6_1_1_12_1_0);
    CallInterfaceFunction("setAutoNModeTestConditionAfterModeActived (canSigTimeoutBool=canSigTimeoutBool)");
    if(_fct_DoStop(EVerdBOF_TC, 1))
    {
      return;
    }
  }
  TestCommandBegin("CAPL Inline", "Judge if auto N mode has been cleared.");
  {
    _ttg_fct_caplinline_6_1_1_12_3();
  }
  // _ttg_!_6_1_1_12_3
  TestCommandEnd();
  if(_fct_DoStop(EVerdBOF_TC, 1))
  {
    return;
  }
  TestCommandBegin("Wait", "Keep brake on for 3s, then go to make brake off.");
  {
    _fct_Wait("1", (int64)(3LL * 1000000000LL), 1000000000, "");
  }
  // _ttg_!_6_1_1_12_4
  TestCommandEnd();
  if(_fct_DoStop(EVerdBOF_TC, 1))
  {
    return;
  }
  {
    CreateCaplIFFunction("setBrakeStatus", 0);
    AddIFParameterInt(0LL);
    CallInterfaceFunction("brake off");
    if(_fct_DoStop(EVerdBOF_TC, 1))
    {
      return;
    }
  }
  TestCommandBegin("CAPL Inline", "Judge if any signal change happen after brake off.");
  {
    _ttg_fct_caplinline_6_1_1_12_6();
  }
  // _ttg_!_6_1_1_12_6
  TestCommandEnd();
  if(_fct_DoStop(EVerdBOF_TC, 1))
  {
    return;
  }
}
// _ttg_#_6_1_1_12
testcase _ttg_fct_iGOnMode_a_6_1_1_13(int64 _ttg_var_canSigTimeoutBool_6_1_1_13_1_0, int64 _ttg_var_vehicleGearPosStatus_6_1_1_13_1_1)
{
  {
    // Preparation
    _ttg_fct_preparation_6_1_1_13_2(_ttg_var_canSigTimeoutBool_6_1_1_13_1_0, _ttg_var_vehicleGearPosStatus_6_1_1_13_1_1);
    if(_fct_DoStop(EVerdBOF_TC, 1))
    {
      _ttg_fct_completion_6_1_1_13_6(_ttg_var_canSigTimeoutBool_6_1_1_13_1_0, _ttg_var_vehicleGearPosStatus_6_1_1_13_1_1);
      return;
    }
  }
  {
    CreateCaplIFFunction("setVehicleGearPos", 0);
    AddIFParameterInt(1LL);
    AddIFParameterInt(_ttg_var_canSigTimeoutBool_6_1_1_13_1_0);
    AddIFParameterInt(_ttg_var_vehicleGearPosStatus_6_1_1_13_1_1);
    CallInterfaceFunction("set vehicleGearPosStatus = not N");
    if(_fct_DoStop(EVerdBOF_TC, 1))
    {
      _ttg_fct_completion_6_1_1_13_6(_ttg_var_canSigTimeoutBool_6_1_1_13_1_0, _ttg_var_vehicleGearPosStatus_6_1_1_13_1_1);
      return;
    }
  }
  TestCommandBegin("Await Value Match", "check if SBW operate PRA to P Position");
  {
    dword eventTable[2];
    long ret, setfailed; setfailed = 0;
    if((int64)(5LL * 1000000000LL) < 0)
    {
      testStepErrorInTestSystem(0, "1", "Invalid wait time (< 0)");
    }
    else
    {
      eventTable[0] = testJoinSignal(HKMC_LH_SBW::dbNode::LVR::LVR11::CF_Lvr_PNStat, "_ttg_callback_awaitvaluematch_6_1_1_13_4_3", "CAN signal \'CF_Lvr_PNStat\'", 0);
      setfailed |= eventTable[0] < 0;
      eventTable[1] = testJoinSignal(HKMC_LH_SBW::dbNode::LVR::LVR11::CF_Lvr_PRelStat, "_ttg_callback_awaitvaluematch_6_1_1_13_4_4", "CAN signal \'CF_Lvr_PRelStat\'", 0);
      setfailed |= eventTable[1] < 0;
      if(setfailed != 0)
      {
        testStepErrorInTestSystem(0, "1", "Unable to set value condition(s)");
      }
      ret = testWaitForAllJoinedEventsNS((int64)(5LL * 1000000000LL));
      if(setfailed == 0)
      {
        if(ret > 0)
        {
          testStepPass(2, "1", "Waited for occurrence of 2 value condition(s).");
        }
        else
        {
          testStepFail(0, "1", "Waited for occurrence of 2 value condition(s).");
        }
        _fct_TiTableHeadExpectedEx("");
        _fct_ChckRep(0, HKMC_LH_SBW::dbNode::LVR::LVR11::CF_Lvr_PNStat, "CAN signal \'CF_Lvr_PNStat\'", "==", 1LL, "Park Status");
        _fct_TiCellResult(((0!=getSignalTime(HKMC_LH_SBW::dbNode::LVR::LVR11::CF_Lvr_PNStat)) && CheckSignalMatch(HKMC_LH_SBW::dbNode::LVR::LVR11::CF_Lvr_PNStat, 1LL, "=") == 1));
        _fct_ChckRep(0, HKMC_LH_SBW::dbNode::LVR::LVR11::CF_Lvr_PRelStat, "CAN signal \'CF_Lvr_PRelStat\'", "==", 0LL, "Parking not released");
        _fct_TiCellResult(((0!=getSignalTime(HKMC_LH_SBW::dbNode::LVR::LVR11::CF_Lvr_PRelStat)) && CheckSignalMatch(HKMC_LH_SBW::dbNode::LVR::LVR11::CF_Lvr_PRelStat, 0LL, "=") == 1));
        _fct_TiTableEnd("", 0, 0);
      }
    }
  }
  // _ttg_!_6_1_1_13_4
  TestCommandEnd();
  if(_fct_DoStop(EVerdBOF_TC, 1))
  {
    _ttg_fct_completion_6_1_1_13_6(_ttg_var_canSigTimeoutBool_6_1_1_13_1_0, _ttg_var_vehicleGearPosStatus_6_1_1_13_1_1);
    return;
  }
  TestCommandBegin("CAPL Inline", "capture CF_Lvr_PNStat&CF_Lvr_PRelStat");
  {
    _ttg_fct_caplinline_6_1_1_13_5();
  }
  // _ttg_!_6_1_1_13_5
  TestCommandEnd();
  if(_fct_DoStop(EVerdBOF_TC, 1))
  {
    _ttg_fct_completion_6_1_1_13_6(_ttg_var_canSigTimeoutBool_6_1_1_13_1_0, _ttg_var_vehicleGearPosStatus_6_1_1_13_1_1);
    return;
  }
  {
    // Completion
    _ttg_fct_completion_6_1_1_13_6(_ttg_var_canSigTimeoutBool_6_1_1_13_1_0, _ttg_var_vehicleGearPosStatus_6_1_1_13_1_1);
  }
}
// _ttg_#_6_1_1_13
testcase _ttg_fct_recoveryTcuOffAtVehicleDriving_6_1_1_14(int64 _ttg_var_G_SEL_DISP_value_of_D_6_1_1_14_1_0)
{
  {
    // Preparation
    _ttg_fct_preparation_6_1_1_14_2(_ttg_var_G_SEL_DISP_value_of_D_6_1_1_14_1_0);
    if(_fct_DoStop(EVerdBOF_TC, 1))
    {
      return;
    }
  }
  TestCommandBegin("CAPL Inline", "set last gear as D");
  {
    _ttg_fct_caplinline_6_1_1_14_5(_ttg_var_G_SEL_DISP_value_of_D_6_1_1_14_1_0);
  }
  // _ttg_!_6_1_1_14_5
  TestCommandEnd();
  if(_fct_DoStop(EVerdBOF_TC, 1))
  {
    return;
  }
  TestCommandBegin("CAPL Inline", "set signal G_SEL_DISP time out");
  {
    _ttg_fct_caplinline_6_1_1_14_6();
  }
  // _ttg_!_6_1_1_14_6
  TestCommandEnd();
  if(_fct_DoStop(EVerdBOF_TC, 1))
  {
    return;
  }
  TestCommandBegin("Wait", "");
  {
    _fct_Wait("1", (int64)(1LL * 1000000000LL), 1000000000, "");
  }
  // _ttg_!_6_1_1_14_7
  TestCommandEnd();
  if(_fct_DoStop(EVerdBOF_TC, 1))
  {
    return;
  }
  {
    CreateCaplIFFunction("setVehicleSpeed", 0);
    AddIFParameterInt(1LL);
    AddIFParameterInt(0LL);
    CallInterfaceFunction("make vehicle drive");
    if(_fct_DoStop(EVerdBOF_TC, 1))
    {
      return;
    }
  }
  TestCommandBegin("Wait", "");
  {
    _fct_Wait("1", (int64)(1LL * 1000000000LL), 1000000000, "");
  }
  // _ttg_!_6_1_1_14_11
  TestCommandEnd();
  if(_fct_DoStop(EVerdBOF_TC, 1))
  {
    return;
  }
  TestCommandBegin("CAPL Inline", "make TCU recover");
  {
    _ttg_fct_caplinline_6_1_1_14_12();
  }
  // _ttg_!_6_1_1_14_12
  TestCommandEnd();
  if(_fct_DoStop(EVerdBOF_TC, 1))
  {
    return;
  }
  TestCommandBegin("Await Value Match", "check if SBW operate PRA to not P Position");
  {
    dword eventTable[2];
    long ret, setfailed; setfailed = 0;
    if((int64)(5LL * 1000000000LL) < 0)
    {
      testStepErrorInTestSystem(0, "1", "Invalid wait time (< 0)");
    }
    else
    {
      eventTable[0] = testJoinSignal(HKMC_LH_SBW::dbNode::LVR::LVR11::CF_Lvr_PNStat, "_ttg_callback_awaitvaluematch_6_1_1_14_13_3", "CAN signal \'CF_Lvr_PNStat\'", 0);
      setfailed |= eventTable[0] < 0;
      eventTable[1] = testJoinSignal(HKMC_LH_SBW::dbNode::LVR::LVR11::CF_Lvr_PRelStat, "_ttg_callback_awaitvaluematch_6_1_1_14_13_4", "CAN signal \'CF_Lvr_PRelStat\'", 0);
      setfailed |= eventTable[1] < 0;
      if(setfailed != 0)
      {
        testStepErrorInTestSystem(0, "1", "Unable to set value condition(s)");
      }
      ret = testWaitForAllJoinedEventsNS((int64)(5LL * 1000000000LL));
      if(setfailed == 0)
      {
        if(ret > 0)
        {
          testStepPass(2, "1", "Waited for occurrence of 2 value condition(s).");
        }
        else
        {
          testStepFail(0, "1", "Waited for occurrence of 2 value condition(s).");
        }
        _fct_TiTableHeadExpectedEx("");
        _fct_ChckRep(0, HKMC_LH_SBW::dbNode::LVR::LVR11::CF_Lvr_PNStat, "CAN signal \'CF_Lvr_PNStat\'", "==", 2LL, "Not Park Status");
        _fct_TiCellResult(((0!=getSignalTime(HKMC_LH_SBW::dbNode::LVR::LVR11::CF_Lvr_PNStat)) && CheckSignalMatch(HKMC_LH_SBW::dbNode::LVR::LVR11::CF_Lvr_PNStat, 2LL, "=") == 1));
        _fct_ChckRep(0, HKMC_LH_SBW::dbNode::LVR::LVR11::CF_Lvr_PRelStat, "CAN signal \'CF_Lvr_PRelStat\'", "==", 1LL, "Parking released");
        _fct_TiCellResult(((0!=getSignalTime(HKMC_LH_SBW::dbNode::LVR::LVR11::CF_Lvr_PRelStat)) && CheckSignalMatch(HKMC_LH_SBW::dbNode::LVR::LVR11::CF_Lvr_PRelStat, 1LL, "=") == 1));
        _fct_TiTableEnd("", 0, 0);
      }
    }
  }
  // _ttg_!_6_1_1_14_13
  TestCommandEnd();
  if(_fct_DoStop(EVerdBOF_TC, 1))
  {
    return;
  }
  TestCommandBegin("CAPL Inline", "capture CF_Lvr_PNStat&CF_Lvr_PRelStat");
  {
    _ttg_fct_caplinline_6_1_1_14_14();
  }
  // _ttg_!_6_1_1_14_14
  TestCommandEnd();
  if(_fct_DoStop(EVerdBOF_TC, 1))
  {
    return;
  }
}
// _ttg_#_6_1_1_14
testcase _ttg_fct_recoveryTcuOffAtVehicleStop_6_1_1_15(int64 _ttg_var_G_SEL_DISP_value_of_D_6_1_1_15_1_0)
{
  {
    // Preparation
    _ttg_fct_preparation_6_1_1_15_2(_ttg_var_G_SEL_DISP_value_of_D_6_1_1_15_1_0);
    if(_fct_DoStop(EVerdBOF_TC, 1))
    {
      return;
    }
  }
  TestCommandBegin("CAPL Inline", "set last gear as D through G_SEL_DISP");
  {
    _ttg_fct_caplinline_6_1_1_15_4(_ttg_var_G_SEL_DISP_value_of_D_6_1_1_15_1_0);
  }
  // _ttg_!_6_1_1_15_4
  TestCommandEnd();
  if(_fct_DoStop(EVerdBOF_TC, 1))
  {
    return;
  }
  TestCommandBegin("CAPL Inline", "set signal G_SEL_DISP time out");
  {
    _ttg_fct_caplinline_6_1_1_15_6();
  }
  // _ttg_!_6_1_1_15_6
  TestCommandEnd();
  if(_fct_DoStop(EVerdBOF_TC, 1))
  {
    return;
  }
  TestCommandBegin("Wait", "");
  {
    _fct_Wait("1", (int64)(1LL * 1000000000LL), 1000000000, "");
  }
  // _ttg_!_6_1_1_15_7
  TestCommandEnd();
  if(_fct_DoStop(EVerdBOF_TC, 1))
  {
    return;
  }
  {
    CreateCaplIFFunction("setVehicleSpeed", 0);
    AddIFParameterInt(1LL);
    AddIFParameterInt(1LL);
    CallInterfaceFunction("make vehicle stop");
    if(_fct_DoStop(EVerdBOF_TC, 1))
    {
      return;
    }
  }
  TestCommandBegin("Wait", "");
  {
    _fct_Wait("1", (int64)(1LL * 1000000000LL), 1000000000, "");
  }
  // _ttg_!_6_1_1_15_10
  TestCommandEnd();
  if(_fct_DoStop(EVerdBOF_TC, 1))
  {
    return;
  }
  TestCommandBegin("CAPL Inline", "make TCU recover");
  {
    _ttg_fct_caplinline_6_1_1_15_11();
  }
  // _ttg_!_6_1_1_15_11
  TestCommandEnd();
  if(_fct_DoStop(EVerdBOF_TC, 1))
  {
    return;
  }
  TestCommandBegin("Await Value Match", "check if SBW operate PRA to P position");
  {
    dword eventTable[2];
    long ret, setfailed; setfailed = 0;
    if((int64)(5LL * 1000000000LL) < 0)
    {
      testStepErrorInTestSystem(0, "1", "Invalid wait time (< 0)");
    }
    else
    {
      eventTable[0] = testJoinSignal(HKMC_LH_SBW::dbNode::LVR::LVR11::CF_Lvr_PNStat, "_ttg_callback_awaitvaluematch_6_1_1_15_12_3", "CAN signal \'CF_Lvr_PNStat\'", 0);
      setfailed |= eventTable[0] < 0;
      eventTable[1] = testJoinSignal(HKMC_LH_SBW::dbNode::LVR::LVR11::CF_Lvr_PRelStat, "_ttg_callback_awaitvaluematch_6_1_1_15_12_4", "CAN signal \'CF_Lvr_PRelStat\'", 0);
      setfailed |= eventTable[1] < 0;
      if(setfailed != 0)
      {
        testStepErrorInTestSystem(0, "1", "Unable to set value condition(s)");
      }
      ret = testWaitForAllJoinedEventsNS((int64)(5LL * 1000000000LL));
      if(setfailed == 0)
      {
        if(ret > 0)
        {
          testStepPass(2, "1", "Waited for occurrence of 2 value condition(s).");
        }
        else
        {
          testStepFail(0, "1", "Waited for occurrence of 2 value condition(s).");
        }
        _fct_TiTableHeadExpectedEx("");
        _fct_ChckRep(0, HKMC_LH_SBW::dbNode::LVR::LVR11::CF_Lvr_PNStat, "CAN signal \'CF_Lvr_PNStat\'", "==", 1LL, "Park Status");
        _fct_TiCellResult(((0!=getSignalTime(HKMC_LH_SBW::dbNode::LVR::LVR11::CF_Lvr_PNStat)) && CheckSignalMatch(HKMC_LH_SBW::dbNode::LVR::LVR11::CF_Lvr_PNStat, 1LL, "=") == 1));
        _fct_ChckRep(0, HKMC_LH_SBW::dbNode::LVR::LVR11::CF_Lvr_PRelStat, "CAN signal \'CF_Lvr_PRelStat\'", "==", 0LL, "Parking not released");
        _fct_TiCellResult(((0!=getSignalTime(HKMC_LH_SBW::dbNode::LVR::LVR11::CF_Lvr_PRelStat)) && CheckSignalMatch(HKMC_LH_SBW::dbNode::LVR::LVR11::CF_Lvr_PRelStat, 0LL, "=") == 1));
        _fct_TiTableEnd("", 0, 0);
      }
    }
  }
  // _ttg_!_6_1_1_15_12
  TestCommandEnd();
  if(_fct_DoStop(EVerdBOF_TC, 1))
  {
    return;
  }
  TestCommandBegin("CAPL Inline", "capture CF_Lvr_PNStat&CF_Lvr_PRelStat");
  {
    _ttg_fct_caplinline_6_1_1_15_13();
  }
  // _ttg_!_6_1_1_15_13
  TestCommandEnd();
  if(_fct_DoStop(EVerdBOF_TC, 1))
  {
    return;
  }
}
// _ttg_#_6_1_1_15
testcase _ttg_fct_testPRAUnderTcuOffwithLastGearD_6_1_1_16(int64 _ttg_var_G_SEL_DISP_value_of_D_6_1_1_16_1_0)
{
  {
    // Preparation
    _ttg_fct_preparation_6_1_1_16_2(_ttg_var_G_SEL_DISP_value_of_D_6_1_1_16_1_0);
    if(_fct_DoStop(EVerdBOF_TC, 1))
    {
      _ttg_fct_completion_6_1_1_16_11(_ttg_var_G_SEL_DISP_value_of_D_6_1_1_16_1_0);
      return;
    }
  }
  TestCommandBegin("CAPL Inline", "set last gear as D");
  {
    _ttg_fct_caplinline_6_1_1_16_3(_ttg_var_G_SEL_DISP_value_of_D_6_1_1_16_1_0);
  }
  // _ttg_!_6_1_1_16_3
  TestCommandEnd();
  if(_fct_DoStop(EVerdBOF_TC, 1))
  {
    _ttg_fct_completion_6_1_1_16_11(_ttg_var_G_SEL_DISP_value_of_D_6_1_1_16_1_0);
    return;
  }
  TestCommandBegin("Wait", "");
  {
    _fct_Wait("1", (int64)(1LL * 1000000000LL), 1000000000, "");
  }
  // _ttg_!_6_1_1_16_4
  TestCommandEnd();
  if(_fct_DoStop(EVerdBOF_TC, 1))
  {
    _ttg_fct_completion_6_1_1_16_11(_ttg_var_G_SEL_DISP_value_of_D_6_1_1_16_1_0);
    return;
  }
  {
    CreateCaplIFFunction("SBWControlPRAByIGONTCURequest", 0);
    AddIFParameterInt(1LL);
    CallInterfaceFunction("Set PRA to P position at initial");
    if(_fct_DoStop(EVerdBOF_TC, 1))
    {
      _ttg_fct_completion_6_1_1_16_11(_ttg_var_G_SEL_DISP_value_of_D_6_1_1_16_1_0);
      return;
    }
  }
  TestCommandBegin("Await Value Match", "check if SBW operate PRA to P Position");
  {
    dword eventTable[2];
    long ret, setfailed; setfailed = 0;
    if((int64)(5LL * 1000000000LL) < 0)
    {
      testStepErrorInTestSystem(0, "1", "Invalid wait time (< 0)");
    }
    else
    {
      eventTable[0] = testJoinSignal(HKMC_LH_SBW::dbNode::LVR::LVR11::CF_Lvr_PNStat, "_ttg_callback_awaitvaluematch_6_1_1_16_6_3", "CAN signal \'CF_Lvr_PNStat\'", 0);
      setfailed |= eventTable[0] < 0;
      eventTable[1] = testJoinSignal(HKMC_LH_SBW::dbNode::LVR::LVR11::CF_Lvr_PRelStat, "_ttg_callback_awaitvaluematch_6_1_1_16_6_4", "CAN signal \'CF_Lvr_PRelStat\'", 0);
      setfailed |= eventTable[1] < 0;
      if(setfailed != 0)
      {
        testStepErrorInTestSystem(0, "1", "Unable to set value condition(s)");
      }
      ret = testWaitForAllJoinedEventsNS((int64)(5LL * 1000000000LL));
      if(setfailed == 0)
      {
        if(ret > 0)
        {
          testStepPass(2, "1", "Waited for occurrence of 2 value condition(s).");
        }
        else
        {
          testStepFail(0, "1", "Waited for occurrence of 2 value condition(s).");
        }
        _fct_TiTableHeadExpectedEx("");
        _fct_ChckRep(0, HKMC_LH_SBW::dbNode::LVR::LVR11::CF_Lvr_PNStat, "CAN signal \'CF_Lvr_PNStat\'", "==", 1LL, "Park Status");
        _fct_TiCellResult(((0!=getSignalTime(HKMC_LH_SBW::dbNode::LVR::LVR11::CF_Lvr_PNStat)) && CheckSignalMatch(HKMC_LH_SBW::dbNode::LVR::LVR11::CF_Lvr_PNStat, 1LL, "=") == 1));
        _fct_ChckRep(0, HKMC_LH_SBW::dbNode::LVR::LVR11::CF_Lvr_PRelStat, "CAN signal \'CF_Lvr_PRelStat\'", "==", 0LL, "Parking not released");
        _fct_TiCellResult(((0!=getSignalTime(HKMC_LH_SBW::dbNode::LVR::LVR11::CF_Lvr_PRelStat)) && CheckSignalMatch(HKMC_LH_SBW::dbNode::LVR::LVR11::CF_Lvr_PRelStat, 0LL, "=") == 1));
        _fct_TiTableEnd("", 0, 0);
      }
    }
  }
  // _ttg_!_6_1_1_16_6
  TestCommandEnd();
  if(_fct_DoStop(EVerdBOF_TC, 1))
  {
    _ttg_fct_completion_6_1_1_16_11(_ttg_var_G_SEL_DISP_value_of_D_6_1_1_16_1_0);
    return;
  }
  TestCommandBegin("CAPL Inline", "capture CF_Lvr_PNStat&CF_Lvr_PRelStat");
  {
    _ttg_fct_caplinline_6_1_1_16_7();
  }
  // _ttg_!_6_1_1_16_7
  TestCommandEnd();
  if(_fct_DoStop(EVerdBOF_TC, 1))
  {
    _ttg_fct_completion_6_1_1_16_11(_ttg_var_G_SEL_DISP_value_of_D_6_1_1_16_1_0);
    return;
  }
  TestCommandBegin("CAPL Inline", "set signal G_SEL_DISP time out");
  {
    _ttg_fct_caplinline_6_1_1_16_8();
  }
  // _ttg_!_6_1_1_16_8
  TestCommandEnd();
  if(_fct_DoStop(EVerdBOF_TC, 1))
  {
    _ttg_fct_completion_6_1_1_16_11(_ttg_var_G_SEL_DISP_value_of_D_6_1_1_16_1_0);
    return;
  }
  TestCommandBegin("Await Value Match", "check if SBW operate PRA to not P Position");
  {
    dword eventTable[2];
    long ret, setfailed; setfailed = 0;
    if((int64)(5LL * 1000000000LL) < 0)
    {
      testStepErrorInTestSystem(0, "1", "Invalid wait time (< 0)");
    }
    else
    {
      eventTable[0] = testJoinSignal(HKMC_LH_SBW::dbNode::LVR::LVR11::CF_Lvr_PNStat, "_ttg_callback_awaitvaluematch_6_1_1_16_9_3", "CAN signal \'CF_Lvr_PNStat\'", 0);
      setfailed |= eventTable[0] < 0;
      eventTable[1] = testJoinSignal(HKMC_LH_SBW::dbNode::LVR::LVR11::CF_Lvr_PRelStat, "_ttg_callback_awaitvaluematch_6_1_1_16_9_4", "CAN signal \'CF_Lvr_PRelStat\'", 0);
      setfailed |= eventTable[1] < 0;
      if(setfailed != 0)
      {
        testStepErrorInTestSystem(0, "1", "Unable to set value condition(s)");
      }
      ret = testWaitForAllJoinedEventsNS((int64)(5LL * 1000000000LL));
      if(setfailed == 0)
      {
        if(ret > 0)
        {
          testStepPass(2, "1", "Waited for occurrence of 2 value condition(s).");
        }
        else
        {
          testStepFail(0, "1", "Waited for occurrence of 2 value condition(s).");
        }
        _fct_TiTableHeadExpectedEx("");
        _fct_ChckRep(0, HKMC_LH_SBW::dbNode::LVR::LVR11::CF_Lvr_PNStat, "CAN signal \'CF_Lvr_PNStat\'", "==", 2LL, "Not Park Status");
        _fct_TiCellResult(((0!=getSignalTime(HKMC_LH_SBW::dbNode::LVR::LVR11::CF_Lvr_PNStat)) && CheckSignalMatch(HKMC_LH_SBW::dbNode::LVR::LVR11::CF_Lvr_PNStat, 2LL, "=") == 1));
        _fct_ChckRep(0, HKMC_LH_SBW::dbNode::LVR::LVR11::CF_Lvr_PRelStat, "CAN signal \'CF_Lvr_PRelStat\'", "==", 1LL, "Parking released");
        _fct_TiCellResult(((0!=getSignalTime(HKMC_LH_SBW::dbNode::LVR::LVR11::CF_Lvr_PRelStat)) && CheckSignalMatch(HKMC_LH_SBW::dbNode::LVR::LVR11::CF_Lvr_PRelStat, 1LL, "=") == 1));
        _fct_TiTableEnd("", 0, 0);
      }
    }
  }
  // _ttg_!_6_1_1_16_9
  TestCommandEnd();
  if(_fct_DoStop(EVerdBOF_TC, 1))
  {
    _ttg_fct_completion_6_1_1_16_11(_ttg_var_G_SEL_DISP_value_of_D_6_1_1_16_1_0);
    return;
  }
  TestCommandBegin("CAPL Inline", "capture CF_Lvr_PNStat&CF_Lvr_PRelStat");
  {
    _ttg_fct_caplinline_6_1_1_16_10();
  }
  // _ttg_!_6_1_1_16_10
  TestCommandEnd();
  if(_fct_DoStop(EVerdBOF_TC, 1))
  {
    _ttg_fct_completion_6_1_1_16_11(_ttg_var_G_SEL_DISP_value_of_D_6_1_1_16_1_0);
    return;
  }
  {
    // Completion
    _ttg_fct_completion_6_1_1_16_11(_ttg_var_G_SEL_DISP_value_of_D_6_1_1_16_1_0);
  }
}
// _ttg_#_6_1_1_16
testcase _ttg_fct_testPRAUnderTcuOffwithLastGearPRorN_6_1_1_17(int64 _ttg_var_G_SEL_DISP_value_of_PRorN_6_1_1_17_1_0)
{
  {
    // Preparation
    _ttg_fct_preparation_6_1_1_17_2(_ttg_var_G_SEL_DISP_value_of_PRorN_6_1_1_17_1_0);
    if(_fct_DoStop(EVerdBOF_TC, 1))
    {
      _ttg_fct_completion_6_1_1_17_3(_ttg_var_G_SEL_DISP_value_of_PRorN_6_1_1_17_1_0);
      return;
    }
  }
  {
    // Completion
    _ttg_fct_completion_6_1_1_17_3(_ttg_var_G_SEL_DISP_value_of_PRorN_6_1_1_17_1_0);
  }
}
// _ttg_#_6_1_1_17
testcase _ttg_fct_testPRAUnderIGOffMode_6_1_1_18(int64 _ttg_var_G_SEL_DISP_value_of_notN_6_1_1_18_1_0)
{
  {
    // Preparation
    _ttg_fct_preparation_6_1_1_18_2(_ttg_var_G_SEL_DISP_value_of_notN_6_1_1_18_1_0);
    if(_fct_DoStop(EVerdBOF_TC, 1))
    {
      _ttg_fct_completion_6_1_1_18_12(_ttg_var_G_SEL_DISP_value_of_notN_6_1_1_18_1_0);
      return;
    }
  }
  {
    CreateCaplIFFunction("setVehicleSpeed", 0);
    AddIFParameterInt(1LL);
    AddIFParameterInt(0LL);
    CallInterfaceFunction("make vehicle drive");
    if(_fct_DoStop(EVerdBOF_TC, 1))
    {
      _ttg_fct_completion_6_1_1_18_12(_ttg_var_G_SEL_DISP_value_of_notN_6_1_1_18_1_0);
      return;
    }
  }
  TestCommandBegin("Wait", "");
  {
    _fct_Wait("1", (int64)(1LL * 1000000000LL), 1000000000, "");
  }
  // _ttg_!_6_1_1_18_5
  TestCommandEnd();
  if(_fct_DoStop(EVerdBOF_TC, 1))
  {
    _ttg_fct_completion_6_1_1_18_12(_ttg_var_G_SEL_DISP_value_of_notN_6_1_1_18_1_0);
    return;
  }
  {
    CreateCaplIFFunction("fromIGONToIGOffMode", 0);
    AddIFParameterInt(_ttg_var_G_SEL_DISP_value_of_notN_6_1_1_18_1_0);
    CallInterfaceFunction("fromIGONToIGOffMode (G_SEL_DISP_value_of_notN=G_SEL_DISP_value_of_notN)");
    if(_fct_DoStop(EVerdBOF_TC, 1))
    {
      _ttg_fct_completion_6_1_1_18_12(_ttg_var_G_SEL_DISP_value_of_notN_6_1_1_18_1_0);
      return;
    }
  }
  TestCommandBegin("Await Value Match", "check if SBW operate PRA to not P position");
  {
    dword eventTable[2];
    long ret, setfailed; setfailed = 0;
    if((int64)(5LL * 1000000000LL) < 0)
    {
      testStepErrorInTestSystem(0, "1", "Invalid wait time (< 0)");
    }
    else
    {
      eventTable[0] = testJoinSignal(HKMC_LH_SBW::dbNode::LVR::LVR11::CF_Lvr_PNStat, "_ttg_callback_awaitvaluematch_6_1_1_18_7_3", "CAN signal \'CF_Lvr_PNStat\'", 0);
      setfailed |= eventTable[0] < 0;
      eventTable[1] = testJoinSignal(HKMC_LH_SBW::dbNode::LVR::LVR11::CF_Lvr_PRelStat, "_ttg_callback_awaitvaluematch_6_1_1_18_7_4", "CAN signal \'CF_Lvr_PRelStat\'", 0);
      setfailed |= eventTable[1] < 0;
      if(setfailed != 0)
      {
        testStepErrorInTestSystem(0, "1", "Unable to set value condition(s)");
      }
      ret = testWaitForAllJoinedEventsNS((int64)(5LL * 1000000000LL));
      if(setfailed == 0)
      {
        if(ret > 0)
        {
          testStepPass(2, "1", "Waited for occurrence of 2 value condition(s).");
        }
        else
        {
          testStepFail(0, "1", "Waited for occurrence of 2 value condition(s).");
        }
        _fct_TiTableHeadExpectedEx("");
        _fct_ChckRep(0, HKMC_LH_SBW::dbNode::LVR::LVR11::CF_Lvr_PNStat, "CAN signal \'CF_Lvr_PNStat\'", "==", 2LL, "Not Park Status");
        _fct_TiCellResult(((0!=getSignalTime(HKMC_LH_SBW::dbNode::LVR::LVR11::CF_Lvr_PNStat)) && CheckSignalMatch(HKMC_LH_SBW::dbNode::LVR::LVR11::CF_Lvr_PNStat, 2LL, "=") == 1));
        _fct_ChckRep(0, HKMC_LH_SBW::dbNode::LVR::LVR11::CF_Lvr_PRelStat, "CAN signal \'CF_Lvr_PRelStat\'", "==", 1LL, "Parking released");
        _fct_TiCellResult(((0!=getSignalTime(HKMC_LH_SBW::dbNode::LVR::LVR11::CF_Lvr_PRelStat)) && CheckSignalMatch(HKMC_LH_SBW::dbNode::LVR::LVR11::CF_Lvr_PRelStat, 1LL, "=") == 1));
        _fct_TiTableEnd("", 0, 0);
      }
    }
  }
  // _ttg_!_6_1_1_18_7
  TestCommandEnd();
  if(_fct_DoStop(EVerdBOF_TC, 1))
  {
    _ttg_fct_completion_6_1_1_18_12(_ttg_var_G_SEL_DISP_value_of_notN_6_1_1_18_1_0);
    return;
  }
  TestCommandBegin("CAPL Inline", "capture CF_Lvr_PNStat&CF_Lvr_PRelStat");
  {
    _ttg_fct_caplinline_6_1_1_18_8();
  }
  // _ttg_!_6_1_1_18_8
  TestCommandEnd();
  if(_fct_DoStop(EVerdBOF_TC, 1))
  {
    _ttg_fct_completion_6_1_1_18_12(_ttg_var_G_SEL_DISP_value_of_notN_6_1_1_18_1_0);
    return;
  }
  {
    CreateCaplIFFunction("setVehicleSpeed", 0);
    AddIFParameterInt(1LL);
    AddIFParameterInt(1LL);
    CallInterfaceFunction("make vehicle stop");
    if(_fct_DoStop(EVerdBOF_TC, 1))
    {
      _ttg_fct_completion_6_1_1_18_12(_ttg_var_G_SEL_DISP_value_of_notN_6_1_1_18_1_0);
      return;
    }
  }
  TestCommandBegin("Await Value Match", "check if SBW operate PRA to P position");
  {
    dword eventTable[2];
    long ret, setfailed; setfailed = 0;
    if((int64)(5LL * 1000000000LL) < 0)
    {
      testStepErrorInTestSystem(0, "1", "Invalid wait time (< 0)");
    }
    else
    {
      eventTable[0] = testJoinSignal(HKMC_LH_SBW::dbNode::LVR::LVR11::CF_Lvr_PNStat, "_ttg_callback_awaitvaluematch_6_1_1_18_10_3", "CAN signal \'CF_Lvr_PNStat\'", 0);
      setfailed |= eventTable[0] < 0;
      eventTable[1] = testJoinSignal(HKMC_LH_SBW::dbNode::LVR::LVR11::CF_Lvr_PRelStat, "_ttg_callback_awaitvaluematch_6_1_1_18_10_4", "CAN signal \'CF_Lvr_PRelStat\'", 0);
      setfailed |= eventTable[1] < 0;
      if(setfailed != 0)
      {
        testStepErrorInTestSystem(0, "1", "Unable to set value condition(s)");
      }
      ret = testWaitForAllJoinedEventsNS((int64)(5LL * 1000000000LL));
      if(setfailed == 0)
      {
        if(ret > 0)
        {
          testStepPass(2, "1", "Waited for occurrence of 2 value condition(s).");
        }
        else
        {
          testStepFail(0, "1", "Waited for occurrence of 2 value condition(s).");
        }
        _fct_TiTableHeadExpectedEx("");
        _fct_ChckRep(0, HKMC_LH_SBW::dbNode::LVR::LVR11::CF_Lvr_PNStat, "CAN signal \'CF_Lvr_PNStat\'", "==", 1LL, "Park Status");
        _fct_TiCellResult(((0!=getSignalTime(HKMC_LH_SBW::dbNode::LVR::LVR11::CF_Lvr_PNStat)) && CheckSignalMatch(HKMC_LH_SBW::dbNode::LVR::LVR11::CF_Lvr_PNStat, 1LL, "=") == 1));
        _fct_ChckRep(0, HKMC_LH_SBW::dbNode::LVR::LVR11::CF_Lvr_PRelStat, "CAN signal \'CF_Lvr_PRelStat\'", "==", 0LL, "Parking not released");
        _fct_TiCellResult(((0!=getSignalTime(HKMC_LH_SBW::dbNode::LVR::LVR11::CF_Lvr_PRelStat)) && CheckSignalMatch(HKMC_LH_SBW::dbNode::LVR::LVR11::CF_Lvr_PRelStat, 0LL, "=") == 1));
        _fct_TiTableEnd("", 0, 0);
      }
    }
  }
  // _ttg_!_6_1_1_18_10
  TestCommandEnd();
  if(_fct_DoStop(EVerdBOF_TC, 1))
  {
    _ttg_fct_completion_6_1_1_18_12(_ttg_var_G_SEL_DISP_value_of_notN_6_1_1_18_1_0);
    return;
  }
  TestCommandBegin("CAPL Inline", "capture CF_Lvr_PNStat&CF_Lvr_PRelStat");
  {
    _ttg_fct_caplinline_6_1_1_18_11();
  }
  // _ttg_!_6_1_1_18_11
  TestCommandEnd();
  if(_fct_DoStop(EVerdBOF_TC, 1))
  {
    _ttg_fct_completion_6_1_1_18_12(_ttg_var_G_SEL_DISP_value_of_notN_6_1_1_18_1_0);
    return;
  }
  {
    // Completion
    _ttg_fct_completion_6_1_1_18_12(_ttg_var_G_SEL_DISP_value_of_notN_6_1_1_18_1_0);
  }
}
// _ttg_#_6_1_1_18
testcase _ttg_fct_testPRAUnderNParkMode_6_1_1_19(int64 _ttg_var_G_SEL_DISP_value_of_notN_6_1_1_19_1_0)
{
  {
    // Preparation
    _ttg_fct_preparation_6_1_1_19_2(_ttg_var_G_SEL_DISP_value_of_notN_6_1_1_19_1_0);
    if(_fct_DoStop(EVerdBOF_TC, 1))
    {
      _ttg_fct_completion_6_1_1_19_10(_ttg_var_G_SEL_DISP_value_of_notN_6_1_1_19_1_0);
      return;
    }
  }
  {
    CreateCaplIFFunction("fromIGONToNParkIGOffMode", 0);
    _ttg_I0 = _ttg_var_G_SEL_DISP_value_of_notN_6_1_1_19_1_0;
    AddIFParameterInt(_ttg_I0);
    CallInterfaceFunction("fromIGONToNParkIGOffMode (G_SEL_DISP_value_of_notN=G_SEL_DISP_value_of_notN)");
    if(_fct_DoStop(EVerdBOF_TC, 1))
    {
      _ttg_fct_completion_6_1_1_19_10(_ttg_var_G_SEL_DISP_value_of_notN_6_1_1_19_1_0);
      return;
    }
  }
  TestCommandBegin("Await Value Match", "check if SBW operate PRA to not P Position");
  {
    dword eventTable[2];
    long ret, setfailed; setfailed = 0;
    if((int64)(5LL * 1000000000LL) < 0)
    {
      testStepErrorInTestSystem(0, "1", "Invalid wait time (< 0)");
    }
    else
    {
      eventTable[0] = testJoinSignal(HKMC_LH_SBW::dbNode::LVR::LVR11::CF_Lvr_PNStat, "_ttg_callback_awaitvaluematch_6_1_1_19_4_3", "CAN signal \'CF_Lvr_PNStat\'", 0);
      setfailed |= eventTable[0] < 0;
      eventTable[1] = testJoinSignal(HKMC_LH_SBW::dbNode::LVR::LVR11::CF_Lvr_PRelStat, "_ttg_callback_awaitvaluematch_6_1_1_19_4_4", "CAN signal \'CF_Lvr_PRelStat\'", 0);
      setfailed |= eventTable[1] < 0;
      if(setfailed != 0)
      {
        testStepErrorInTestSystem(0, "1", "Unable to set value condition(s)");
      }
      ret = testWaitForAllJoinedEventsNS((int64)(5LL * 1000000000LL));
      if(setfailed == 0)
      {
        if(ret > 0)
        {
          testStepPass(2, "1", "Waited for occurrence of 2 value condition(s).");
        }
        else
        {
          testStepFail(0, "1", "Waited for occurrence of 2 value condition(s).");
        }
        _fct_TiTableHeadExpectedEx("");
        _fct_ChckRep(0, HKMC_LH_SBW::dbNode::LVR::LVR11::CF_Lvr_PNStat, "CAN signal \'CF_Lvr_PNStat\'", "==", 2LL, "Not Park Status");
        _fct_TiCellResult(((0!=getSignalTime(HKMC_LH_SBW::dbNode::LVR::LVR11::CF_Lvr_PNStat)) && CheckSignalMatch(HKMC_LH_SBW::dbNode::LVR::LVR11::CF_Lvr_PNStat, 2LL, "=") == 1));
        _fct_ChckRep(0, HKMC_LH_SBW::dbNode::LVR::LVR11::CF_Lvr_PRelStat, "CAN signal \'CF_Lvr_PRelStat\'", "==", 1LL, "Parking released");
        _fct_TiCellResult(((0!=getSignalTime(HKMC_LH_SBW::dbNode::LVR::LVR11::CF_Lvr_PRelStat)) && CheckSignalMatch(HKMC_LH_SBW::dbNode::LVR::LVR11::CF_Lvr_PRelStat, 1LL, "=") == 1));
        _fct_TiTableEnd("", 0, 0);
      }
    }
  }
  // _ttg_!_6_1_1_19_4
  TestCommandEnd();
  if(_fct_DoStop(EVerdBOF_TC, 1))
  {
    _ttg_fct_completion_6_1_1_19_10(_ttg_var_G_SEL_DISP_value_of_notN_6_1_1_19_1_0);
    return;
  }
  TestCommandBegin("CAPL Inline", "capture CF_Lvr_PNStat&CF_Lvr_PRelStat");
  {
    _ttg_fct_caplinline_6_1_1_19_5();
  }
  // _ttg_!_6_1_1_19_5
  TestCommandEnd();
  if(_fct_DoStop(EVerdBOF_TC, 1))
  {
    _ttg_fct_completion_6_1_1_19_10(_ttg_var_G_SEL_DISP_value_of_notN_6_1_1_19_1_0);
    return;
  }
  {
    CreateCaplIFFunction("parkSwitchPress", 0);
    AddIFParameterInt(1LL);
    AddIFParameterChar("15.3.4 make a valid park switch press.png");
    CallInterfaceFunction("make a valid park switch press");
    if(_fct_DoStop(EVerdBOF_TC, 1))
    {
      _ttg_fct_completion_6_1_1_19_10(_ttg_var_G_SEL_DISP_value_of_notN_6_1_1_19_1_0);
      return;
    }
  }
  TestCommandBegin("Await Value Match", "check if SBW operate PRA to P Position");
  {
    dword eventTable[2];
    long ret, setfailed; setfailed = 0;
    if((int64)(5LL * 1000000000LL) < 0)
    {
      testStepErrorInTestSystem(0, "1", "Invalid wait time (< 0)");
    }
    else
    {
      eventTable[0] = testJoinSignal(HKMC_LH_SBW::dbNode::LVR::LVR11::CF_Lvr_PNStat, "_ttg_callback_awaitvaluematch_6_1_1_19_7_3", "CAN signal \'CF_Lvr_PNStat\'", 0);
      setfailed |= eventTable[0] < 0;
      eventTable[1] = testJoinSignal(HKMC_LH_SBW::dbNode::LVR::LVR11::CF_Lvr_PRelStat, "_ttg_callback_awaitvaluematch_6_1_1_19_7_4", "CAN signal \'CF_Lvr_PRelStat\'", 0);
      setfailed |= eventTable[1] < 0;
      if(setfailed != 0)
      {
        testStepErrorInTestSystem(0, "1", "Unable to set value condition(s)");
      }
      ret = testWaitForAllJoinedEventsNS((int64)(5LL * 1000000000LL));
      if(setfailed == 0)
      {
        if(ret > 0)
        {
          testStepPass(2, "1", "Waited for occurrence of 2 value condition(s).");
        }
        else
        {
          testStepFail(0, "1", "Waited for occurrence of 2 value condition(s).");
        }
        _fct_TiTableHeadExpectedEx("");
        _fct_ChckRep(0, HKMC_LH_SBW::dbNode::LVR::LVR11::CF_Lvr_PNStat, "CAN signal \'CF_Lvr_PNStat\'", "==", 1LL, "Park Status");
        _fct_TiCellResult(((0!=getSignalTime(HKMC_LH_SBW::dbNode::LVR::LVR11::CF_Lvr_PNStat)) && CheckSignalMatch(HKMC_LH_SBW::dbNode::LVR::LVR11::CF_Lvr_PNStat, 1LL, "=") == 1));
        _fct_ChckRep(0, HKMC_LH_SBW::dbNode::LVR::LVR11::CF_Lvr_PRelStat, "CAN signal \'CF_Lvr_PRelStat\'", "==", 0LL, "Parking not released");
        _fct_TiCellResult(((0!=getSignalTime(HKMC_LH_SBW::dbNode::LVR::LVR11::CF_Lvr_PRelStat)) && CheckSignalMatch(HKMC_LH_SBW::dbNode::LVR::LVR11::CF_Lvr_PRelStat, 0LL, "=") == 1));
        _fct_TiTableEnd("", 0, 0);
      }
    }
  }
  // _ttg_!_6_1_1_19_7
  TestCommandEnd();
  if(_fct_DoStop(EVerdBOF_TC, 1))
  {
    _ttg_fct_completion_6_1_1_19_10(_ttg_var_G_SEL_DISP_value_of_notN_6_1_1_19_1_0);
    return;
  }
  TestCommandBegin("CAPL Inline", "capture CF_Lvr_PNStat&CF_Lvr_PRelStat");
  {
    _ttg_fct_caplinline_6_1_1_19_8();
  }
  // _ttg_!_6_1_1_19_8
  TestCommandEnd();
  if(_fct_DoStop(EVerdBOF_TC, 1))
  {
    _ttg_fct_completion_6_1_1_19_10(_ttg_var_G_SEL_DISP_value_of_notN_6_1_1_19_1_0);
    return;
  }
  TestCommandBegin("CANoe Standard Service", "check even if timeout is expired during P-Position ↔ Not-P Position operation, SBW should complete PRA operation to P-Position or Not P-Position, then SBW goes into sleep mode.");
  {
    testStep(2, "", "Execute testValidateTesterConfirmation(\"Press P and P-Release,check even if timeout is expired during P-Position ↔ Not-P Position operation, SBW should complete PRA operation to P-Position or Not P-Position, then SBW goes into sleep mode.\", \"check PRA position\", 1)");
    testValidateTesterConfirmation("Press P and P-Release,check even if timeout is expired during P-Position ↔ Not-P Position operation, SBW should complete PRA operation to P-Position or Not P-Position, then SBW goes into sleep mode.", "check PRA position", 1LL);
  }
  // _ttg_!_6_1_1_19_9
  TestCommandEnd();
  if(_fct_DoStop(EVerdBOF_TC, 1))
  {
    _ttg_fct_completion_6_1_1_19_10(_ttg_var_G_SEL_DISP_value_of_notN_6_1_1_19_1_0);
    return;
  }
  {
    // Completion
    _ttg_fct_completion_6_1_1_19_10(_ttg_var_G_SEL_DISP_value_of_notN_6_1_1_19_1_0);
  }
}
// _ttg_#_6_1_1_19
testcase _ttg_fct_checkIndicatorAccordingToPRAPos_6_1_1_20(int64 _ttg_var_G_SEL_DISP_value_of_notN_6_1_1_20_1_0)
{
  {
    // Preparation
    _ttg_fct_preparation_6_1_1_20_2(_ttg_var_G_SEL_DISP_value_of_notN_6_1_1_20_1_0);
    if(_fct_DoStop(EVerdBOF_TC, 1))
    {
      _ttg_fct_completion_6_1_1_20_8(_ttg_var_G_SEL_DISP_value_of_notN_6_1_1_20_1_0);
      return;
    }
  }
  TestCommandBegin("CANoe Standard Service", "PRA@NOT P:check if N indicator is lighten");
  {
    testStep(2, "", "Execute testValidateTesterConfirmation(\"PRA@NOT P:check if N indicator is lighten\", \"check N indicator\", 1)");
    testValidateTesterConfirmation("PRA@NOT P:check if N indicator is lighten", "check N indicator", 1LL);
  }
  // _ttg_!_6_1_1_20_3
  TestCommandEnd();
  if(_fct_DoStop(EVerdBOF_TC, 1))
  {
    _ttg_fct_completion_6_1_1_20_8(_ttg_var_G_SEL_DISP_value_of_notN_6_1_1_20_1_0);
    return;
  }
  TestCommandBegin("CAPL Inline", "capture PRA posiiton after valid P-release at NParkIGOFF");
  {
    _ttg_fct_caplinline_6_1_1_20_4();
  }
  // _ttg_!_6_1_1_20_4
  TestCommandEnd();
  if(_fct_DoStop(EVerdBOF_TC, 1))
  {
    _ttg_fct_completion_6_1_1_20_8(_ttg_var_G_SEL_DISP_value_of_notN_6_1_1_20_1_0);
    return;
  }
  {
    CreateCaplIFFunction("parkSwitchPress", 0);
    AddIFParameterInt(1LL);
    AddIFParameterChar("13.4.1.b make a valid P switch press.png");
    CallInterfaceFunction("make a valid P switch press,operate PRA to P position.");
    if(_fct_DoStop(EVerdBOF_TC, 1))
    {
      _ttg_fct_completion_6_1_1_20_8(_ttg_var_G_SEL_DISP_value_of_notN_6_1_1_20_1_0);
      return;
    }
  }
  TestCommandBegin("CANoe Standard Service", "PRA@P:check if P indicator is lighten");
  {
    testStep(2, "", "Execute testValidateTesterConfirmation(\"PRA@ P:check if P indicator is lighten\", \"check P indicator\", 1)");
    testValidateTesterConfirmation("PRA@ P:check if P indicator is lighten", "check P indicator", 1LL);
  }
  // _ttg_!_6_1_1_20_6
  TestCommandEnd();
  if(_fct_DoStop(EVerdBOF_TC, 1))
  {
    _ttg_fct_completion_6_1_1_20_8(_ttg_var_G_SEL_DISP_value_of_notN_6_1_1_20_1_0);
    return;
  }
  TestCommandBegin("CAPL Inline", "capture PRA posiiton after valid P at NParkIGOFF");
  {
    _ttg_fct_caplinline_6_1_1_20_7();
  }
  // _ttg_!_6_1_1_20_7
  TestCommandEnd();
  if(_fct_DoStop(EVerdBOF_TC, 1))
  {
    _ttg_fct_completion_6_1_1_20_8(_ttg_var_G_SEL_DISP_value_of_notN_6_1_1_20_1_0);
    return;
  }
  {
    // Completion
    _ttg_fct_completion_6_1_1_20_8(_ttg_var_G_SEL_DISP_value_of_notN_6_1_1_20_1_0);
  }
}
// _ttg_#_6_1_1_20
testcase _ttg_fct_checkIndicatorBlinkingMode_6_1_1_21(int64 _ttg_var_G_SEL_DISP_value_of_notN_6_1_1_21_1_0)
{
  {
    // Preparation
    _ttg_fct_preparation_6_1_1_21_2(_ttg_var_G_SEL_DISP_value_of_notN_6_1_1_21_1_0);
    if(_fct_DoStop(EVerdBOF_TC, 1))
    {
      _ttg_fct_completion_6_1_1_21_9(_ttg_var_G_SEL_DISP_value_of_notN_6_1_1_21_1_0);
      return;
    }
  }
  TestCommandBegin("Wait", "");
  {
    _fct_Wait("1", (int64)(1LL * 1000000000LL), 1000000000, "");
  }
  // _ttg_!_6_1_1_21_3
  TestCommandEnd();
  if(_fct_DoStop(EVerdBOF_TC, 1))
  {
    _ttg_fct_completion_6_1_1_21_9(_ttg_var_G_SEL_DISP_value_of_notN_6_1_1_21_1_0);
    return;
  }
  {
    CreateCaplIFFunction("setPRAPos", 0);
    AddIFParameterInt(1LL);
    AddIFParameterInt(0LL);
    CallInterfaceFunction("Make TM SW at not P status");
    if(_fct_DoStop(EVerdBOF_TC, 1))
    {
      _ttg_fct_completion_6_1_1_21_9(_ttg_var_G_SEL_DISP_value_of_notN_6_1_1_21_1_0);
      return;
    }
  }
  TestCommandBegin("CANoe Standard Service", "reminder:Keep P switch pressed for 1.5s,when park button was asked to pressed");
  {
    testStep(2, "", "Execute testValidateTesterConfirmation(\"Keep P switch pressed for 1.5s,when park button was asked to pressed\", \"reminder\", 1)");
    testValidateTesterConfirmation("Keep P switch pressed for 1.5s,when park button was asked to pressed", "reminder", 1LL);
  }
  // _ttg_!_6_1_1_21_5
  TestCommandEnd();
  if(_fct_DoStop(EVerdBOF_TC, 1))
  {
    _ttg_fct_completion_6_1_1_21_9(_ttg_var_G_SEL_DISP_value_of_notN_6_1_1_21_1_0);
    return;
  }
  {
    CreateCaplIFFunction("parkSwitchPress", 0);
    AddIFParameterInt(1LL);
    AddIFParameterChar("13.4.2.5 Keep P switch pressed for 1500ms.png");
    CallInterfaceFunction("Keep P switch pressed for 1500ms");
    if(_fct_DoStop(EVerdBOF_TC, 1))
    {
      _ttg_fct_completion_6_1_1_21_9(_ttg_var_G_SEL_DISP_value_of_notN_6_1_1_21_1_0);
      return;
    }
  }
  TestCommandBegin("CANoe Standard Service", "check if SBW will blink the N indicator");
  {
    testStep(2, "", "Execute testValidateTesterConfirmation(\"check if SBW will blink the N indicator\", \"check N indicator\", 1)");
    testValidateTesterConfirmation("check if SBW will blink the N indicator", "check N indicator", 1LL);
  }
  // _ttg_!_6_1_1_21_7
  TestCommandEnd();
  if(_fct_DoStop(EVerdBOF_TC, 1))
  {
    _ttg_fct_completion_6_1_1_21_9(_ttg_var_G_SEL_DISP_value_of_notN_6_1_1_21_1_0);
    return;
  }
  TestCommandBegin("CAPL Inline", "Record CF_Lvr_PNStat graph");
  {
    _ttg_fct_caplinline_6_1_1_21_8();
  }
  // _ttg_!_6_1_1_21_8
  TestCommandEnd();
  if(_fct_DoStop(EVerdBOF_TC, 1))
  {
    _ttg_fct_completion_6_1_1_21_9(_ttg_var_G_SEL_DISP_value_of_notN_6_1_1_21_1_0);
    return;
  }
  {
    // Completion
    _ttg_fct_completion_6_1_1_21_9(_ttg_var_G_SEL_DISP_value_of_notN_6_1_1_21_1_0);
  }
}
// _ttg_#_6_1_1_21
testcase _ttg_fct_manualReleaseFunction_a_6_1_1_22(int64 _ttg_var_G_SEL_DISP_value_of_notN_6_1_1_22_1_0)
{
  {
    // Preparation
    _ttg_fct_preparation_6_1_1_22_2(_ttg_var_G_SEL_DISP_value_of_notN_6_1_1_22_1_0);
    if(_fct_DoStop(EVerdBOF_TC, 1))
    {
      _ttg_fct_completion_6_1_1_22_13(_ttg_var_G_SEL_DISP_value_of_notN_6_1_1_22_1_0);
      return;
    }
  }
  {
    CreateCaplIFFunction("SBWControlPRAByIGONTCURequest", 0);
    AddIFParameterInt(1LL);
    CallInterfaceFunction("Set PRA to P position at initial");
    if(_fct_DoStop(EVerdBOF_TC, 1))
    {
      _ttg_fct_completion_6_1_1_22_13(_ttg_var_G_SEL_DISP_value_of_notN_6_1_1_22_1_0);
      return;
    }
  }
  TestCommandBegin("Await Value Match", "check if SBW operate PRA to P Position at initial");
  {
    dword eventTable[2];
    long ret, setfailed; setfailed = 0;
    if((int64)(5LL * 1000000000LL) < 0)
    {
      testStepErrorInTestSystem(0, "1", "Invalid wait time (< 0)");
    }
    else
    {
      eventTable[0] = testJoinSignal(HKMC_LH_SBW::dbNode::LVR::LVR11::CF_Lvr_PNStat, "_ttg_callback_awaitvaluematch_6_1_1_22_4_3", "CAN signal \'CF_Lvr_PNStat\'", 0);
      setfailed |= eventTable[0] < 0;
      eventTable[1] = testJoinSignal(HKMC_LH_SBW::dbNode::LVR::LVR11::CF_Lvr_PRelStat, "_ttg_callback_awaitvaluematch_6_1_1_22_4_4", "CAN signal \'CF_Lvr_PRelStat\'", 0);
      setfailed |= eventTable[1] < 0;
      if(setfailed != 0)
      {
        testStepErrorInTestSystem(0, "1", "Unable to set value condition(s)");
      }
      ret = testWaitForAllJoinedEventsNS((int64)(5LL * 1000000000LL));
      if(setfailed == 0)
      {
        if(ret > 0)
        {
          testStepPass(2, "1", "Waited for occurrence of 2 value condition(s).");
        }
        else
        {
          testStepFail(0, "1", "Waited for occurrence of 2 value condition(s).");
        }
        _fct_TiTableHeadExpectedEx("");
        _fct_ChckRep(0, HKMC_LH_SBW::dbNode::LVR::LVR11::CF_Lvr_PNStat, "CAN signal \'CF_Lvr_PNStat\'", "==", 1LL, "Park Status");
        _fct_TiCellResult(((0!=getSignalTime(HKMC_LH_SBW::dbNode::LVR::LVR11::CF_Lvr_PNStat)) && CheckSignalMatch(HKMC_LH_SBW::dbNode::LVR::LVR11::CF_Lvr_PNStat, 1LL, "=") == 1));
        _fct_ChckRep(0, HKMC_LH_SBW::dbNode::LVR::LVR11::CF_Lvr_PRelStat, "CAN signal \'CF_Lvr_PRelStat\'", "==", 0LL, "Parking not released");
        _fct_TiCellResult(((0!=getSignalTime(HKMC_LH_SBW::dbNode::LVR::LVR11::CF_Lvr_PRelStat)) && CheckSignalMatch(HKMC_LH_SBW::dbNode::LVR::LVR11::CF_Lvr_PRelStat, 0LL, "=") == 1));
        _fct_TiTableEnd("", 0, 0);
      }
    }
  }
  // _ttg_!_6_1_1_22_4
  TestCommandEnd();
  if(_fct_DoStop(EVerdBOF_TC, 1))
  {
    _ttg_fct_completion_6_1_1_22_13(_ttg_var_G_SEL_DISP_value_of_notN_6_1_1_22_1_0);
    return;
  }
  TestCommandBegin("CAPL Inline", "capture CF_Lvr_PNStat&CF_Lvr_PRelStat");
  {
    _ttg_fct_caplinline_6_1_1_22_5();
  }
  // _ttg_!_6_1_1_22_5
  TestCommandEnd();
  if(_fct_DoStop(EVerdBOF_TC, 1))
  {
    _ttg_fct_completion_6_1_1_22_13(_ttg_var_G_SEL_DISP_value_of_notN_6_1_1_22_1_0);
    return;
  }
  {
    CreateCaplIFFunction("fromIGONToNParkIGOffMode", 0);
    AddIFParameterInt(_ttg_var_G_SEL_DISP_value_of_notN_6_1_1_22_1_0);
    CallInterfaceFunction("fromIGONToNParkIGOffMode (G_SEL_DISP_value_of_notN=G_SEL_DISP_value_of_notN)");
    if(_fct_DoStop(EVerdBOF_TC, 1))
    {
      _ttg_fct_completion_6_1_1_22_13(_ttg_var_G_SEL_DISP_value_of_notN_6_1_1_22_1_0);
      return;
    }
  }
  TestCommandBegin("Await Value Match", "check if SBW operate PRA to not P Position");
  {
    dword eventTable[2];
    long ret, setfailed; setfailed = 0;
    if((int64)(5LL * 1000000000LL) < 0)
    {
      testStepErrorInTestSystem(0, "1", "Invalid wait time (< 0)");
    }
    else
    {
      eventTable[0] = testJoinSignal(HKMC_LH_SBW::dbNode::LVR::LVR11::CF_Lvr_PNStat, "_ttg_callback_awaitvaluematch_6_1_1_22_7_3", "CAN signal \'CF_Lvr_PNStat\'", 0);
      setfailed |= eventTable[0] < 0;
      eventTable[1] = testJoinSignal(HKMC_LH_SBW::dbNode::LVR::LVR11::CF_Lvr_PRelStat, "_ttg_callback_awaitvaluematch_6_1_1_22_7_4", "CAN signal \'CF_Lvr_PRelStat\'", 0);
      setfailed |= eventTable[1] < 0;
      if(setfailed != 0)
      {
        testStepErrorInTestSystem(0, "1", "Unable to set value condition(s)");
      }
      ret = testWaitForAllJoinedEventsNS((int64)(5LL * 1000000000LL));
      if(setfailed == 0)
      {
        if(ret > 0)
        {
          testStepPass(2, "1", "Waited for occurrence of 2 value condition(s).");
        }
        else
        {
          testStepFail(0, "1", "Waited for occurrence of 2 value condition(s).");
        }
        _fct_TiTableHeadExpectedEx("");
        _fct_ChckRep(0, HKMC_LH_SBW::dbNode::LVR::LVR11::CF_Lvr_PNStat, "CAN signal \'CF_Lvr_PNStat\'", "==", 2LL, "Not Park Status");
        _fct_TiCellResult(((0!=getSignalTime(HKMC_LH_SBW::dbNode::LVR::LVR11::CF_Lvr_PNStat)) && CheckSignalMatch(HKMC_LH_SBW::dbNode::LVR::LVR11::CF_Lvr_PNStat, 2LL, "=") == 1));
        _fct_ChckRep(0, HKMC_LH_SBW::dbNode::LVR::LVR11::CF_Lvr_PRelStat, "CAN signal \'CF_Lvr_PRelStat\'", "==", 1LL, "Parking released");
        _fct_TiCellResult(((0!=getSignalTime(HKMC_LH_SBW::dbNode::LVR::LVR11::CF_Lvr_PRelStat)) && CheckSignalMatch(HKMC_LH_SBW::dbNode::LVR::LVR11::CF_Lvr_PRelStat, 1LL, "=") == 1));
        _fct_TiTableEnd("", 0, 0);
      }
    }
  }
  // _ttg_!_6_1_1_22_7
  TestCommandEnd();
  if(_fct_DoStop(EVerdBOF_TC, 1))
  {
    _ttg_fct_completion_6_1_1_22_13(_ttg_var_G_SEL_DISP_value_of_notN_6_1_1_22_1_0);
    return;
  }
  TestCommandBegin("CAPL Inline", "capture CF_Lvr_PNStat&CF_Lvr_PRelStat");
  {
    _ttg_fct_caplinline_6_1_1_22_8();
  }
  // _ttg_!_6_1_1_22_8
  TestCommandEnd();
  if(_fct_DoStop(EVerdBOF_TC, 1))
  {
    _ttg_fct_completion_6_1_1_22_13(_ttg_var_G_SEL_DISP_value_of_notN_6_1_1_22_1_0);
    return;
  }
  {
    CreateCaplIFFunction("parkSwitchPress", 0);
    AddIFParameterInt(1LL);
    AddIFParameterChar("15.3.5.a make a valid park switch press.png");
    CallInterfaceFunction("make a valid park switch press");
    if(_fct_DoStop(EVerdBOF_TC, 1))
    {
      _ttg_fct_completion_6_1_1_22_13(_ttg_var_G_SEL_DISP_value_of_notN_6_1_1_22_1_0);
      return;
    }
  }
  TestCommandBegin("Await Value Match", "check if SBW operate PRA to P Position");
  {
    dword eventTable[2];
    long ret, setfailed; setfailed = 0;
    if((int64)(5LL * 1000000000LL) < 0)
    {
      testStepErrorInTestSystem(0, "1", "Invalid wait time (< 0)");
    }
    else
    {
      eventTable[0] = testJoinSignal(HKMC_LH_SBW::dbNode::LVR::LVR11::CF_Lvr_PNStat, "_ttg_callback_awaitvaluematch_6_1_1_22_10_3", "CAN signal \'CF_Lvr_PNStat\'", 0);
      setfailed |= eventTable[0] < 0;
      eventTable[1] = testJoinSignal(HKMC_LH_SBW::dbNode::LVR::LVR11::CF_Lvr_PRelStat, "_ttg_callback_awaitvaluematch_6_1_1_22_10_4", "CAN signal \'CF_Lvr_PRelStat\'", 0);
      setfailed |= eventTable[1] < 0;
      if(setfailed != 0)
      {
        testStepErrorInTestSystem(0, "1", "Unable to set value condition(s)");
      }
      ret = testWaitForAllJoinedEventsNS((int64)(5LL * 1000000000LL));
      if(setfailed == 0)
      {
        if(ret > 0)
        {
          testStepPass(2, "1", "Waited for occurrence of 2 value condition(s).");
        }
        else
        {
          testStepFail(0, "1", "Waited for occurrence of 2 value condition(s).");
        }
        _fct_TiTableHeadExpectedEx("");
        _fct_ChckRep(0, HKMC_LH_SBW::dbNode::LVR::LVR11::CF_Lvr_PNStat, "CAN signal \'CF_Lvr_PNStat\'", "==", 1LL, "Park Status");
        _fct_TiCellResult(((0!=getSignalTime(HKMC_LH_SBW::dbNode::LVR::LVR11::CF_Lvr_PNStat)) && CheckSignalMatch(HKMC_LH_SBW::dbNode::LVR::LVR11::CF_Lvr_PNStat, 1LL, "=") == 1));
        _fct_ChckRep(0, HKMC_LH_SBW::dbNode::LVR::LVR11::CF_Lvr_PRelStat, "CAN signal \'CF_Lvr_PRelStat\'", "==", 0LL, "Parking not released");
        _fct_TiCellResult(((0!=getSignalTime(HKMC_LH_SBW::dbNode::LVR::LVR11::CF_Lvr_PRelStat)) && CheckSignalMatch(HKMC_LH_SBW::dbNode::LVR::LVR11::CF_Lvr_PRelStat, 0LL, "=") == 1));
        _fct_TiTableEnd("", 0, 0);
      }
    }
  }
  // _ttg_!_6_1_1_22_10
  TestCommandEnd();
  if(_fct_DoStop(EVerdBOF_TC, 1))
  {
    _ttg_fct_completion_6_1_1_22_13(_ttg_var_G_SEL_DISP_value_of_notN_6_1_1_22_1_0);
    return;
  }
  TestCommandBegin("CAPL Inline", "capture CF_Lvr_PNStat&CF_Lvr_PRelStat");
  {
    _ttg_fct_caplinline_6_1_1_22_11();
  }
  // _ttg_!_6_1_1_22_11
  TestCommandEnd();
  if(_fct_DoStop(EVerdBOF_TC, 1))
  {
    _ttg_fct_completion_6_1_1_22_13(_ttg_var_G_SEL_DISP_value_of_notN_6_1_1_22_1_0);
    return;
  }
  TestCommandBegin("CANoe Standard Service", "check if manual release is allowed in current IGN Off cycle.");
  {
    testStep(2, "", "Execute testValidateTesterConfirmation(\"check if manual release is allowed in current IGN Off cycle.\", \"check manual release\", 1)");
    testValidateTesterConfirmation("check if manual release is allowed in current IGN Off cycle.", "check manual release", 1LL);
  }
  // _ttg_!_6_1_1_22_12
  TestCommandEnd();
  if(_fct_DoStop(EVerdBOF_TC, 1))
  {
    _ttg_fct_completion_6_1_1_22_13(_ttg_var_G_SEL_DISP_value_of_notN_6_1_1_22_1_0);
    return;
  }
  {
    // Completion
    _ttg_fct_completion_6_1_1_22_13(_ttg_var_G_SEL_DISP_value_of_notN_6_1_1_22_1_0);
  }
}
// _ttg_#_6_1_1_22
testcase _ttg_fct_manualReleaseFunction_d_6_1_1_23(int64 _ttg_var_G_SEL_DISP_value_of_notN_6_1_1_23_1_0)
{
  {
    // Preparation
    _ttg_fct_preparation_6_1_1_23_2(_ttg_var_G_SEL_DISP_value_of_notN_6_1_1_23_1_0);
    if(_fct_DoStop(EVerdBOF_TC, 1))
    {
      _ttg_fct_completion_6_1_1_23_9(_ttg_var_G_SEL_DISP_value_of_notN_6_1_1_23_1_0);
      return;
    }
  }
  {
    CreateCaplIFFunction("SBWControlPRAByIGONTCURequest", 0);
    AddIFParameterInt(1LL);
    CallInterfaceFunction("Set PRA to P position at initial");
    if(_fct_DoStop(EVerdBOF_TC, 1))
    {
      _ttg_fct_completion_6_1_1_23_9(_ttg_var_G_SEL_DISP_value_of_notN_6_1_1_23_1_0);
      return;
    }
  }
  TestCommandBegin("Await Value Match", "check if SBW operate PRA to P Position at initial");
  {
    dword eventTable[2];
    long ret, setfailed; setfailed = 0;
    if((int64)(5LL * 1000000000LL) < 0)
    {
      testStepErrorInTestSystem(0, "1", "Invalid wait time (< 0)");
    }
    else
    {
      eventTable[0] = testJoinSignal(HKMC_LH_SBW::dbNode::LVR::LVR11::CF_Lvr_PNStat, "_ttg_callback_awaitvaluematch_6_1_1_23_4_3", "CAN signal \'CF_Lvr_PNStat\'", 0);
      setfailed |= eventTable[0] < 0;
      eventTable[1] = testJoinSignal(HKMC_LH_SBW::dbNode::LVR::LVR11::CF_Lvr_PRelStat, "_ttg_callback_awaitvaluematch_6_1_1_23_4_4", "CAN signal \'CF_Lvr_PRelStat\'", 0);
      setfailed |= eventTable[1] < 0;
      if(setfailed != 0)
      {
        testStepErrorInTestSystem(0, "1", "Unable to set value condition(s)");
      }
      ret = testWaitForAllJoinedEventsNS((int64)(5LL * 1000000000LL));
      if(setfailed == 0)
      {
        if(ret > 0)
        {
          testStepPass(2, "1", "Waited for occurrence of 2 value condition(s).");
        }
        else
        {
          testStepFail(0, "1", "Waited for occurrence of 2 value condition(s).");
        }
        _fct_TiTableHeadExpectedEx("");
        _fct_ChckRep(0, HKMC_LH_SBW::dbNode::LVR::LVR11::CF_Lvr_PNStat, "CAN signal \'CF_Lvr_PNStat\'", "==", 1LL, "Park Status");
        _fct_TiCellResult(((0!=getSignalTime(HKMC_LH_SBW::dbNode::LVR::LVR11::CF_Lvr_PNStat)) && CheckSignalMatch(HKMC_LH_SBW::dbNode::LVR::LVR11::CF_Lvr_PNStat, 1LL, "=") == 1));
        _fct_ChckRep(0, HKMC_LH_SBW::dbNode::LVR::LVR11::CF_Lvr_PRelStat, "CAN signal \'CF_Lvr_PRelStat\'", "==", 0LL, "Parking not released");
        _fct_TiCellResult(((0!=getSignalTime(HKMC_LH_SBW::dbNode::LVR::LVR11::CF_Lvr_PRelStat)) && CheckSignalMatch(HKMC_LH_SBW::dbNode::LVR::LVR11::CF_Lvr_PRelStat, 0LL, "=") == 1));
        _fct_TiTableEnd("", 0, 0);
      }
    }
  }
  // _ttg_!_6_1_1_23_4
  TestCommandEnd();
  if(_fct_DoStop(EVerdBOF_TC, 1))
  {
    _ttg_fct_completion_6_1_1_23_9(_ttg_var_G_SEL_DISP_value_of_notN_6_1_1_23_1_0);
    return;
  }
  {
    CreateCaplIFFunction("fromIGONToStandByMode", 0);
    _ttg_I0 = _ttg_var_G_SEL_DISP_value_of_notN_6_1_1_23_1_0;
    AddIFParameterInt(_ttg_I0);
    CallInterfaceFunction("fromIGONToStandByMode (G_SEL_DISP_value_of_notN=G_SEL_DISP_value_of_notN)");
    if(_fct_DoStop(EVerdBOF_TC, 1))
    {
      _ttg_fct_completion_6_1_1_23_9(_ttg_var_G_SEL_DISP_value_of_notN_6_1_1_23_1_0);
      return;
    }
  }
  {
    CreateCaplIFFunction("setDriverDoorStatus", 0);
    AddIFParameterInt(1LL);
    CallInterfaceFunction("set driver door open");
    if(_fct_DoStop(EVerdBOF_TC, 1))
    {
      _ttg_fct_completion_6_1_1_23_9(_ttg_var_G_SEL_DISP_value_of_notN_6_1_1_23_1_0);
      return;
    }
  }
  TestCommandBegin("Wait", "");
  {
    _fct_Wait("1", (int64)(1LL * 1000000000LL), 1000000000, "");
  }
  // _ttg_!_6_1_1_23_7
  TestCommandEnd();
  if(_fct_DoStop(EVerdBOF_TC, 1))
  {
    _ttg_fct_completion_6_1_1_23_9(_ttg_var_G_SEL_DISP_value_of_notN_6_1_1_23_1_0);
    return;
  }
  TestCommandBegin("CANoe Standard Service", "Do manual release and check if SBW will operate PRA to P position after 4s.");
  {
    testStep(2, "", "Execute testValidateTesterConfirmation(\"Do manual release and check if SBW will operate PRA to P position after 4s.\", \"check manual release\", 1)");
    testValidateTesterConfirmation("Do manual release and check if SBW will operate PRA to P position after 4s.", "check manual release", 1LL);
  }
  // _ttg_!_6_1_1_23_8
  TestCommandEnd();
  if(_fct_DoStop(EVerdBOF_TC, 1))
  {
    _ttg_fct_completion_6_1_1_23_9(_ttg_var_G_SEL_DISP_value_of_notN_6_1_1_23_1_0);
    return;
  }
  {
    // Completion
    _ttg_fct_completion_6_1_1_23_9(_ttg_var_G_SEL_DISP_value_of_notN_6_1_1_23_1_0);
  }
}
// _ttg_#_6_1_1_23
// 11.6.4 Valid P Switch Press
testcase _ttg_tc_tc_6_0_2_2()
{
  {
    // Preparation
    _ttg_fct_preparation_6_0_2_2_1();
    if(_fct_DoStop(EVerdBOF_TC, 1))
    {
      return;
    }
  }
  {
    CreateCaplIFFunction("clearDTC", 0);
    CallInterfaceFunction("clearDTC");
    if(_fct_DoStop(EVerdBOF_TC, 1))
    {
      return;
    }
  }
  {
    CreateCaplIFFunction("parkSwitchPress", 0);
    AddIFParameterInt(0LL);
    AddIFParameterChar("11.6.4 invalid P Switch Press.png");
    CallInterfaceFunction("Make an invalid P switch press");
    if(_fct_DoStop(EVerdBOF_TC, 1))
    {
      return;
    }
  }
  {
    CreateCaplIFFunction("readDTC", 0);
    AddIFParameterInt(0x3364LL);
    CallInterfaceFunction("check if DTC:C153364 P Switch Fault occurred");
    if(_fct_DoStop(EVerdBOF_TC, 1))
    {
      return;
    }
  }
}
// _ttg_#_6_0_2_2
// 11.6.5 Valid P-Release Switch Press
testcase _ttg_tc_tc_6_0_2_3()
{
  {
    CreateCaplIFFunction("clearDTC", 0);
    CallInterfaceFunction("clearDTC");
    if(_fct_DoStop(EVerdBOF_TC, 1))
    {
      return;
    }
  }
  {
    CreateCaplIFFunction("parkReleaseSwitchPress", 0);
    AddIFParameterInt(0LL);
    CallInterfaceFunction("Make an invalid P release switch press");
    if(_fct_DoStop(EVerdBOF_TC, 1))
    {
      return;
    }
  }
  {
    CreateCaplIFFunction("readDTC", 0);
    AddIFParameterInt(0x3364LL);
    CallInterfaceFunction("check if DTC:C153364 P-Release Switch Fault occurred");
    if(_fct_DoStop(EVerdBOF_TC, 1))
    {
      return;
    }
  }
}
// _ttg_#_6_0_2_3
// c. Mode Reset
testcase _ttg_tc_tc_6_0_7_3()
{
  TestCommandBegin("CAPL Inline", "Set engine running");
  {
    _ttg_fct_caplinline_6_0_7_3_3();
  }
  // _ttg_!_6_0_7_3_3
  TestCommandEnd();
  if(_fct_DoStop(EVerdBOF_TC, 1))
  {
    return;
  }
  {
    CreateCaplIFFunction("setVehicleSpeed", 0);
    AddIFParameterInt(1LL);
    AddIFParameterInt(1LL);
    CallInterfaceFunction("make vehicle stop");
    if(_fct_DoStop(EVerdBOF_TC, 1))
    {
      return;
    }
  }
  TestCommandBegin("CANoe Standard Service", "make sure that Park Release Switch be pressed for 5 s");
  {
    testStep(2, "", "Execute testValidateTesterConfirmation(\"when you are asked to press the park release switch,remeber to keep pressing for 5s\", \"5s press tip\", 1)");
    testValidateTesterConfirmation("when you are asked to press the park release switch,remeber to keep pressing for 5s", "5s press tip", 1LL);
  }
  // _ttg_!_6_0_7_3_7
  TestCommandEnd();
  if(_fct_DoStop(EVerdBOF_TC, 1))
  {
    return;
  }
  {
    CreateCaplIFFunction("parkReleaseSwitchPress", 0);
    AddIFParameterInt(1LL);
    CallInterfaceFunction("keep pressing P Release Switch for 5 s");
    if(_fct_DoStop(EVerdBOF_TC, 1))
    {
      return;
    }
  }
}
// _ttg_#_6_0_7_3
// 13.3 Backlight Illumination
testcase _ttg_tc_tc_6_0_8_1()
{
  {
    CreateCaplIFFunction("setIlluminationmode", 0);
    AddIFParameterInt(0LL);
    AddIFParameterInt(1LL);
    CallInterfaceFunction("set timeout mode");
    if(_fct_DoStop(EVerdBOF_TC, 1))
    {
      return;
    }
  }
  TestCommandBegin("CANoe Standard Service", "@timeout mode:check if SBW will control backlight PWM duty on 50%");
  {
    testStep(2, "", "Execute testValidateTesterConfirmation(\"@timeout mode:check if SBW will control backlight PWM duty on 50%\", \"check backlight illumination\", 1)");
    testValidateTesterConfirmation("@timeout mode:check if SBW will control backlight PWM duty on 50%", "check backlight illumination", 1LL);
  }
  // _ttg_!_6_0_8_1_2
  TestCommandEnd();
  if(_fct_DoStop(EVerdBOF_TC, 1))
  {
    return;
  }
  {
    CreateCaplIFFunction("setIlluminationmode", 0);
    AddIFParameterInt(1LL);
    AddIFParameterInt(1LL);
    CallInterfaceFunction("set day mode");
    if(_fct_DoStop(EVerdBOF_TC, 1))
    {
      return;
    }
  }
  TestCommandBegin("CANoe Standard Service", "@day mode:check if SBW will control backlight PWM duty on 100%");
  {
    testStep(2, "", "Execute testValidateTesterConfirmation(\"@day mode:check if SBW will control backlight PWM duty on 100%\", \"check backlight illumination\", 1)");
    testValidateTesterConfirmation("@day mode:check if SBW will control backlight PWM duty on 100%", "check backlight illumination", 1LL);
  }
  // _ttg_!_6_0_8_1_4
  TestCommandEnd();
  if(_fct_DoStop(EVerdBOF_TC, 1))
  {
    return;
  }
  {
    CreateCaplIFFunction("setIlluminationmode", 0);
    AddIFParameterInt(1LL);
    AddIFParameterInt(0LL);
    CallInterfaceFunction("set night mode");
    if(_fct_DoStop(EVerdBOF_TC, 1))
    {
      return;
    }
  }
  TestCommandBegin("CAPL Inline", "increase CF_Gway_RheostatLevel step by step(from 1 to 21)");
  {
    _ttg_fct_caplinline_6_0_8_1_6();
  }
  // _ttg_!_6_0_8_1_6
  TestCommandEnd();
  if(_fct_DoStop(EVerdBOF_TC, 1))
  {
    return;
  }
  TestCommandBegin("CANoe Standard Service", "@night mode:check if SBW will control backlight PWM duty according to Rheostat level");
  {
    testStep(2, "", "Execute testValidateTesterConfirmation(\"@night mode:check if SBW will control backlight PWM duty according to Rheostat level\", \"check indicator illumination\", 1)");
    testValidateTesterConfirmation("@night mode:check if SBW will control backlight PWM duty according to Rheostat level", "check indicator illumination", 1LL);
  }
  // _ttg_!_6_0_8_1_7
  TestCommandEnd();
  if(_fct_DoStop(EVerdBOF_TC, 1))
  {
    return;
  }
}
// _ttg_#_6_0_8_1
// 13.4.2.2-13.4.2.4 Operation:timeout mode,day mode,night mode
testcase _ttg_tc_tc_6_0_8_4()
{
  {
    CreateCaplIFFunction("setIlluminationmode", 0);
    AddIFParameterInt(0LL);
    AddIFParameterInt(1LL);
    CallInterfaceFunction("set timeout mode");
    if(_fct_DoStop(EVerdBOF_TC, 1))
    {
      _ttg_fct_completion_6_0_8_4_7();
      return;
    }
  }
  TestCommandBegin("CANoe Standard Service", "@timeout mode:check if SBW will control PWM duty on 50%");
  {
    testStep(2, "", "Execute testValidateTesterConfirmation(\"@timeout mode:check if SBW will control PWM duty on 50%\", \"check indicator illumination\", 1)");
    testValidateTesterConfirmation("@timeout mode:check if SBW will control PWM duty on 50%", "check indicator illumination", 1LL);
  }
  // _ttg_!_6_0_8_4_2
  TestCommandEnd();
  if(_fct_DoStop(EVerdBOF_TC, 1))
  {
    _ttg_fct_completion_6_0_8_4_7();
    return;
  }
  {
    CreateCaplIFFunction("setIlluminationmode", 0);
    AddIFParameterInt(1LL);
    AddIFParameterInt(1LL);
    CallInterfaceFunction("set day mode");
    if(_fct_DoStop(EVerdBOF_TC, 1))
    {
      _ttg_fct_completion_6_0_8_4_7();
      return;
    }
  }
  TestCommandBegin("CANoe Standard Service", "@day mode:check if SBW will control PWM duty on 100%");
  {
    testStep(2, "", "Execute testValidateTesterConfirmation(\"@day mode:check if SBW will control PWM duty on 100%\", \"check indicator illumination\", 1)");
    testValidateTesterConfirmation("@day mode:check if SBW will control PWM duty on 100%", "check indicator illumination", 1LL);
  }
  // _ttg_!_6_0_8_4_4
  TestCommandEnd();
  if(_fct_DoStop(EVerdBOF_TC, 1))
  {
    _ttg_fct_completion_6_0_8_4_7();
    return;
  }
  {
    CreateCaplIFFunction("setIlluminationmode", 0);
    AddIFParameterInt(1LL);
    AddIFParameterInt(0LL);
    CallInterfaceFunction("set night mode");
    if(_fct_DoStop(EVerdBOF_TC, 1))
    {
      _ttg_fct_completion_6_0_8_4_7();
      return;
    }
  }
  TestCommandBegin("CANoe Standard Service", "@night mode:check if SBW will control PWM duty on 50%");
  {
    testStep(2, "", "Execute testValidateTesterConfirmation(\"@night mode:check if SBW will control PWM duty on 50%\", \"check indicator illumination\", 1)");
    testValidateTesterConfirmation("@night mode:check if SBW will control PWM duty on 50%", "check indicator illumination", 1LL);
  }
  // _ttg_!_6_0_8_4_6
  TestCommandEnd();
  if(_fct_DoStop(EVerdBOF_TC, 1))
  {
    _ttg_fct_completion_6_0_8_4_7();
    return;
  }
  {
    // Completion
    _ttg_fct_completion_6_0_8_4_7();
  }
}
// _ttg_#_6_0_8_4
// 15.3.1.b IG ON Mode: If P Switch pressed ON while IGN ON and vehicle stop, SBW shall operate PRA to P position.
testcase _ttg_tc_tc_6_0_9_2()
{
  {
    // Preparation
    _ttg_fct_preparation_6_0_9_2_1();
    if(_fct_DoStop(EVerdBOF_TC, 1))
    {
      return;
    }
  }
  {
    CreateCaplIFFunction("SBWControlPRAByIGONTCURequest", 0);
    AddIFParameterInt(0LL);
    CallInterfaceFunction("Set PRA to not P position at initial");
    if(_fct_DoStop(EVerdBOF_TC, 1))
    {
      return;
    }
  }
  TestCommandBegin("Await Value Match", "check if SBW operate PRA to not P Position at initial");
  {
    dword eventTable[2];
    long ret, setfailed; setfailed = 0;
    if((int64)(5LL * 1000000000LL) < 0)
    {
      testStepErrorInTestSystem(0, "1", "Invalid wait time (< 0)");
    }
    else
    {
      eventTable[0] = testJoinSignal(HKMC_LH_SBW::dbNode::LVR::LVR11::CF_Lvr_PNStat, "_ttg_callback_awaitvaluematch_6_0_9_2_3_3", "CAN signal \'CF_Lvr_PNStat\'", 0);
      setfailed |= eventTable[0] < 0;
      eventTable[1] = testJoinSignal(HKMC_LH_SBW::dbNode::LVR::LVR11::CF_Lvr_PRelStat, "_ttg_callback_awaitvaluematch_6_0_9_2_3_4", "CAN signal \'CF_Lvr_PRelStat\'", 0);
      setfailed |= eventTable[1] < 0;
      if(setfailed != 0)
      {
        testStepErrorInTestSystem(0, "1", "Unable to set value condition(s)");
      }
      ret = testWaitForAllJoinedEventsNS((int64)(5LL * 1000000000LL));
      if(setfailed == 0)
      {
        if(ret > 0)
        {
          testStepPass(2, "1", "Waited for occurrence of 2 value condition(s).");
        }
        else
        {
          testStepFail(0, "1", "Waited for occurrence of 2 value condition(s).");
        }
        _fct_TiTableHeadExpectedEx("");
        _fct_ChckRep(0, HKMC_LH_SBW::dbNode::LVR::LVR11::CF_Lvr_PNStat, "CAN signal \'CF_Lvr_PNStat\'", "==", 2LL, "Not Park Status");
        _fct_TiCellResult(((0!=getSignalTime(HKMC_LH_SBW::dbNode::LVR::LVR11::CF_Lvr_PNStat)) && CheckSignalMatch(HKMC_LH_SBW::dbNode::LVR::LVR11::CF_Lvr_PNStat, 2LL, "=") == 1));
        _fct_ChckRep(0, HKMC_LH_SBW::dbNode::LVR::LVR11::CF_Lvr_PRelStat, "CAN signal \'CF_Lvr_PRelStat\'", "==", 1LL, "Parking released");
        _fct_TiCellResult(((0!=getSignalTime(HKMC_LH_SBW::dbNode::LVR::LVR11::CF_Lvr_PRelStat)) && CheckSignalMatch(HKMC_LH_SBW::dbNode::LVR::LVR11::CF_Lvr_PRelStat, 1LL, "=") == 1));
        _fct_TiTableEnd("", 0, 0);
      }
    }
  }
  // _ttg_!_6_0_9_2_3
  TestCommandEnd();
  if(_fct_DoStop(EVerdBOF_TC, 1))
  {
    return;
  }
  TestCommandBegin("CAPL Inline", "capture CF_Lvr_PNStat&CF_Lvr_PRelStat");
  {
    _ttg_fct_caplinline_6_0_9_2_4();
  }
  // _ttg_!_6_0_9_2_4
  TestCommandEnd();
  if(_fct_DoStop(EVerdBOF_TC, 1))
  {
    return;
  }
  {
    CreateCaplIFFunction("setVehicleSpeed", 0);
    AddIFParameterInt(1LL);
    AddIFParameterInt(1LL);
    CallInterfaceFunction("make vehicle stop");
    if(_fct_DoStop(EVerdBOF_TC, 1))
    {
      return;
    }
  }
  {
    CreateCaplIFFunction("parkSwitchPress", 0);
    AddIFParameterInt(1LL);
    AddIFParameterChar("15.3.1.b make a valid P switch press.png");
    CallInterfaceFunction("make a valid P switch press");
    if(_fct_DoStop(EVerdBOF_TC, 1))
    {
      return;
    }
  }
  TestCommandBegin("Await Value Match", "check if SBW operate PRA to P Position");
  {
    dword eventTable[2];
    long ret, setfailed; setfailed = 0;
    if((int64)(5LL * 1000000000LL) < 0)
    {
      testStepErrorInTestSystem(0, "1", "Invalid wait time (< 0)");
    }
    else
    {
      eventTable[0] = testJoinSignal(HKMC_LH_SBW::dbNode::LVR::LVR11::CF_Lvr_PNStat, "_ttg_callback_awaitvaluematch_6_0_9_2_9_3", "CAN signal \'CF_Lvr_PNStat\'", 0);
      setfailed |= eventTable[0] < 0;
      eventTable[1] = testJoinSignal(HKMC_LH_SBW::dbNode::LVR::LVR11::CF_Lvr_PRelStat, "_ttg_callback_awaitvaluematch_6_0_9_2_9_4", "CAN signal \'CF_Lvr_PRelStat\'", 0);
      setfailed |= eventTable[1] < 0;
      if(setfailed != 0)
      {
        testStepErrorInTestSystem(0, "1", "Unable to set value condition(s)");
      }
      ret = testWaitForAllJoinedEventsNS((int64)(5LL * 1000000000LL));
      if(setfailed == 0)
      {
        if(ret > 0)
        {
          testStepPass(2, "1", "Waited for occurrence of 2 value condition(s).");
        }
        else
        {
          testStepFail(0, "1", "Waited for occurrence of 2 value condition(s).");
        }
        _fct_TiTableHeadExpectedEx("");
        _fct_ChckRep(0, HKMC_LH_SBW::dbNode::LVR::LVR11::CF_Lvr_PNStat, "CAN signal \'CF_Lvr_PNStat\'", "==", 1LL, "Park Status");
        _fct_TiCellResult(((0!=getSignalTime(HKMC_LH_SBW::dbNode::LVR::LVR11::CF_Lvr_PNStat)) && CheckSignalMatch(HKMC_LH_SBW::dbNode::LVR::LVR11::CF_Lvr_PNStat, 1LL, "=") == 1));
        _fct_ChckRep(0, HKMC_LH_SBW::dbNode::LVR::LVR11::CF_Lvr_PRelStat, "CAN signal \'CF_Lvr_PRelStat\'", "==", 0LL, "Parking not released");
        _fct_TiCellResult(((0!=getSignalTime(HKMC_LH_SBW::dbNode::LVR::LVR11::CF_Lvr_PRelStat)) && CheckSignalMatch(HKMC_LH_SBW::dbNode::LVR::LVR11::CF_Lvr_PRelStat, 0LL, "=") == 1));
        _fct_TiTableEnd("", 0, 0);
      }
    }
  }
  // _ttg_!_6_0_9_2_9
  TestCommandEnd();
  if(_fct_DoStop(EVerdBOF_TC, 1))
  {
    return;
  }
  TestCommandBegin("CAPL Inline", "capture CF_Lvr_PNStat&CF_Lvr_PRelStat");
  {
    _ttg_fct_caplinline_6_0_9_2_10();
  }
  // _ttg_!_6_0_9_2_10
  TestCommandEnd();
  if(_fct_DoStop(EVerdBOF_TC, 1))
  {
    return;
  }
}
// _ttg_#_6_0_9_2
// 15.3.1.1.d TCU OFF: When P switch is pressed when vehicle is stopped, SBW shall operate PRA to P position
testcase _ttg_tc_tc_6_0_9_5()
{
  {
    // Preparation
    _ttg_fct_preparation_6_0_9_5_1();
    if(_fct_DoStop(EVerdBOF_TC, 1))
    {
      _ttg_fct_completion_6_0_9_5_11();
      return;
    }
  }
  {
    CreateCaplIFFunction("SBWControlPRAByIGONTCURequest", 0);
    AddIFParameterInt(0LL);
    CallInterfaceFunction("Set PRA to not P position at initial");
    if(_fct_DoStop(EVerdBOF_TC, 1))
    {
      _ttg_fct_completion_6_0_9_5_11();
      return;
    }
  }
  TestCommandBegin("Await Value Match", "check if SBW operate PRA to not P Position at initial");
  {
    dword eventTable[2];
    long ret, setfailed; setfailed = 0;
    if((int64)(5LL * 1000000000LL) < 0)
    {
      testStepErrorInTestSystem(0, "1", "Invalid wait time (< 0)");
    }
    else
    {
      eventTable[0] = testJoinSignal(HKMC_LH_SBW::dbNode::LVR::LVR11::CF_Lvr_PNStat, "_ttg_callback_awaitvaluematch_6_0_9_5_3_3", "CAN signal \'CF_Lvr_PNStat\'", 0);
      setfailed |= eventTable[0] < 0;
      eventTable[1] = testJoinSignal(HKMC_LH_SBW::dbNode::LVR::LVR11::CF_Lvr_PRelStat, "_ttg_callback_awaitvaluematch_6_0_9_5_3_4", "CAN signal \'CF_Lvr_PRelStat\'", 0);
      setfailed |= eventTable[1] < 0;
      if(setfailed != 0)
      {
        testStepErrorInTestSystem(0, "1", "Unable to set value condition(s)");
      }
      ret = testWaitForAllJoinedEventsNS((int64)(5LL * 1000000000LL));
      if(setfailed == 0)
      {
        if(ret > 0)
        {
          testStepPass(2, "1", "Waited for occurrence of 2 value condition(s).");
        }
        else
        {
          testStepFail(0, "1", "Waited for occurrence of 2 value condition(s).");
        }
        _fct_TiTableHeadExpectedEx("");
        _fct_ChckRep(0, HKMC_LH_SBW::dbNode::LVR::LVR11::CF_Lvr_PNStat, "CAN signal \'CF_Lvr_PNStat\'", "==", 2LL, "Not Park Status");
        _fct_TiCellResult(((0!=getSignalTime(HKMC_LH_SBW::dbNode::LVR::LVR11::CF_Lvr_PNStat)) && CheckSignalMatch(HKMC_LH_SBW::dbNode::LVR::LVR11::CF_Lvr_PNStat, 2LL, "=") == 1));
        _fct_ChckRep(0, HKMC_LH_SBW::dbNode::LVR::LVR11::CF_Lvr_PRelStat, "CAN signal \'CF_Lvr_PRelStat\'", "==", 1LL, "Parking released");
        _fct_TiCellResult(((0!=getSignalTime(HKMC_LH_SBW::dbNode::LVR::LVR11::CF_Lvr_PRelStat)) && CheckSignalMatch(HKMC_LH_SBW::dbNode::LVR::LVR11::CF_Lvr_PRelStat, 1LL, "=") == 1));
        _fct_TiTableEnd("", 0, 0);
      }
    }
  }
  // _ttg_!_6_0_9_5_3
  TestCommandEnd();
  if(_fct_DoStop(EVerdBOF_TC, 1))
  {
    _ttg_fct_completion_6_0_9_5_11();
    return;
  }
  TestCommandBegin("CAPL Inline", "capture CF_Lvr_PNStat&CF_Lvr_PRelStat at initial");
  {
    _ttg_fct_caplinline_6_0_9_5_4();
  }
  // _ttg_!_6_0_9_5_4
  TestCommandEnd();
  if(_fct_DoStop(EVerdBOF_TC, 1))
  {
    _ttg_fct_completion_6_0_9_5_11();
    return;
  }
  TestCommandBegin("CAPL Inline", "set G_SEL_DISP time out");
  {
    _ttg_fct_caplinline_6_0_9_5_5();
  }
  // _ttg_!_6_0_9_5_5
  TestCommandEnd();
  if(_fct_DoStop(EVerdBOF_TC, 1))
  {
    _ttg_fct_completion_6_0_9_5_11();
    return;
  }
  TestCommandBegin("Wait", "");
  {
    _fct_Wait("1", (int64)(1LL * 1000000000LL), 1000000000, "");
  }
  // _ttg_!_6_0_9_5_6
  TestCommandEnd();
  if(_fct_DoStop(EVerdBOF_TC, 1))
  {
    _ttg_fct_completion_6_0_9_5_11();
    return;
  }
  {
    CreateCaplIFFunction("setVehicleSpeed", 0);
    AddIFParameterInt(1LL);
    AddIFParameterInt(1LL);
    CallInterfaceFunction("make vehicle stop");
    if(_fct_DoStop(EVerdBOF_TC, 1))
    {
      _ttg_fct_completion_6_0_9_5_11();
      return;
    }
  }
  {
    CreateCaplIFFunction("parkSwitchPress", 0);
    AddIFParameterInt(1LL);
    AddIFParameterChar("15.3.1.1.d make a valid park switch press.png");
    CallInterfaceFunction("make a valid park switch press");
    if(_fct_DoStop(EVerdBOF_TC, 1))
    {
      _ttg_fct_completion_6_0_9_5_11();
      return;
    }
  }
  TestCommandBegin("Await Value Match", "check if SBW operate PRA to P position");
  {
    dword eventTable[2];
    long ret, setfailed; setfailed = 0;
    if((int64)(5LL * 1000000000LL) < 0)
    {
      testStepErrorInTestSystem(0, "1", "Invalid wait time (< 0)");
    }
    else
    {
      eventTable[0] = testJoinSignal(HKMC_LH_SBW::dbNode::LVR::LVR11::CF_Lvr_PNStat, "_ttg_callback_awaitvaluematch_6_0_9_5_9_3", "CAN signal \'CF_Lvr_PNStat\'", 0);
      setfailed |= eventTable[0] < 0;
      eventTable[1] = testJoinSignal(HKMC_LH_SBW::dbNode::LVR::LVR11::CF_Lvr_PRelStat, "_ttg_callback_awaitvaluematch_6_0_9_5_9_4", "CAN signal \'CF_Lvr_PRelStat\'", 0);
      setfailed |= eventTable[1] < 0;
      if(setfailed != 0)
      {
        testStepErrorInTestSystem(0, "1", "Unable to set value condition(s)");
      }
      ret = testWaitForAllJoinedEventsNS((int64)(5LL * 1000000000LL));
      if(setfailed == 0)
      {
        if(ret > 0)
        {
          testStepPass(2, "1", "Waited for occurrence of 2 value condition(s).");
        }
        else
        {
          testStepFail(0, "1", "Waited for occurrence of 2 value condition(s).");
        }
        _fct_TiTableHeadExpectedEx("");
        _fct_ChckRep(0, HKMC_LH_SBW::dbNode::LVR::LVR11::CF_Lvr_PNStat, "CAN signal \'CF_Lvr_PNStat\'", "==", 1LL, "Park Status");
        _fct_TiCellResult(((0!=getSignalTime(HKMC_LH_SBW::dbNode::LVR::LVR11::CF_Lvr_PNStat)) && CheckSignalMatch(HKMC_LH_SBW::dbNode::LVR::LVR11::CF_Lvr_PNStat, 1LL, "=") == 1));
        _fct_ChckRep(0, HKMC_LH_SBW::dbNode::LVR::LVR11::CF_Lvr_PRelStat, "CAN signal \'CF_Lvr_PRelStat\'", "==", 0LL, "Parking not released");
        _fct_TiCellResult(((0!=getSignalTime(HKMC_LH_SBW::dbNode::LVR::LVR11::CF_Lvr_PRelStat)) && CheckSignalMatch(HKMC_LH_SBW::dbNode::LVR::LVR11::CF_Lvr_PRelStat, 0LL, "=") == 1));
        _fct_TiTableEnd("", 0, 0);
      }
    }
  }
  // _ttg_!_6_0_9_5_9
  TestCommandEnd();
  if(_fct_DoStop(EVerdBOF_TC, 1))
  {
    _ttg_fct_completion_6_0_9_5_11();
    return;
  }
  TestCommandBegin("CAPL Inline", "capture CF_Lvr_PNStat&CF_Lvr_PRelStat at initial");
  {
    _ttg_fct_caplinline_6_0_9_5_10();
  }
  // _ttg_!_6_0_9_5_10
  TestCommandEnd();
  if(_fct_DoStop(EVerdBOF_TC, 1))
  {
    _ttg_fct_completion_6_0_9_5_11();
    return;
  }
  {
    // Completion
    _ttg_fct_completion_6_0_9_5_11();
  }
}
// _ttg_#_6_0_9_5
// 15.3.1.2.c TCU Request: During the activating to Not P position by receiving CF_Tcu_PrelReq = 0x1 from TCU, if receiving the CF_Tcu_PrelReq = 0x0 from TCU, then SBW shall operate PRA to P position immediately.
testcase _ttg_tc_tc_6_0_9_6()
{
  {
    // Preparation
    _ttg_fct_preparation_6_0_9_6_1();
    if(_fct_DoStop(EVerdBOF_TC, 1))
    {
      return;
    }
  }
  {
    CreateCaplIFFunction("SBWControlPRAByIGONTCURequest", 0);
    AddIFParameterInt(1LL);
    CallInterfaceFunction("Set PRA to P position at initial");
    if(_fct_DoStop(EVerdBOF_TC, 1))
    {
      return;
    }
  }
  TestCommandBegin("Await Value Match", "check if SBW operate PRA to P Position at initial");
  {
    dword eventTable[2];
    long ret, setfailed; setfailed = 0;
    if((int64)(5LL * 1000000000LL) < 0)
    {
      testStepErrorInTestSystem(0, "1", "Invalid wait time (< 0)");
    }
    else
    {
      eventTable[0] = testJoinSignal(HKMC_LH_SBW::dbNode::LVR::LVR11::CF_Lvr_PNStat, "_ttg_callback_awaitvaluematch_6_0_9_6_3_3", "CAN signal \'CF_Lvr_PNStat\'", 0);
      setfailed |= eventTable[0] < 0;
      eventTable[1] = testJoinSignal(HKMC_LH_SBW::dbNode::LVR::LVR11::CF_Lvr_PRelStat, "_ttg_callback_awaitvaluematch_6_0_9_6_3_4", "CAN signal \'CF_Lvr_PRelStat\'", 0);
      setfailed |= eventTable[1] < 0;
      if(setfailed != 0)
      {
        testStepErrorInTestSystem(0, "1", "Unable to set value condition(s)");
      }
      ret = testWaitForAllJoinedEventsNS((int64)(5LL * 1000000000LL));
      if(setfailed == 0)
      {
        if(ret > 0)
        {
          testStepPass(2, "1", "Waited for occurrence of 2 value condition(s).");
        }
        else
        {
          testStepFail(0, "1", "Waited for occurrence of 2 value condition(s).");
        }
        _fct_TiTableHeadExpectedEx("");
        _fct_ChckRep(0, HKMC_LH_SBW::dbNode::LVR::LVR11::CF_Lvr_PNStat, "CAN signal \'CF_Lvr_PNStat\'", "==", 1LL, "Park Status");
        _fct_TiCellResult(((0!=getSignalTime(HKMC_LH_SBW::dbNode::LVR::LVR11::CF_Lvr_PNStat)) && CheckSignalMatch(HKMC_LH_SBW::dbNode::LVR::LVR11::CF_Lvr_PNStat, 1LL, "=") == 1));
        _fct_ChckRep(0, HKMC_LH_SBW::dbNode::LVR::LVR11::CF_Lvr_PRelStat, "CAN signal \'CF_Lvr_PRelStat\'", "==", 0LL, "Parking not released");
        _fct_TiCellResult(((0!=getSignalTime(HKMC_LH_SBW::dbNode::LVR::LVR11::CF_Lvr_PRelStat)) && CheckSignalMatch(HKMC_LH_SBW::dbNode::LVR::LVR11::CF_Lvr_PRelStat, 0LL, "=") == 1));
        _fct_TiTableEnd("", 0, 0);
      }
    }
  }
  // _ttg_!_6_0_9_6_3
  TestCommandEnd();
  if(_fct_DoStop(EVerdBOF_TC, 1))
  {
    return;
  }
  TestCommandBegin("CAPL Inline", "capture CF_Lvr_PNStat&CF_Lvr_PRelStat at initial");
  {
    _ttg_fct_caplinline_6_0_9_6_4();
  }
  // _ttg_!_6_0_9_6_4
  TestCommandEnd();
  if(_fct_DoStop(EVerdBOF_TC, 1))
  {
    return;
  }
  {
    CreateCaplIFFunction("SBWControlPRAByIGONTCURequest", 0);
    AddIFParameterInt(0LL);
    CallInterfaceFunction("Set PRA to not P position");
    if(_fct_DoStop(EVerdBOF_TC, 1))
    {
      return;
    }
  }
  TestCommandBegin("Wait", "");
  {
    _fct_Wait("1", (int64)(300LL * 1000000LL), 1000000, "");
  }
  // _ttg_!_6_0_9_6_6
  TestCommandEnd();
  if(_fct_DoStop(EVerdBOF_TC, 1))
  {
    return;
  }
  {
    CreateCaplIFFunction("SBWControlPRAByIGONTCURequest", 0);
    AddIFParameterInt(1LL);
    CallInterfaceFunction("Set PRA to P position");
    if(_fct_DoStop(EVerdBOF_TC, 1))
    {
      return;
    }
  }
  TestCommandBegin("Await Value Match", "check if SBW operate PRA to P position immediately.");
  {
    dword eventTable[2];
    long ret, setfailed; setfailed = 0;
    if((int64)(5LL * 1000000000LL) < 0)
    {
      testStepErrorInTestSystem(0, "1", "Invalid wait time (< 0)");
    }
    else
    {
      eventTable[0] = testJoinSignal(HKMC_LH_SBW::dbNode::LVR::LVR11::CF_Lvr_PNStat, "_ttg_callback_awaitvaluematch_6_0_9_6_8_3", "CAN signal \'CF_Lvr_PNStat\'", 0);
      setfailed |= eventTable[0] < 0;
      eventTable[1] = testJoinSignal(HKMC_LH_SBW::dbNode::LVR::LVR11::CF_Lvr_PRelStat, "_ttg_callback_awaitvaluematch_6_0_9_6_8_4", "CAN signal \'CF_Lvr_PRelStat\'", 0);
      setfailed |= eventTable[1] < 0;
      if(setfailed != 0)
      {
        testStepErrorInTestSystem(0, "1", "Unable to set value condition(s)");
      }
      ret = testWaitForAllJoinedEventsNS((int64)(5LL * 1000000000LL));
      if(setfailed == 0)
      {
        if(ret > 0)
        {
          testStepPass(2, "1", "Waited for occurrence of 2 value condition(s).");
        }
        else
        {
          testStepFail(0, "1", "Waited for occurrence of 2 value condition(s).");
        }
        _fct_TiTableHeadExpectedEx("");
        _fct_ChckRep(0, HKMC_LH_SBW::dbNode::LVR::LVR11::CF_Lvr_PNStat, "CAN signal \'CF_Lvr_PNStat\'", "==", 1LL, "Park Status");
        _fct_TiCellResult(((0!=getSignalTime(HKMC_LH_SBW::dbNode::LVR::LVR11::CF_Lvr_PNStat)) && CheckSignalMatch(HKMC_LH_SBW::dbNode::LVR::LVR11::CF_Lvr_PNStat, 1LL, "=") == 1));
        _fct_ChckRep(0, HKMC_LH_SBW::dbNode::LVR::LVR11::CF_Lvr_PRelStat, "CAN signal \'CF_Lvr_PRelStat\'", "==", 0LL, "Parking not released");
        _fct_TiCellResult(((0!=getSignalTime(HKMC_LH_SBW::dbNode::LVR::LVR11::CF_Lvr_PRelStat)) && CheckSignalMatch(HKMC_LH_SBW::dbNode::LVR::LVR11::CF_Lvr_PRelStat, 0LL, "=") == 1));
        _fct_TiTableEnd("", 0, 0);
      }
    }
  }
  // _ttg_!_6_0_9_6_8
  TestCommandEnd();
  if(_fct_DoStop(EVerdBOF_TC, 1))
  {
    return;
  }
  TestCommandBegin("CAPL Inline", "capture CF_Lvr_PNStat&CF_Lvr_PRelStat at final");
  {
    _ttg_fct_caplinline_6_0_9_6_9();
  }
  // _ttg_!_6_0_9_6_9
  TestCommandEnd();
  if(_fct_DoStop(EVerdBOF_TC, 1))
  {
    return;
  }
}
// _ttg_#_6_0_9_6
// 15.3.1.2.d TCU Request: Otherwise SBW shall ignore TCU request, without any PRA operation.
testcase _ttg_tc_tc_6_0_9_7()
{
  {
    // Preparation
    _ttg_fct_preparation_6_0_9_7_1();
    if(_fct_DoStop(EVerdBOF_TC, 1))
    {
      return;
    }
  }
  {
    CreateCaplIFFunction("SBWControlPRAByIGONTCURequest", 0);
    AddIFParameterInt(0LL);
    CallInterfaceFunction("Set PRA to not P position at initial");
    if(_fct_DoStop(EVerdBOF_TC, 1))
    {
      return;
    }
  }
  TestCommandBegin("Await Value Match", "check if SBW operate PRA to not P Position at initial");
  {
    dword eventTable[2];
    long ret, setfailed; setfailed = 0;
    if((int64)(5LL * 1000000000LL) < 0)
    {
      testStepErrorInTestSystem(0, "1", "Invalid wait time (< 0)");
    }
    else
    {
      eventTable[0] = testJoinSignal(HKMC_LH_SBW::dbNode::LVR::LVR11::CF_Lvr_PNStat, "_ttg_callback_awaitvaluematch_6_0_9_7_3_3", "CAN signal \'CF_Lvr_PNStat\'", 0);
      setfailed |= eventTable[0] < 0;
      eventTable[1] = testJoinSignal(HKMC_LH_SBW::dbNode::LVR::LVR11::CF_Lvr_PRelStat, "_ttg_callback_awaitvaluematch_6_0_9_7_3_4", "CAN signal \'CF_Lvr_PRelStat\'", 0);
      setfailed |= eventTable[1] < 0;
      if(setfailed != 0)
      {
        testStepErrorInTestSystem(0, "1", "Unable to set value condition(s)");
      }
      ret = testWaitForAllJoinedEventsNS((int64)(5LL * 1000000000LL));
      if(setfailed == 0)
      {
        if(ret > 0)
        {
          testStepPass(2, "1", "Waited for occurrence of 2 value condition(s).");
        }
        else
        {
          testStepFail(0, "1", "Waited for occurrence of 2 value condition(s).");
        }
        _fct_TiTableHeadExpectedEx("");
        _fct_ChckRep(0, HKMC_LH_SBW::dbNode::LVR::LVR11::CF_Lvr_PNStat, "CAN signal \'CF_Lvr_PNStat\'", "==", 2LL, "Not Park Status");
        _fct_TiCellResult(((0!=getSignalTime(HKMC_LH_SBW::dbNode::LVR::LVR11::CF_Lvr_PNStat)) && CheckSignalMatch(HKMC_LH_SBW::dbNode::LVR::LVR11::CF_Lvr_PNStat, 2LL, "=") == 1));
        _fct_ChckRep(0, HKMC_LH_SBW::dbNode::LVR::LVR11::CF_Lvr_PRelStat, "CAN signal \'CF_Lvr_PRelStat\'", "==", 1LL, "Parking released");
        _fct_TiCellResult(((0!=getSignalTime(HKMC_LH_SBW::dbNode::LVR::LVR11::CF_Lvr_PRelStat)) && CheckSignalMatch(HKMC_LH_SBW::dbNode::LVR::LVR11::CF_Lvr_PRelStat, 1LL, "=") == 1));
        _fct_TiTableEnd("", 0, 0);
      }
    }
  }
  // _ttg_!_6_0_9_7_3
  TestCommandEnd();
  if(_fct_DoStop(EVerdBOF_TC, 1))
  {
    return;
  }
  TestCommandBegin("CAPL Inline", "capture CF_Lvr_PNStat&CF_Lvr_PRelStat at initial");
  {
    _ttg_fct_caplinline_6_0_9_7_4();
  }
  // _ttg_!_6_0_9_7_4
  TestCommandEnd();
  if(_fct_DoStop(EVerdBOF_TC, 1))
  {
    return;
  }
  {
    CreateCaplIFFunction("SBWControlPRAByIGONTCURequest", 0);
    AddIFParameterInt(1LL);
    CallInterfaceFunction("Set PRA to P position");
    if(_fct_DoStop(EVerdBOF_TC, 1))
    {
      return;
    }
  }
  TestCommandBegin("Wait", "");
  {
    _fct_Wait("1", (int64)(300LL * 1000000LL), 1000000, "");
  }
  // _ttg_!_6_0_9_7_6
  TestCommandEnd();
  if(_fct_DoStop(EVerdBOF_TC, 1))
  {
    return;
  }
  {
    CreateCaplIFFunction("SBWControlPRAByIGONTCURequest", 0);
    AddIFParameterInt(0LL);
    CallInterfaceFunction("try to Set PRA to not P position");
    if(_fct_DoStop(EVerdBOF_TC, 1))
    {
      return;
    }
  }
  TestCommandBegin("CANoe Standard Service", "check if SBW won't operate PRA to Not P position immediately.");
  {
    testStep(2, "", "Execute testValidateTesterConfirmation(\"check if SBW won\\\'t operate PRA to Not P position immediately.\", \"check PRA\", 1)");
    testValidateTesterConfirmation("check if SBW won\'t operate PRA to Not P position immediately.", "check PRA", 1LL);
  }
  // _ttg_!_6_0_9_7_8
  TestCommandEnd();
  if(_fct_DoStop(EVerdBOF_TC, 1))
  {
    return;
  }
  TestCommandBegin("CAPL Inline", "capture CF_Lvr_PNStat&CF_Lvr_PRelStat at initial");
  {
    _ttg_fct_caplinline_6_0_9_7_9();
  }
  // _ttg_!_6_0_9_7_9
  TestCommandEnd();
  if(_fct_DoStop(EVerdBOF_TC, 1))
  {
    return;
  }
}
// _ttg_#_6_0_9_7
// 15.3.3.a Gear N IG OFF Mode: SBW shall initially keep PRA to Not P position unless below condition happened.
testcase _ttg_tc_tc_6_0_11_1()
{
  {
    // Preparation
    _ttg_fct_preparation_6_0_11_1_1();
    if(_fct_DoStop(EVerdBOF_TC, 1))
    {
      _ttg_fct_completion_6_0_11_1_12();
      return;
    }
  }
  {
    CreateCaplIFFunction("SBWControlPRAByIGONTCURequest", 0);
    AddIFParameterInt(1LL);
    CallInterfaceFunction("Set PRA to P position at initial");
    if(_fct_DoStop(EVerdBOF_TC, 1))
    {
      _ttg_fct_completion_6_0_11_1_12();
      return;
    }
  }
  TestCommandBegin("Await Value Match", "check if SBW operate PRA to P Position at initial");
  {
    dword eventTable[2];
    long ret, setfailed; setfailed = 0;
    if((int64)(5LL * 1000000000LL) < 0)
    {
      testStepErrorInTestSystem(0, "1", "Invalid wait time (< 0)");
    }
    else
    {
      eventTable[0] = testJoinSignal(HKMC_LH_SBW::dbNode::LVR::LVR11::CF_Lvr_PNStat, "_ttg_callback_awaitvaluematch_6_0_11_1_3_3", "CAN signal \'CF_Lvr_PNStat\'", 0);
      setfailed |= eventTable[0] < 0;
      eventTable[1] = testJoinSignal(HKMC_LH_SBW::dbNode::LVR::LVR11::CF_Lvr_PRelStat, "_ttg_callback_awaitvaluematch_6_0_11_1_3_4", "CAN signal \'CF_Lvr_PRelStat\'", 0);
      setfailed |= eventTable[1] < 0;
      if(setfailed != 0)
      {
        testStepErrorInTestSystem(0, "1", "Unable to set value condition(s)");
      }
      ret = testWaitForAllJoinedEventsNS((int64)(5LL * 1000000000LL));
      if(setfailed == 0)
      {
        if(ret > 0)
        {
          testStepPass(2, "1", "Waited for occurrence of 2 value condition(s).");
        }
        else
        {
          testStepFail(0, "1", "Waited for occurrence of 2 value condition(s).");
        }
        _fct_TiTableHeadExpectedEx("");
        _fct_ChckRep(0, HKMC_LH_SBW::dbNode::LVR::LVR11::CF_Lvr_PNStat, "CAN signal \'CF_Lvr_PNStat\'", "==", 1LL, "Park Status");
        _fct_TiCellResult(((0!=getSignalTime(HKMC_LH_SBW::dbNode::LVR::LVR11::CF_Lvr_PNStat)) && CheckSignalMatch(HKMC_LH_SBW::dbNode::LVR::LVR11::CF_Lvr_PNStat, 1LL, "=") == 1));
        _fct_ChckRep(0, HKMC_LH_SBW::dbNode::LVR::LVR11::CF_Lvr_PRelStat, "CAN signal \'CF_Lvr_PRelStat\'", "==", 0LL, "Parking not released");
        _fct_TiCellResult(((0!=getSignalTime(HKMC_LH_SBW::dbNode::LVR::LVR11::CF_Lvr_PRelStat)) && CheckSignalMatch(HKMC_LH_SBW::dbNode::LVR::LVR11::CF_Lvr_PRelStat, 0LL, "=") == 1));
        _fct_TiTableEnd("", 0, 0);
      }
    }
  }
  // _ttg_!_6_0_11_1_3
  TestCommandEnd();
  if(_fct_DoStop(EVerdBOF_TC, 1))
  {
    _ttg_fct_completion_6_0_11_1_12();
    return;
  }
  TestCommandBegin("CAPL Inline", "capture CF_Lvr_PNStat&CF_Lvr_PRelStat");
  {
    _ttg_fct_caplinline_6_0_11_1_4();
  }
  // _ttg_!_6_0_11_1_4
  TestCommandEnd();
  if(_fct_DoStop(EVerdBOF_TC, 1))
  {
    _ttg_fct_completion_6_0_11_1_12();
    return;
  }
  {
    CreateCaplIFFunction("fromIGONToGearNIGOffMode", 0);
    CallInterfaceFunction("enter gear N IG off mode");
    if(_fct_DoStop(EVerdBOF_TC, 1))
    {
      _ttg_fct_completion_6_0_11_1_12();
      return;
    }
  }
  TestCommandBegin("Await Value Match", "check if SBW will operate PRA to not P position");
  {
    dword eventTable[2];
    long ret, setfailed; setfailed = 0;
    if((int64)(5LL * 1000000000LL) < 0)
    {
      testStepErrorInTestSystem(0, "1", "Invalid wait time (< 0)");
    }
    else
    {
      eventTable[0] = testJoinSignal(HKMC_LH_SBW::dbNode::LVR::LVR11::CF_Lvr_PNStat, "_ttg_callback_awaitvaluematch_6_0_11_1_6_3", "CAN signal \'CF_Lvr_PNStat\'", 0);
      setfailed |= eventTable[0] < 0;
      eventTable[1] = testJoinSignal(HKMC_LH_SBW::dbNode::LVR::LVR11::CF_Lvr_PRelStat, "_ttg_callback_awaitvaluematch_6_0_11_1_6_4", "CAN signal \'CF_Lvr_PRelStat\'", 0);
      setfailed |= eventTable[1] < 0;
      if(setfailed != 0)
      {
        testStepErrorInTestSystem(0, "1", "Unable to set value condition(s)");
      }
      ret = testWaitForAllJoinedEventsNS((int64)(5LL * 1000000000LL));
      if(setfailed == 0)
      {
        if(ret > 0)
        {
          testStepPass(2, "1", "Waited for occurrence of 2 value condition(s).");
        }
        else
        {
          testStepFail(0, "1", "Waited for occurrence of 2 value condition(s).");
        }
        _fct_TiTableHeadExpectedEx("");
        _fct_ChckRep(0, HKMC_LH_SBW::dbNode::LVR::LVR11::CF_Lvr_PNStat, "CAN signal \'CF_Lvr_PNStat\'", "==", 2LL, "Not Park Status");
        _fct_TiCellResult(((0!=getSignalTime(HKMC_LH_SBW::dbNode::LVR::LVR11::CF_Lvr_PNStat)) && CheckSignalMatch(HKMC_LH_SBW::dbNode::LVR::LVR11::CF_Lvr_PNStat, 2LL, "=") == 1));
        _fct_ChckRep(0, HKMC_LH_SBW::dbNode::LVR::LVR11::CF_Lvr_PRelStat, "CAN signal \'CF_Lvr_PRelStat\'", "==", 1LL, "Parking released");
        _fct_TiCellResult(((0!=getSignalTime(HKMC_LH_SBW::dbNode::LVR::LVR11::CF_Lvr_PRelStat)) && CheckSignalMatch(HKMC_LH_SBW::dbNode::LVR::LVR11::CF_Lvr_PRelStat, 1LL, "=") == 1));
        _fct_TiTableEnd("", 0, 0);
      }
    }
  }
  // _ttg_!_6_0_11_1_6
  TestCommandEnd();
  if(_fct_DoStop(EVerdBOF_TC, 1))
  {
    _ttg_fct_completion_6_0_11_1_12();
    return;
  }
  TestCommandBegin("CAPL Inline", "capture CF_Lvr_PNStat&CF_Lvr_PRelStat");
  {
    _ttg_fct_caplinline_6_0_11_1_7();
  }
  // _ttg_!_6_0_11_1_7
  TestCommandEnd();
  if(_fct_DoStop(EVerdBOF_TC, 1))
  {
    _ttg_fct_completion_6_0_11_1_12();
    return;
  }
  TestCommandBegin("CAPL Inline", "set door open (DRV or AST)");
  {
    _ttg_fct_caplinline_6_0_11_1_9();
  }
  // _ttg_!_6_0_11_1_9
  TestCommandEnd();
  if(_fct_DoStop(EVerdBOF_TC, 1))
  {
    _ttg_fct_completion_6_0_11_1_12();
    return;
  }
  TestCommandBegin("Await Value Match", "check if SBW will operate PRA to P position");
  {
    dword eventTable[2];
    long ret, setfailed; setfailed = 0;
    if((int64)(5LL * 1000000000LL) < 0)
    {
      testStepErrorInTestSystem(0, "1", "Invalid wait time (< 0)");
    }
    else
    {
      eventTable[0] = testJoinSignal(HKMC_LH_SBW::dbNode::LVR::LVR11::CF_Lvr_PNStat, "_ttg_callback_awaitvaluematch_6_0_11_1_10_3", "CAN signal \'CF_Lvr_PNStat\'", 0);
      setfailed |= eventTable[0] < 0;
      eventTable[1] = testJoinSignal(HKMC_LH_SBW::dbNode::LVR::LVR11::CF_Lvr_PRelStat, "_ttg_callback_awaitvaluematch_6_0_11_1_10_4", "CAN signal \'CF_Lvr_PRelStat\'", 0);
      setfailed |= eventTable[1] < 0;
      if(setfailed != 0)
      {
        testStepErrorInTestSystem(0, "1", "Unable to set value condition(s)");
      }
      ret = testWaitForAllJoinedEventsNS((int64)(5LL * 1000000000LL));
      if(setfailed == 0)
      {
        if(ret > 0)
        {
          testStepPass(2, "1", "Waited for occurrence of 2 value condition(s).");
        }
        else
        {
          testStepFail(0, "1", "Waited for occurrence of 2 value condition(s).");
        }
        _fct_TiTableHeadExpectedEx("");
        _fct_ChckRep(0, HKMC_LH_SBW::dbNode::LVR::LVR11::CF_Lvr_PNStat, "CAN signal \'CF_Lvr_PNStat\'", "==", 1LL, "Park Status");
        _fct_TiCellResult(((0!=getSignalTime(HKMC_LH_SBW::dbNode::LVR::LVR11::CF_Lvr_PNStat)) && CheckSignalMatch(HKMC_LH_SBW::dbNode::LVR::LVR11::CF_Lvr_PNStat, 1LL, "=") == 1));
        _fct_ChckRep(0, HKMC_LH_SBW::dbNode::LVR::LVR11::CF_Lvr_PRelStat, "CAN signal \'CF_Lvr_PRelStat\'", "==", 0LL, "Parking not released");
        _fct_TiCellResult(((0!=getSignalTime(HKMC_LH_SBW::dbNode::LVR::LVR11::CF_Lvr_PRelStat)) && CheckSignalMatch(HKMC_LH_SBW::dbNode::LVR::LVR11::CF_Lvr_PRelStat, 0LL, "=") == 1));
        _fct_TiTableEnd("", 0, 0);
      }
    }
  }
  // _ttg_!_6_0_11_1_10
  TestCommandEnd();
  if(_fct_DoStop(EVerdBOF_TC, 1))
  {
    _ttg_fct_completion_6_0_11_1_12();
    return;
  }
  TestCommandBegin("CAPL Inline", "capture CF_Lvr_PNStat&CF_Lvr_PRelStat");
  {
    _ttg_fct_caplinline_6_0_11_1_11();
  }
  // _ttg_!_6_0_11_1_11
  TestCommandEnd();
  if(_fct_DoStop(EVerdBOF_TC, 1))
  {
    _ttg_fct_completion_6_0_11_1_12();
    return;
  }
  {
    // Completion
    _ttg_fct_completion_6_0_11_1_12();
  }
}
// _ttg_#_6_0_11_1
// 15.3.3.b Gear N IG OFF Mode: While timeout, SBW shall operate PRA to P position
testcase _ttg_tc_tc_6_0_11_2()
{
  {
    // Preparation
    _ttg_fct_preparation_6_0_11_2_1();
    if(_fct_DoStop(EVerdBOF_TC, 1))
    {
      _ttg_fct_completion_6_0_11_2_13();
      return;
    }
  }
  {
    CreateCaplIFFunction("SBWControlPRAByIGONTCURequest", 0);
    AddIFParameterInt(1LL);
    CallInterfaceFunction("Set PRA to P position at initial");
    if(_fct_DoStop(EVerdBOF_TC, 1))
    {
      _ttg_fct_completion_6_0_11_2_13();
      return;
    }
  }
  TestCommandBegin("Await Value Match", "check if SBW operate PRA to P Position at initial");
  {
    dword eventTable[2];
    long ret, setfailed; setfailed = 0;
    if((int64)(5LL * 1000000000LL) < 0)
    {
      testStepErrorInTestSystem(0, "1", "Invalid wait time (< 0)");
    }
    else
    {
      eventTable[0] = testJoinSignal(HKMC_LH_SBW::dbNode::LVR::LVR11::CF_Lvr_PNStat, "_ttg_callback_awaitvaluematch_6_0_11_2_3_3", "CAN signal \'CF_Lvr_PNStat\'", 0);
      setfailed |= eventTable[0] < 0;
      eventTable[1] = testJoinSignal(HKMC_LH_SBW::dbNode::LVR::LVR11::CF_Lvr_PRelStat, "_ttg_callback_awaitvaluematch_6_0_11_2_3_4", "CAN signal \'CF_Lvr_PRelStat\'", 0);
      setfailed |= eventTable[1] < 0;
      if(setfailed != 0)
      {
        testStepErrorInTestSystem(0, "1", "Unable to set value condition(s)");
      }
      ret = testWaitForAllJoinedEventsNS((int64)(5LL * 1000000000LL));
      if(setfailed == 0)
      {
        if(ret > 0)
        {
          testStepPass(2, "1", "Waited for occurrence of 2 value condition(s).");
        }
        else
        {
          testStepFail(0, "1", "Waited for occurrence of 2 value condition(s).");
        }
        _fct_TiTableHeadExpectedEx("");
        _fct_ChckRep(0, HKMC_LH_SBW::dbNode::LVR::LVR11::CF_Lvr_PNStat, "CAN signal \'CF_Lvr_PNStat\'", "==", 1LL, "Park Status");
        _fct_TiCellResult(((0!=getSignalTime(HKMC_LH_SBW::dbNode::LVR::LVR11::CF_Lvr_PNStat)) && CheckSignalMatch(HKMC_LH_SBW::dbNode::LVR::LVR11::CF_Lvr_PNStat, 1LL, "=") == 1));
        _fct_ChckRep(0, HKMC_LH_SBW::dbNode::LVR::LVR11::CF_Lvr_PRelStat, "CAN signal \'CF_Lvr_PRelStat\'", "==", 0LL, "Parking not released");
        _fct_TiCellResult(((0!=getSignalTime(HKMC_LH_SBW::dbNode::LVR::LVR11::CF_Lvr_PRelStat)) && CheckSignalMatch(HKMC_LH_SBW::dbNode::LVR::LVR11::CF_Lvr_PRelStat, 0LL, "=") == 1));
        _fct_TiTableEnd("", 0, 0);
      }
    }
  }
  // _ttg_!_6_0_11_2_3
  TestCommandEnd();
  if(_fct_DoStop(EVerdBOF_TC, 1))
  {
    _ttg_fct_completion_6_0_11_2_13();
    return;
  }
  TestCommandBegin("CAPL Inline", "capture CF_Lvr_PNStat&CF_Lvr_PRelStat");
  {
    _ttg_fct_caplinline_6_0_11_2_4();
  }
  // _ttg_!_6_0_11_2_4
  TestCommandEnd();
  if(_fct_DoStop(EVerdBOF_TC, 1))
  {
    _ttg_fct_completion_6_0_11_2_13();
    return;
  }
  {
    CreateCaplIFFunction("fromIGONToGearNIGOffMode", 0);
    CallInterfaceFunction("fromIGONToGearNIGOffMode ()");
    if(_fct_DoStop(EVerdBOF_TC, 1))
    {
      _ttg_fct_completion_6_0_11_2_13();
      return;
    }
  }
  TestCommandBegin("Await Value Match", "check if SBW operate PRA to Not P position");
  {
    dword eventTable[2];
    long ret, setfailed; setfailed = 0;
    if((int64)(5LL * 1000000000LL) < 0)
    {
      testStepErrorInTestSystem(0, "1", "Invalid wait time (< 0)");
    }
    else
    {
      eventTable[0] = testJoinSignal(HKMC_LH_SBW::dbNode::LVR::LVR11::CF_Lvr_PNStat, "_ttg_callback_awaitvaluematch_6_0_11_2_6_3", "CAN signal \'CF_Lvr_PNStat\'", 0);
      setfailed |= eventTable[0] < 0;
      eventTable[1] = testJoinSignal(HKMC_LH_SBW::dbNode::LVR::LVR11::CF_Lvr_PRelStat, "_ttg_callback_awaitvaluematch_6_0_11_2_6_4", "CAN signal \'CF_Lvr_PRelStat\'", 0);
      setfailed |= eventTable[1] < 0;
      if(setfailed != 0)
      {
        testStepErrorInTestSystem(0, "1", "Unable to set value condition(s)");
      }
      ret = testWaitForAllJoinedEventsNS((int64)(5LL * 1000000000LL));
      if(setfailed == 0)
      {
        if(ret > 0)
        {
          testStepPass(2, "1", "Waited for occurrence of 2 value condition(s).");
        }
        else
        {
          testStepFail(0, "1", "Waited for occurrence of 2 value condition(s).");
        }
        _fct_TiTableHeadExpectedEx("");
        _fct_ChckRep(0, HKMC_LH_SBW::dbNode::LVR::LVR11::CF_Lvr_PNStat, "CAN signal \'CF_Lvr_PNStat\'", "==", 2LL, "Not Park Status");
        _fct_TiCellResult(((0!=getSignalTime(HKMC_LH_SBW::dbNode::LVR::LVR11::CF_Lvr_PNStat)) && CheckSignalMatch(HKMC_LH_SBW::dbNode::LVR::LVR11::CF_Lvr_PNStat, 2LL, "=") == 1));
        _fct_ChckRep(0, HKMC_LH_SBW::dbNode::LVR::LVR11::CF_Lvr_PRelStat, "CAN signal \'CF_Lvr_PRelStat\'", "==", 1LL, "Parking released");
        _fct_TiCellResult(((0!=getSignalTime(HKMC_LH_SBW::dbNode::LVR::LVR11::CF_Lvr_PRelStat)) && CheckSignalMatch(HKMC_LH_SBW::dbNode::LVR::LVR11::CF_Lvr_PRelStat, 1LL, "=") == 1));
        _fct_TiTableEnd("", 0, 0);
      }
    }
  }
  // _ttg_!_6_0_11_2_6
  TestCommandEnd();
  if(_fct_DoStop(EVerdBOF_TC, 1))
  {
    _ttg_fct_completion_6_0_11_2_13();
    return;
  }
  TestCommandBegin("CAPL Inline", "capture CF_Lvr_PNStat&CF_Lvr_PRelStat");
  {
    _ttg_fct_caplinline_6_0_11_2_7();
  }
  // _ttg_!_6_0_11_2_7
  TestCommandEnd();
  if(_fct_DoStop(EVerdBOF_TC, 1))
  {
    _ttg_fct_completion_6_0_11_2_13();
    return;
  }
  TestCommandBegin("Wait", "");
  {
    _fct_Wait("1", (int64)(1798LL * 1000000000LL), 1000000000, "");
  }
  // _ttg_!_6_0_11_2_8
  TestCommandEnd();
  if(_fct_DoStop(EVerdBOF_TC, 1))
  {
    _ttg_fct_completion_6_0_11_2_13();
    return;
  }
  TestCommandBegin("Await Value Match", "check if SBW operate PRA to P Position");
  {
    dword eventTable[2];
    long ret, setfailed; setfailed = 0;
    if((int64)(5LL * 1000000000LL) < 0)
    {
      testStepErrorInTestSystem(0, "1", "Invalid wait time (< 0)");
    }
    else
    {
      eventTable[0] = testJoinSignal(HKMC_LH_SBW::dbNode::LVR::LVR11::CF_Lvr_PNStat, "_ttg_callback_awaitvaluematch_6_0_11_2_11_3", "CAN signal \'CF_Lvr_PNStat\'", 0);
      setfailed |= eventTable[0] < 0;
      eventTable[1] = testJoinSignal(HKMC_LH_SBW::dbNode::LVR::LVR11::CF_Lvr_PRelStat, "_ttg_callback_awaitvaluematch_6_0_11_2_11_4", "CAN signal \'CF_Lvr_PRelStat\'", 0);
      setfailed |= eventTable[1] < 0;
      if(setfailed != 0)
      {
        testStepErrorInTestSystem(0, "1", "Unable to set value condition(s)");
      }
      ret = testWaitForAllJoinedEventsNS((int64)(5LL * 1000000000LL));
      if(setfailed == 0)
      {
        if(ret > 0)
        {
          testStepPass(2, "1", "Waited for occurrence of 2 value condition(s).");
        }
        else
        {
          testStepFail(0, "1", "Waited for occurrence of 2 value condition(s).");
        }
        _fct_TiTableHeadExpectedEx("");
        _fct_ChckRep(0, HKMC_LH_SBW::dbNode::LVR::LVR11::CF_Lvr_PNStat, "CAN signal \'CF_Lvr_PNStat\'", "==", 1LL, "Park Status");
        _fct_TiCellResult(((0!=getSignalTime(HKMC_LH_SBW::dbNode::LVR::LVR11::CF_Lvr_PNStat)) && CheckSignalMatch(HKMC_LH_SBW::dbNode::LVR::LVR11::CF_Lvr_PNStat, 1LL, "=") == 1));
        _fct_ChckRep(0, HKMC_LH_SBW::dbNode::LVR::LVR11::CF_Lvr_PRelStat, "CAN signal \'CF_Lvr_PRelStat\'", "==", 0LL, "Parking not released");
        _fct_TiCellResult(((0!=getSignalTime(HKMC_LH_SBW::dbNode::LVR::LVR11::CF_Lvr_PRelStat)) && CheckSignalMatch(HKMC_LH_SBW::dbNode::LVR::LVR11::CF_Lvr_PRelStat, 0LL, "=") == 1));
        _fct_TiTableEnd("", 0, 0);
      }
    }
  }
  // _ttg_!_6_0_11_2_11
  TestCommandEnd();
  if(_fct_DoStop(EVerdBOF_TC, 1))
  {
    _ttg_fct_completion_6_0_11_2_13();
    return;
  }
  TestCommandBegin("CAPL Inline", "capture CF_Lvr_PNStat&CF_Lvr_PRelStat");
  {
    _ttg_fct_caplinline_6_0_11_2_12();
  }
  // _ttg_!_6_0_11_2_12
  TestCommandEnd();
  if(_fct_DoStop(EVerdBOF_TC, 1))
  {
    _ttg_fct_completion_6_0_11_2_13();
    return;
  }
  {
    // Completion
    _ttg_fct_completion_6_0_11_2_13();
  }
}
// _ttg_#_6_0_11_2
// 15.3.5.b Manual Release Function: When IG ON, if driver do manual release, Waits 4 seconds, SBW shall operate PRA to P position.
testcase _ttg_tc_tc_6_0_13_2()
{
  {
    // Preparation
    _ttg_fct_preparation_6_0_13_2_1();
    if(_fct_DoStop(EVerdBOF_TC, 1))
    {
      return;
    }
  }
  {
    CreateCaplIFFunction("SBWControlPRAByIGONTCURequest", 0);
    AddIFParameterInt(1LL);
    CallInterfaceFunction("Set PRA to P position at initial");
    if(_fct_DoStop(EVerdBOF_TC, 1))
    {
      return;
    }
  }
  TestCommandBegin("Await Value Match", "check if SBW operate PRA to P Position at initial");
  {
    dword eventTable[2];
    long ret, setfailed; setfailed = 0;
    if((int64)(5LL * 1000000000LL) < 0)
    {
      testStepErrorInTestSystem(0, "1", "Invalid wait time (< 0)");
    }
    else
    {
      eventTable[0] = testJoinSignal(HKMC_LH_SBW::dbNode::LVR::LVR11::CF_Lvr_PNStat, "_ttg_callback_awaitvaluematch_6_0_13_2_3_3", "CAN signal \'CF_Lvr_PNStat\'", 0);
      setfailed |= eventTable[0] < 0;
      eventTable[1] = testJoinSignal(HKMC_LH_SBW::dbNode::LVR::LVR11::CF_Lvr_PRelStat, "_ttg_callback_awaitvaluematch_6_0_13_2_3_4", "CAN signal \'CF_Lvr_PRelStat\'", 0);
      setfailed |= eventTable[1] < 0;
      if(setfailed != 0)
      {
        testStepErrorInTestSystem(0, "1", "Unable to set value condition(s)");
      }
      ret = testWaitForAllJoinedEventsNS((int64)(5LL * 1000000000LL));
      if(setfailed == 0)
      {
        if(ret > 0)
        {
          testStepPass(2, "1", "Waited for occurrence of 2 value condition(s).");
        }
        else
        {
          testStepFail(0, "1", "Waited for occurrence of 2 value condition(s).");
        }
        _fct_TiTableHeadExpectedEx("");
        _fct_ChckRep(0, HKMC_LH_SBW::dbNode::LVR::LVR11::CF_Lvr_PNStat, "CAN signal \'CF_Lvr_PNStat\'", "==", 1LL, "Park Status");
        _fct_TiCellResult(((0!=getSignalTime(HKMC_LH_SBW::dbNode::LVR::LVR11::CF_Lvr_PNStat)) && CheckSignalMatch(HKMC_LH_SBW::dbNode::LVR::LVR11::CF_Lvr_PNStat, 1LL, "=") == 1));
        _fct_ChckRep(0, HKMC_LH_SBW::dbNode::LVR::LVR11::CF_Lvr_PRelStat, "CAN signal \'CF_Lvr_PRelStat\'", "==", 0LL, "Parking not released");
        _fct_TiCellResult(((0!=getSignalTime(HKMC_LH_SBW::dbNode::LVR::LVR11::CF_Lvr_PRelStat)) && CheckSignalMatch(HKMC_LH_SBW::dbNode::LVR::LVR11::CF_Lvr_PRelStat, 0LL, "=") == 1));
        _fct_TiTableEnd("", 0, 0);
      }
    }
  }
  // _ttg_!_6_0_13_2_3
  TestCommandEnd();
  if(_fct_DoStop(EVerdBOF_TC, 1))
  {
    return;
  }
  TestCommandBegin("Await Value Match", "check if SBW operate PRA to P Position at initial");
  {
    dword eventTable[2];
    long ret, setfailed; setfailed = 0;
    if((int64)(5LL * 1000000000LL) < 0)
    {
      testStepErrorInTestSystem(0, "1", "Invalid wait time (< 0)");
    }
    else
    {
      eventTable[0] = testJoinSignal(HKMC_LH_SBW::dbNode::LVR::LVR11::CF_Lvr_PNStat, "_ttg_callback_awaitvaluematch_6_0_13_2_4_3", "CAN signal \'CF_Lvr_PNStat\'", 0);
      setfailed |= eventTable[0] < 0;
      eventTable[1] = testJoinSignal(HKMC_LH_SBW::dbNode::LVR::LVR11::CF_Lvr_PRelStat, "_ttg_callback_awaitvaluematch_6_0_13_2_4_4", "CAN signal \'CF_Lvr_PRelStat\'", 0);
      setfailed |= eventTable[1] < 0;
      if(setfailed != 0)
      {
        testStepErrorInTestSystem(0, "1", "Unable to set value condition(s)");
      }
      ret = testWaitForAllJoinedEventsNS((int64)(5LL * 1000000000LL));
      if(setfailed == 0)
      {
        if(ret > 0)
        {
          testStepPass(2, "1", "Waited for occurrence of 2 value condition(s).");
        }
        else
        {
          testStepFail(0, "1", "Waited for occurrence of 2 value condition(s).");
        }
        _fct_TiTableHeadExpectedEx("");
        _fct_ChckRep(0, HKMC_LH_SBW::dbNode::LVR::LVR11::CF_Lvr_PNStat, "CAN signal \'CF_Lvr_PNStat\'", "==", 1LL, "Park Status");
        _fct_TiCellResult(((0!=getSignalTime(HKMC_LH_SBW::dbNode::LVR::LVR11::CF_Lvr_PNStat)) && CheckSignalMatch(HKMC_LH_SBW::dbNode::LVR::LVR11::CF_Lvr_PNStat, 1LL, "=") == 1));
        _fct_ChckRep(0, HKMC_LH_SBW::dbNode::LVR::LVR11::CF_Lvr_PRelStat, "CAN signal \'CF_Lvr_PRelStat\'", "==", 0LL, "Parking not released");
        _fct_TiCellResult(((0!=getSignalTime(HKMC_LH_SBW::dbNode::LVR::LVR11::CF_Lvr_PRelStat)) && CheckSignalMatch(HKMC_LH_SBW::dbNode::LVR::LVR11::CF_Lvr_PRelStat, 0LL, "=") == 1));
        _fct_TiTableEnd("", 0, 0);
      }
    }
  }
  // _ttg_!_6_0_13_2_4
  TestCommandEnd();
  if(_fct_DoStop(EVerdBOF_TC, 1))
  {
    return;
  }
  TestCommandBegin("CANoe Standard Service", "Do manual release and check if SBW will operate PRA to P position after 4s.");
  {
    testStep(2, "", "Execute testValidateTesterConfirmation(\"Do manual release and check if SBW will operate PRA to P position after 4s.\", \"check manual release\", 1)");
    testValidateTesterConfirmation("Do manual release and check if SBW will operate PRA to P position after 4s.", "check manual release", 1LL);
  }
  // _ttg_!_6_0_13_2_5
  TestCommandEnd();
  if(_fct_DoStop(EVerdBOF_TC, 1))
  {
    return;
  }
}
// _ttg_#_6_0_13_2
// 15.3.7.c Limp-Home function: IGN ON and PRA is not P position within low voltage range (8v-8.5v), then SBW shall operate PRA to P position.
testcase _ttg_tc_tc_6_0_15_1()
{
  {
    // Preparation
    _ttg_fct_preparation_6_0_15_1_1();
    if(_fct_DoStop(EVerdBOF_TC, 1))
    {
      _ttg_fct_completion_6_0_15_1_5();
      return;
    }
  }
  TestCommandBegin("CAPL Inline", "LimpHome Mode ON:battery voltage is 8.3v");
  {
    _ttg_fct_caplinline_6_0_15_1_2();
  }
  // _ttg_!_6_0_15_1_2
  TestCommandEnd();
  if(_fct_DoStop(EVerdBOF_TC, 1))
  {
    _ttg_fct_completion_6_0_15_1_5();
    return;
  }
  TestCommandBegin("Await Value Match", "check if SBW operate PRA to P Position");
  {
    dword eventTable[2];
    long ret, setfailed; setfailed = 0;
    if((int64)(5LL * 1000000000LL) < 0)
    {
      testStepErrorInTestSystem(0, "1", "Invalid wait time (< 0)");
    }
    else
    {
      eventTable[0] = testJoinSignal(HKMC_LH_SBW::dbNode::LVR::LVR11::CF_Lvr_PNStat, "_ttg_callback_awaitvaluematch_6_0_15_1_3_3", "CAN signal \'CF_Lvr_PNStat\'", 0);
      setfailed |= eventTable[0] < 0;
      eventTable[1] = testJoinSignal(HKMC_LH_SBW::dbNode::LVR::LVR11::CF_Lvr_PRelStat, "_ttg_callback_awaitvaluematch_6_0_15_1_3_4", "CAN signal \'CF_Lvr_PRelStat\'", 0);
      setfailed |= eventTable[1] < 0;
      if(setfailed != 0)
      {
        testStepErrorInTestSystem(0, "1", "Unable to set value condition(s)");
      }
      ret = testWaitForAllJoinedEventsNS((int64)(5LL * 1000000000LL));
      if(setfailed == 0)
      {
        if(ret > 0)
        {
          testStepPass(2, "1", "Waited for occurrence of 2 value condition(s).");
        }
        else
        {
          testStepFail(0, "1", "Waited for occurrence of 2 value condition(s).");
        }
        _fct_TiTableHeadExpectedEx("");
        _fct_ChckRep(0, HKMC_LH_SBW::dbNode::LVR::LVR11::CF_Lvr_PNStat, "CAN signal \'CF_Lvr_PNStat\'", "==", 1LL, "Park Status");
        _fct_TiCellResult(((0!=getSignalTime(HKMC_LH_SBW::dbNode::LVR::LVR11::CF_Lvr_PNStat)) && CheckSignalMatch(HKMC_LH_SBW::dbNode::LVR::LVR11::CF_Lvr_PNStat, 1LL, "=") == 1));
        _fct_ChckRep(0, HKMC_LH_SBW::dbNode::LVR::LVR11::CF_Lvr_PRelStat, "CAN signal \'CF_Lvr_PRelStat\'", "==", 0LL, "Parking not released");
        _fct_TiCellResult(((0!=getSignalTime(HKMC_LH_SBW::dbNode::LVR::LVR11::CF_Lvr_PRelStat)) && CheckSignalMatch(HKMC_LH_SBW::dbNode::LVR::LVR11::CF_Lvr_PRelStat, 0LL, "=") == 1));
        _fct_TiTableEnd("", 0, 0);
      }
    }
  }
  // _ttg_!_6_0_15_1_3
  TestCommandEnd();
  if(_fct_DoStop(EVerdBOF_TC, 1))
  {
    _ttg_fct_completion_6_0_15_1_5();
    return;
  }
  TestCommandBegin("CAPL Inline", "capture CF_Lvr_PNStat&CF_Lvr_PRelStat");
  {
    _ttg_fct_caplinline_6_0_15_1_4();
  }
  // _ttg_!_6_0_15_1_4
  TestCommandEnd();
  if(_fct_DoStop(EVerdBOF_TC, 1))
  {
    _ttg_fct_completion_6_0_15_1_5();
    return;
  }
  {
    // Completion
    _ttg_fct_completion_6_0_15_1_5();
  }
}
// _ttg_#_6_0_15_1
// 15.3.7.a IGN OFF and Determine a low voltage range (8v – 8.5v) and execute an operation command of “P” or “Not P” to PRA depending on the input of valid P switch press and valid P-Release switch press.
testcase _ttg_tc_tc_6_0_15_2()
{
  {
    // Preparation
    _ttg_fct_preparation_6_0_15_2_1();
    if(_fct_DoStop(EVerdBOF_TC, 1))
    {
      _ttg_fct_completion_6_0_15_2_8();
      return;
    }
  }
  {
    CreateCaplIFFunction("parkSwitchPress", 0);
    AddIFParameterInt(1LL);
    AddIFParameterChar("15.3.7.a make a valid park switch press.png");
    CallInterfaceFunction("make a valid park switch press");
    if(_fct_DoStop(EVerdBOF_TC, 1))
    {
      _ttg_fct_completion_6_0_15_2_8();
      return;
    }
  }
  TestCommandBegin("Await Value Match", "check if SBW operate PRA to P Position");
  {
    dword eventTable[2];
    long ret, setfailed; setfailed = 0;
    if((int64)(5LL * 1000000000LL) < 0)
    {
      testStepErrorInTestSystem(0, "1", "Invalid wait time (< 0)");
    }
    else
    {
      eventTable[0] = testJoinSignal(HKMC_LH_SBW::dbNode::LVR::LVR11::CF_Lvr_PNStat, "_ttg_callback_awaitvaluematch_6_0_15_2_3_3", "CAN signal \'CF_Lvr_PNStat\'", 0);
      setfailed |= eventTable[0] < 0;
      eventTable[1] = testJoinSignal(HKMC_LH_SBW::dbNode::LVR::LVR11::CF_Lvr_PRelStat, "_ttg_callback_awaitvaluematch_6_0_15_2_3_4", "CAN signal \'CF_Lvr_PRelStat\'", 0);
      setfailed |= eventTable[1] < 0;
      if(setfailed != 0)
      {
        testStepErrorInTestSystem(0, "1", "Unable to set value condition(s)");
      }
      ret = testWaitForAllJoinedEventsNS((int64)(5LL * 1000000000LL));
      if(setfailed == 0)
      {
        if(ret > 0)
        {
          testStepPass(2, "1", "Waited for occurrence of 2 value condition(s).");
        }
        else
        {
          testStepFail(0, "1", "Waited for occurrence of 2 value condition(s).");
        }
        _fct_TiTableHeadExpectedEx("");
        _fct_ChckRep(0, HKMC_LH_SBW::dbNode::LVR::LVR11::CF_Lvr_PNStat, "CAN signal \'CF_Lvr_PNStat\'", "==", 1LL, "Park Status");
        _fct_TiCellResult(((0!=getSignalTime(HKMC_LH_SBW::dbNode::LVR::LVR11::CF_Lvr_PNStat)) && CheckSignalMatch(HKMC_LH_SBW::dbNode::LVR::LVR11::CF_Lvr_PNStat, 1LL, "=") == 1));
        _fct_ChckRep(0, HKMC_LH_SBW::dbNode::LVR::LVR11::CF_Lvr_PRelStat, "CAN signal \'CF_Lvr_PRelStat\'", "==", 0LL, "Parking not released");
        _fct_TiCellResult(((0!=getSignalTime(HKMC_LH_SBW::dbNode::LVR::LVR11::CF_Lvr_PRelStat)) && CheckSignalMatch(HKMC_LH_SBW::dbNode::LVR::LVR11::CF_Lvr_PRelStat, 0LL, "=") == 1));
        _fct_TiTableEnd("", 0, 0);
      }
    }
  }
  // _ttg_!_6_0_15_2_3
  TestCommandEnd();
  if(_fct_DoStop(EVerdBOF_TC, 1))
  {
    _ttg_fct_completion_6_0_15_2_8();
    return;
  }
  TestCommandBegin("CAPL Inline", "capture CF_Lvr_PNStat&CF_Lvr_PRelStat");
  {
    _ttg_fct_caplinline_6_0_15_2_4();
  }
  // _ttg_!_6_0_15_2_4
  TestCommandEnd();
  if(_fct_DoStop(EVerdBOF_TC, 1))
  {
    _ttg_fct_completion_6_0_15_2_8();
    return;
  }
  {
    CreateCaplIFFunction("parkReleaseSwitchPress", 0);
    AddIFParameterInt(1LL);
    CallInterfaceFunction("make a valid park release switch press");
    if(_fct_DoStop(EVerdBOF_TC, 1))
    {
      _ttg_fct_completion_6_0_15_2_8();
      return;
    }
  }
  TestCommandBegin("Await Value Match", "check if SBW operate PRA to not P Position");
  {
    dword eventTable[2];
    long ret, setfailed; setfailed = 0;
    if((int64)(5LL * 1000000000LL) < 0)
    {
      testStepErrorInTestSystem(0, "1", "Invalid wait time (< 0)");
    }
    else
    {
      eventTable[0] = testJoinSignal(HKMC_LH_SBW::dbNode::LVR::LVR11::CF_Lvr_PNStat, "_ttg_callback_awaitvaluematch_6_0_15_2_6_3", "CAN signal \'CF_Lvr_PNStat\'", 0);
      setfailed |= eventTable[0] < 0;
      eventTable[1] = testJoinSignal(HKMC_LH_SBW::dbNode::LVR::LVR11::CF_Lvr_PRelStat, "_ttg_callback_awaitvaluematch_6_0_15_2_6_4", "CAN signal \'CF_Lvr_PRelStat\'", 0);
      setfailed |= eventTable[1] < 0;
      if(setfailed != 0)
      {
        testStepErrorInTestSystem(0, "1", "Unable to set value condition(s)");
      }
      ret = testWaitForAllJoinedEventsNS((int64)(5LL * 1000000000LL));
      if(setfailed == 0)
      {
        if(ret > 0)
        {
          testStepPass(2, "1", "Waited for occurrence of 2 value condition(s).");
        }
        else
        {
          testStepFail(0, "1", "Waited for occurrence of 2 value condition(s).");
        }
        _fct_TiTableHeadExpectedEx("");
        _fct_ChckRep(0, HKMC_LH_SBW::dbNode::LVR::LVR11::CF_Lvr_PNStat, "CAN signal \'CF_Lvr_PNStat\'", "==", 2LL, "Not Park Status");
        _fct_TiCellResult(((0!=getSignalTime(HKMC_LH_SBW::dbNode::LVR::LVR11::CF_Lvr_PNStat)) && CheckSignalMatch(HKMC_LH_SBW::dbNode::LVR::LVR11::CF_Lvr_PNStat, 2LL, "=") == 1));
        _fct_ChckRep(0, HKMC_LH_SBW::dbNode::LVR::LVR11::CF_Lvr_PRelStat, "CAN signal \'CF_Lvr_PRelStat\'", "==", 1LL, "Parking released");
        _fct_TiCellResult(((0!=getSignalTime(HKMC_LH_SBW::dbNode::LVR::LVR11::CF_Lvr_PRelStat)) && CheckSignalMatch(HKMC_LH_SBW::dbNode::LVR::LVR11::CF_Lvr_PRelStat, 1LL, "=") == 1));
        _fct_TiTableEnd("", 0, 0);
      }
    }
  }
  // _ttg_!_6_0_15_2_6
  TestCommandEnd();
  if(_fct_DoStop(EVerdBOF_TC, 1))
  {
    _ttg_fct_completion_6_0_15_2_8();
    return;
  }
  TestCommandBegin("CAPL Inline", "capture CF_Lvr_PNStat&CF_Lvr_PRelStat");
  {
    _ttg_fct_caplinline_6_0_15_2_7();
  }
  // _ttg_!_6_0_15_2_7
  TestCommandEnd();
  if(_fct_DoStop(EVerdBOF_TC, 1))
  {
    _ttg_fct_completion_6_0_15_2_8();
    return;
  }
  {
    // Completion
    _ttg_fct_completion_6_0_15_2_8();
  }
}
// _ttg_#_6_0_15_2
// P position
testcase _ttg_tc_tc_6_0_19_1()
{
  {
    CreateCaplIFFunction("setPRAPos", 0);
    AddIFParameterInt(1LL);
    AddIFParameterInt(1LL);
    CallInterfaceFunction("setPRAPos (PRAOutputValid=1, PRAPosStatusSetBySBW=1)");
    if(_fct_DoStop(EVerdBOF_TC, 1))
    {
      return;
    }
  }
}
// _ttg_#_6_0_19_1
// Not P position
testcase _ttg_tc_tc_6_0_19_2()
{
  {
    CreateCaplIFFunction("setPRAPos", 0);
    AddIFParameterInt(1LL);
    AddIFParameterInt(0LL);
    CallInterfaceFunction("setPRAPos (PRAOutputValid=1, PRAPosStatusSetBySBW=0)");
    if(_fct_DoStop(EVerdBOF_TC, 1))
    {
      return;
    }
  }
}
// _ttg_#_6_0_19_2
void _ttg_fct_preparation_6_1_1_0_2(int64 _ttg_var_canSigTimeoutBool_6_1_1_0_1_0, int64 _ttg_var_vehicleGearPosStatus_6_1_1_0_1_1)
{
  TestPreparationBegin();
  TestCommandBegin("CANoe Standard Service", "Prepare the graph to see CF_Lvr_PosInf ,CF_Lvr_PosCpl ,CF_Lvr_BkeAct easily");
  {
    testStep(2, "", "Execute testValidateTesterConfirmation(\"Prepare the graph to see CF_Lvr_PosInf ,CF_Lvr_PosCpl ,CF_Lvr_BkeAct easily\", \"Prepare the graph to see CF_Lvr_PosInf ,CF_Lvr_PosCpl ,CF_Lvr_BkeAct easily\", 1)");
    testValidateTesterConfirmation("Prepare the graph to see CF_Lvr_PosInf ,CF_Lvr_PosCpl ,CF_Lvr_BkeAct easily", "Prepare the graph to see CF_Lvr_PosInf ,CF_Lvr_PosCpl ,CF_Lvr_BkeAct easily", 1LL);
  }
  // _ttg_!_6_1_1_0_2_1
  TestCommandEnd();
  if(_fct_DoStop(EVerdBOF_None, 0))
  {
    TestPreparationEnd();
    return;
  }
  {
    CreateCaplIFFunction("setEngineRunningWithAllDoorsClosed", 0);
    CallInterfaceFunction("Set engine running,all doors closed at initial");
    if(_fct_DoStop(EVerdBOF_None, 0))
    {
      TestPreparationEnd();
      return;
    }
  }
  TestPreparationEnd();
}
// _ttg_#_6_1_1_0_2
void _ttg_fct_preparation_6_1_1_1_3(int64 _ttg_var_canSigTimeoutBool_6_1_1_1_1_0, int64 _ttg_var_vehicleGearPosStatus_6_1_1_1_1_1)
{
  TestPreparationBegin();
  TestCommandBegin("CANoe Standard Service", "Prepare the graph to see CF_Lvr_PosInf,CF_Lvr_ShfErrInf easily");
  {
    testStep(2, "", "Execute testValidateTesterConfirmation(\"Prepare the graph to see CF_Lvr_PosInf,CF_Lvr_ShfErrInf easily\", \"Prepare the graph to see CF_Lvr_PosInf,CF_Lvr_ShfErrInf easily\", 1)");
    testValidateTesterConfirmation("Prepare the graph to see CF_Lvr_PosInf,CF_Lvr_ShfErrInf easily", "Prepare the graph to see CF_Lvr_PosInf,CF_Lvr_ShfErrInf easily", 1LL);
  }
  // _ttg_!_6_1_1_1_3_1
  TestCommandEnd();
  if(_fct_DoStop(EVerdBOF_None, 0))
  {
    TestPreparationEnd();
    return;
  }
  {
    CreateCaplIFFunction("setEngineRunningWithAllDoorsClosed", 0);
    CallInterfaceFunction("Set engine running,all doors closed at initial");
    if(_fct_DoStop(EVerdBOF_None, 0))
    {
      TestPreparationEnd();
      return;
    }
  }
  TestPreparationEnd();
}
// _ttg_#_6_1_1_1_3
void _ttg_fct_preparation_6_1_1_2_2(int64 _ttg_var_canSigTimeoutBool_6_1_1_2_1_0, int64 _ttg_var_vehicleGearPosStatus_6_1_1_2_1_1)
{
  TestPreparationBegin();
  {
    CreateCaplIFFunction("setEngineRunningWithAllDoorsClosed", 0);
    CallInterfaceFunction("Set engine running,all doors closed at initial");
    if(_fct_DoStop(EVerdBOF_None, 0))
    {
      TestPreparationEnd();
      return;
    }
  }
  TestCommandBegin("CANoe Standard Service", "Prepare the graph to see CF_Lvr_PosInf ,CF_Lvr_PosCpl easily");
  {
    testStep(2, "", "Execute testValidateTesterConfirmation(\"Prepare the graph to see CF_Lvr_PosInf ,CF_Lvr_PosCpl easily\", \"Prepare the graph to see CF_Lvr_PosInf ,CF_Lvr_PosCpl easily\", 1)");
    testValidateTesterConfirmation("Prepare the graph to see CF_Lvr_PosInf ,CF_Lvr_PosCpl easily", "Prepare the graph to see CF_Lvr_PosInf ,CF_Lvr_PosCpl easily", 1LL);
  }
  // _ttg_!_6_1_1_2_2_3
  TestCommandEnd();
  if(_fct_DoStop(EVerdBOF_None, 0))
  {
    TestPreparationEnd();
    return;
  }
  TestPreparationEnd();
}
// _ttg_#_6_1_1_2_2
void _ttg_fct_preparation_6_1_1_3_3(int64 _ttg_var_canSigTimeoutBool_6_1_1_3_1_0)
{
  TestPreparationBegin();
  TestCommandBegin("CANoe Standard Service", "Prepare the graph to see CF_Lvr_PosInf,CF_Lvr_ShfErrInf easily");
  {
    testStep(2, "", "Execute testValidateTesterConfirmation(\"Prepare the graph to see CF_Lvr_PosInf,CF_Lvr_ShfErrInf easily\", \"Prepare the graph to see CF_Lvr_PosInf,CF_Lvr_ShfErrInf easily\", 1)");
    testValidateTesterConfirmation("Prepare the graph to see CF_Lvr_PosInf,CF_Lvr_ShfErrInf easily", "Prepare the graph to see CF_Lvr_PosInf,CF_Lvr_ShfErrInf easily", 1LL);
  }
  // _ttg_!_6_1_1_3_3_1
  TestCommandEnd();
  if(_fct_DoStop(EVerdBOF_None, 0))
  {
    TestPreparationEnd();
    return;
  }
  {
    CreateCaplIFFunction("setEngineRunningWithAllDoorsClosed", 0);
    CallInterfaceFunction("Set engine running,all doors closed at initial");
    if(_fct_DoStop(EVerdBOF_None, 0))
    {
      TestPreparationEnd();
      return;
    }
  }
  TestPreparationEnd();
}
// _ttg_#_6_1_1_3_3
void _ttg_fct_preparation_6_1_1_4_3(int64 _ttg_var_canSigTimeoutBool_6_1_1_4_1_0)
{
  TestPreparationBegin();
  TestCommandBegin("CANoe Standard Service", "Prepare the graph to see CF_Lvr_PosInf,CF_Lvr_ShfErrInf easily");
  {
    testStep(2, "", "Execute testValidateTesterConfirmation(\"Prepare the graph to see CF_Lvr_PosInf,CF_Lvr_ShfErrInf easily\", \"Prepare the graph to see CF_Lvr_PosInf,CF_Lvr_ShfErrInf easily\", 1)");
    testValidateTesterConfirmation("Prepare the graph to see CF_Lvr_PosInf,CF_Lvr_ShfErrInf easily", "Prepare the graph to see CF_Lvr_PosInf,CF_Lvr_ShfErrInf easily", 1LL);
  }
  // _ttg_!_6_1_1_4_3_1
  TestCommandEnd();
  if(_fct_DoStop(EVerdBOF_None, 0))
  {
    TestPreparationEnd();
    return;
  }
  {
    CreateCaplIFFunction("setEngineRunningWithAllDoorsClosed", 0);
    CallInterfaceFunction("Set engine running,all doors closed at initial");
    if(_fct_DoStop(EVerdBOF_None, 0))
    {
      TestPreparationEnd();
      return;
    }
  }
  TestPreparationEnd();
}
// _ttg_#_6_1_1_4_3
void _ttg_fct_preparation_6_1_1_5_2(int64 _ttg_var_canSigTimeoutBool_6_1_1_5_1_0, int64 _ttg_var_vehicleGearPosStatus_6_1_1_5_1_1)
{
  TestPreparationBegin();
  TestCommandBegin("CANoe Standard Service", "Prepare the graph to see CF_Lvr_PosInf ,CF_Lvr_PosCpl easily");
  {
    testStep(2, "", "Execute testValidateTesterConfirmation(\"Prepare the graph to see CF_Lvr_PosInf ,CF_Lvr_PosCpl easily\", \"Prepare the graph to see CF_Lvr_PosInf ,CF_Lvr_PosCpl easily\", 1)");
    testValidateTesterConfirmation("Prepare the graph to see CF_Lvr_PosInf ,CF_Lvr_PosCpl easily", "Prepare the graph to see CF_Lvr_PosInf ,CF_Lvr_PosCpl easily", 1LL);
  }
  // _ttg_!_6_1_1_5_2_1
  TestCommandEnd();
  if(_fct_DoStop(EVerdBOF_None, 0))
  {
    TestPreparationEnd();
    return;
  }
  {
    CreateCaplIFFunction("setEngineRunningWithAllDoorsClosed", 0);
    CallInterfaceFunction("Set engine running,all doors closed at initial");
    if(_fct_DoStop(EVerdBOF_None, 0))
    {
      TestPreparationEnd();
      return;
    }
  }
  TestPreparationEnd();
}
// _ttg_#_6_1_1_5_2
void _ttg_fct_preparation_6_1_1_6_3(int64 _ttg_var_canSigTimeoutBool_6_1_1_6_1_0, int64 _ttg_var_vehicleGearPosStatus_6_1_1_6_1_1)
{
  TestPreparationBegin();
  TestCommandBegin("CANoe Standard Service", "Prepare the graph to see CF_Lvr_PosInf,CF_Lvr_ShfErrInf easily");
  {
    testStep(2, "", "Execute testValidateTesterConfirmation(\"Prepare the graph to see CF_Lvr_PosInf,CF_Lvr_ShfErrInf easily\", \"Prepare the graph to see CF_Lvr_PosInf,CF_Lvr_ShfErrInf easily\", 1)");
    testValidateTesterConfirmation("Prepare the graph to see CF_Lvr_PosInf,CF_Lvr_ShfErrInf easily", "Prepare the graph to see CF_Lvr_PosInf,CF_Lvr_ShfErrInf easily", 1LL);
  }
  // _ttg_!_6_1_1_6_3_1
  TestCommandEnd();
  if(_fct_DoStop(EVerdBOF_None, 0))
  {
    TestPreparationEnd();
    return;
  }
  {
    CreateCaplIFFunction("setEngineRunningWithAllDoorsClosed", 0);
    CallInterfaceFunction("Set engine running,all doors closed at initial");
    if(_fct_DoStop(EVerdBOF_None, 0))
    {
      TestPreparationEnd();
      return;
    }
  }
  TestPreparationEnd();
}
// _ttg_#_6_1_1_6_3
void _ttg_fct_preparation_6_1_1_7_2(int64 _ttg_var_canSigTimeoutBool_6_1_1_7_1_0, int64 _ttg_var_vehicleGearPosStatus_6_1_1_7_1_1)
{
  TestPreparationBegin();
  TestCommandBegin("CANoe Standard Service", "Prepare the graph to see CF_Lvr_PosInf ,CF_Lvr_PosCpl,CF_Lvr_BkeAct easily");
  {
    testStep(2, "", "Execute testValidateTesterConfirmation(\"Prepare the graph to see CF_Lvr_PosInf ,CF_Lvr_PosCpl,CF_Lvr_BkeAct easily\", \"Prepare the graph to see CF_Lvr_PosInf ,CF_Lvr_PosCpl,CF_Lvr_BkeAct easily\", 1)");
    testValidateTesterConfirmation("Prepare the graph to see CF_Lvr_PosInf ,CF_Lvr_PosCpl,CF_Lvr_BkeAct easily", "Prepare the graph to see CF_Lvr_PosInf ,CF_Lvr_PosCpl,CF_Lvr_BkeAct easily", 1LL);
  }
  // _ttg_!_6_1_1_7_2_1
  TestCommandEnd();
  if(_fct_DoStop(EVerdBOF_None, 0))
  {
    TestPreparationEnd();
    return;
  }
  {
    CreateCaplIFFunction("setEngineRunningWithAllDoorsClosed", 0);
    CallInterfaceFunction("Set engine running,all doors closed at initial");
    if(_fct_DoStop(EVerdBOF_None, 0))
    {
      TestPreparationEnd();
      return;
    }
  }
  TestPreparationEnd();
}
// _ttg_#_6_1_1_7_2
void _ttg_fct_preparation_6_1_1_8_3(int64 _ttg_var_canSigTimeoutBool_6_1_1_8_1_0)
{
  TestPreparationBegin();
  TestCommandBegin("CANoe Standard Service", "Prepare the graph to see CF_Lvr_PosInf,CF_Lvr_ShfErrInf easily");
  {
    testStep(2, "", "Execute testValidateTesterConfirmation(\"Prepare the graph to see CF_Lvr_PosInf,CF_Lvr_ShfErrInf easily\", \"Prepare the graph to see CF_Lvr_PosInf,CF_Lvr_ShfErrInf easily\", 1)");
    testValidateTesterConfirmation("Prepare the graph to see CF_Lvr_PosInf,CF_Lvr_ShfErrInf easily", "Prepare the graph to see CF_Lvr_PosInf,CF_Lvr_ShfErrInf easily", 1LL);
  }
  // _ttg_!_6_1_1_8_3_1
  TestCommandEnd();
  if(_fct_DoStop(EVerdBOF_None, 0))
  {
    TestPreparationEnd();
    return;
  }
  {
    CreateCaplIFFunction("setEngineRunningWithAllDoorsClosed", 0);
    CallInterfaceFunction("Set engine running,all doors closed at initial");
    if(_fct_DoStop(EVerdBOF_None, 0))
    {
      TestPreparationEnd();
      return;
    }
  }
  TestPreparationEnd();
}
// _ttg_#_6_1_1_8_3
void _ttg_fct_preparation_6_1_1_9_3(int64 _ttg_var_canSigTimeoutBool_6_1_1_9_1_0)
{
  TestPreparationBegin();
  TestCommandBegin("CANoe Standard Service", "Prepare the graph to see CF_Lvr_PosInf,CF_Lvr_ShfErrInf easily");
  {
    testStep(2, "", "Execute testValidateTesterConfirmation(\"Prepare the graph to see CF_Lvr_PosInf,CF_Lvr_ShfErrInf easily\", \"Prepare the graph to see CF_Lvr_PosInf,CF_Lvr_ShfErrInf easily\", 1)");
    testValidateTesterConfirmation("Prepare the graph to see CF_Lvr_PosInf,CF_Lvr_ShfErrInf easily", "Prepare the graph to see CF_Lvr_PosInf,CF_Lvr_ShfErrInf easily", 1LL);
  }
  // _ttg_!_6_1_1_9_3_1
  TestCommandEnd();
  if(_fct_DoStop(EVerdBOF_None, 0))
  {
    TestPreparationEnd();
    return;
  }
  {
    CreateCaplIFFunction("setEngineRunningWithAllDoorsClosed", 0);
    CallInterfaceFunction("Set engine running,all doors closed at initial");
    if(_fct_DoStop(EVerdBOF_None, 0))
    {
      TestPreparationEnd();
      return;
    }
  }
  TestPreparationEnd();
}
// _ttg_#_6_1_1_9_3
void _ttg_fct_preparation_6_1_1_11_2(int64 _ttg_var_canSigTimeoutBool_6_1_1_11_1_0)
{
  TestPreparationBegin();
  TestCommandBegin("CANoe Standard Service", "Prepare the graph to see CF_Lvr_PosInf,CF_Lvr_PosCpl,CF_Lvr_BkeAct easily");
  {
    testStep(2, "", "Execute testValidateTesterConfirmation(\"Prepare the graph to see CF_Lvr_PosInf,CF_Lvr_PosCpl,CF_Lvr_BkeAct easily,timebase = 10s\", \"Prepare the graph to see CF_Lvr_PosInf,CF_Lvr_PosCpl,CF_Lvr_BkeAct easily\", 1)");
    testValidateTesterConfirmation("Prepare the graph to see CF_Lvr_PosInf,CF_Lvr_PosCpl,CF_Lvr_BkeAct easily,timebase = 10s", "Prepare the graph to see CF_Lvr_PosInf,CF_Lvr_PosCpl,CF_Lvr_BkeAct easily", 1LL);
  }
  // _ttg_!_6_1_1_11_2_1
  TestCommandEnd();
  if(_fct_DoStop(EVerdBOF_None, 0))
  {
    TestPreparationEnd();
    return;
  }
  TestPreparationEnd();
}
// _ttg_#_6_1_1_11_2
void _ttg_fct_preparation_6_1_1_13_2(int64 _ttg_var_canSigTimeoutBool_6_1_1_13_1_0, int64 _ttg_var_vehicleGearPosStatus_6_1_1_13_1_1)
{
  TestPreparationBegin();
  TestCommandBegin("CANoe Standard Service", "Prepare the graph to see CF_Tcu_PRelReq,G_SEL_DISP,CF_Lvr_PNStat,CF_Lvr_PRelStat easily");
  {
    testStep(2, "", "Execute testValidateTesterConfirmation(\"Prepare the graph to see CF_Tcu_PRelReq,G_SEL_DISP,CF_Lvr_PNStat,CF_Lvr_PRelStat easily\", \"Prepare the graph to see CF_Tcu_PRelReq,G_SEL_DISP,CF_Lvr_PNStat,CF_Lvr_PRelStat easily\", 1)");
    testValidateTesterConfirmation("Prepare the graph to see CF_Tcu_PRelReq,G_SEL_DISP,CF_Lvr_PNStat,CF_Lvr_PRelStat easily", "Prepare the graph to see CF_Tcu_PRelReq,G_SEL_DISP,CF_Lvr_PNStat,CF_Lvr_PRelStat easily", 1LL);
  }
  // _ttg_!_6_1_1_13_2_1
  TestCommandEnd();
  if(_fct_DoStop(EVerdBOF_None, 0))
  {
    TestPreparationEnd();
    return;
  }
  {
    CreateCaplIFFunction("setVehicleGearPos", 0);
    AddIFParameterInt(1LL);
    AddIFParameterInt(_ttg_var_canSigTimeoutBool_6_1_1_13_1_0);
    AddIFParameterInt(3LL);
    CallInterfaceFunction("set vehicleGearPosStatus = N");
    if(_fct_DoStop(EVerdBOF_None, 0))
    {
      TestPreparationEnd();
      return;
    }
  }
  TestCommandBegin("Wait", "");
  {
    _fct_Wait("1", (int64)(1LL * 1000000000LL), 1000000000, "");
  }
  // _ttg_!_6_1_1_13_2_3
  TestCommandEnd();
  if(_fct_DoStop(EVerdBOF_None, 0))
  {
    TestPreparationEnd();
    return;
  }
  {
    CreateCaplIFFunction("SBWControlPRAByIGONTCURequest", 0);
    AddIFParameterInt(0LL);
    CallInterfaceFunction("Set PRA to not P position at initial");
    if(_fct_DoStop(EVerdBOF_None, 0))
    {
      TestPreparationEnd();
      return;
    }
  }
  TestCommandBegin("Await Value Match", "check if SBW operate PRA to not P Position at initial");
  {
    dword eventTable[2];
    long ret, setfailed; setfailed = 0;
    if((int64)(5LL * 1000000000LL) < 0)
    {
      testStepErrorInTestSystem(0, "1", "Invalid wait time (< 0)");
    }
    else
    {
      eventTable[0] = testJoinSignal(HKMC_LH_SBW::dbNode::LVR::LVR11::CF_Lvr_PNStat, "_ttg_callback_awaitvaluematch_6_1_1_13_2_5_3", "CAN signal \'CF_Lvr_PNStat\'", 0);
      setfailed |= eventTable[0] < 0;
      eventTable[1] = testJoinSignal(HKMC_LH_SBW::dbNode::LVR::LVR11::CF_Lvr_PRelStat, "_ttg_callback_awaitvaluematch_6_1_1_13_2_5_4", "CAN signal \'CF_Lvr_PRelStat\'", 0);
      setfailed |= eventTable[1] < 0;
      if(setfailed != 0)
      {
        testStepErrorInTestSystem(0, "1", "Unable to set value condition(s)");
      }
      ret = testWaitForAllJoinedEventsNS((int64)(5LL * 1000000000LL));
      if(setfailed == 0)
      {
        if(ret > 0)
        {
          testStepPass(2, "1", "Waited for occurrence of 2 value condition(s).");
        }
        else
        {
          testStepFail(0, "1", "Waited for occurrence of 2 value condition(s).");
        }
        _fct_TiTableHeadExpectedEx("");
        _fct_ChckRep(0, HKMC_LH_SBW::dbNode::LVR::LVR11::CF_Lvr_PNStat, "CAN signal \'CF_Lvr_PNStat\'", "==", 2LL, "Not Park Status");
        _fct_TiCellResult(((0!=getSignalTime(HKMC_LH_SBW::dbNode::LVR::LVR11::CF_Lvr_PNStat)) && CheckSignalMatch(HKMC_LH_SBW::dbNode::LVR::LVR11::CF_Lvr_PNStat, 2LL, "=") == 1));
        _fct_ChckRep(0, HKMC_LH_SBW::dbNode::LVR::LVR11::CF_Lvr_PRelStat, "CAN signal \'CF_Lvr_PRelStat\'", "==", 1LL, "Parking released");
        _fct_TiCellResult(((0!=getSignalTime(HKMC_LH_SBW::dbNode::LVR::LVR11::CF_Lvr_PRelStat)) && CheckSignalMatch(HKMC_LH_SBW::dbNode::LVR::LVR11::CF_Lvr_PRelStat, 1LL, "=") == 1));
        _fct_TiTableEnd("", 0, 0);
      }
    }
  }
  // _ttg_!_6_1_1_13_2_5
  TestCommandEnd();
  if(_fct_DoStop(EVerdBOF_None, 0))
  {
    TestPreparationEnd();
    return;
  }
  TestPreparationEnd();
}
// _ttg_#_6_1_1_13_2
void _ttg_fct_completion_6_1_1_13_6(int64 _ttg_var_canSigTimeoutBool_6_1_1_13_1_0, int64 _ttg_var_vehicleGearPosStatus_6_1_1_13_1_1)
{
  TestCompletionBegin();
  TestCommandBegin("CAPL Inline", "testEnableMsg(\"TCU11\")");
  {
    _ttg_fct_caplinline_6_1_1_13_6_1();
  }
  // _ttg_!_6_1_1_13_6_1
  TestCommandEnd();
  TestCompletionEnd();
}
// _ttg_#_6_1_1_13_6
void _ttg_fct_preparation_6_1_1_14_2(int64 _ttg_var_G_SEL_DISP_value_of_D_6_1_1_14_1_0)
{
  TestPreparationBegin();
  TestCommandBegin("CANoe Standard Service", "Prepare the graph to see CF_Lvr_PNStat,CF_Lvr_PRelStat,CF_Tcu_PRelReq,G_SEL_DISP easily");
  {
    testStep(2, "", "Execute testValidateTesterConfirmation(\"Prepare the graph to see CF_Lvr_PNStat,CF_Lvr_PRelStat,CF_Tcu_PRelReq,G_SEL_DISP easily\", \"Prepare the graph to see CF_Lvr_PNStat,CF_Lvr_PRelStat,CF_Tcu_PRelReq,G_SEL_DISP easily\", 1)");
    testValidateTesterConfirmation("Prepare the graph to see CF_Lvr_PNStat,CF_Lvr_PRelStat,CF_Tcu_PRelReq,G_SEL_DISP easily", "Prepare the graph to see CF_Lvr_PNStat,CF_Lvr_PRelStat,CF_Tcu_PRelReq,G_SEL_DISP easily", 1LL);
  }
  // _ttg_!_6_1_1_14_2_1
  TestCommandEnd();
  if(_fct_DoStop(EVerdBOF_None, 0))
  {
    TestPreparationEnd();
    return;
  }
  {
    CreateCaplIFFunction("SBWControlPRAByIGONTCURequest", 0);
    AddIFParameterInt(1LL);
    CallInterfaceFunction("Set PRA to P position at initial");
    if(_fct_DoStop(EVerdBOF_None, 0))
    {
      TestPreparationEnd();
      return;
    }
  }
  TestCommandBegin("Await Value Match", "check if SBW operate PRA to P Position at initial");
  {
    dword eventTable[2];
    long ret, setfailed; setfailed = 0;
    if((int64)(5LL * 1000000000LL) < 0)
    {
      testStepErrorInTestSystem(0, "1", "Invalid wait time (< 0)");
    }
    else
    {
      eventTable[0] = testJoinSignal(HKMC_LH_SBW::dbNode::LVR::LVR11::CF_Lvr_PNStat, "_ttg_callback_awaitvaluematch_6_1_1_14_2_3_3", "CAN signal \'CF_Lvr_PNStat\'", 0);
      setfailed |= eventTable[0] < 0;
      eventTable[1] = testJoinSignal(HKMC_LH_SBW::dbNode::LVR::LVR11::CF_Lvr_PRelStat, "_ttg_callback_awaitvaluematch_6_1_1_14_2_3_4", "CAN signal \'CF_Lvr_PRelStat\'", 0);
      setfailed |= eventTable[1] < 0;
      if(setfailed != 0)
      {
        testStepErrorInTestSystem(0, "1", "Unable to set value condition(s)");
      }
      ret = testWaitForAllJoinedEventsNS((int64)(5LL * 1000000000LL));
      if(setfailed == 0)
      {
        if(ret > 0)
        {
          testStepPass(2, "1", "Waited for occurrence of 2 value condition(s).");
        }
        else
        {
          testStepFail(0, "1", "Waited for occurrence of 2 value condition(s).");
        }
        _fct_TiTableHeadExpectedEx("");
        _fct_ChckRep(0, HKMC_LH_SBW::dbNode::LVR::LVR11::CF_Lvr_PNStat, "CAN signal \'CF_Lvr_PNStat\'", "==", 1LL, "Park Status");
        _fct_TiCellResult(((0!=getSignalTime(HKMC_LH_SBW::dbNode::LVR::LVR11::CF_Lvr_PNStat)) && CheckSignalMatch(HKMC_LH_SBW::dbNode::LVR::LVR11::CF_Lvr_PNStat, 1LL, "=") == 1));
        _fct_ChckRep(0, HKMC_LH_SBW::dbNode::LVR::LVR11::CF_Lvr_PRelStat, "CAN signal \'CF_Lvr_PRelStat\'", "==", 0LL, "Parking not released");
        _fct_TiCellResult(((0!=getSignalTime(HKMC_LH_SBW::dbNode::LVR::LVR11::CF_Lvr_PRelStat)) && CheckSignalMatch(HKMC_LH_SBW::dbNode::LVR::LVR11::CF_Lvr_PRelStat, 0LL, "=") == 1));
        _fct_TiTableEnd("", 0, 0);
      }
    }
  }
  // _ttg_!_6_1_1_14_2_3
  TestCommandEnd();
  if(_fct_DoStop(EVerdBOF_None, 0))
  {
    TestPreparationEnd();
    return;
  }
  TestCommandBegin("CAPL Inline", "capture CF_Lvr_PNStat&CF_Lvr_PRelStat");
  {
    _ttg_fct_caplinline_6_1_1_14_2_4();
  }
  // _ttg_!_6_1_1_14_2_4
  TestCommandEnd();
  if(_fct_DoStop(EVerdBOF_None, 0))
  {
    TestPreparationEnd();
    return;
  }
  TestPreparationEnd();
}
// _ttg_#_6_1_1_14_2
void _ttg_fct_preparation_6_1_1_15_2(int64 _ttg_var_G_SEL_DISP_value_of_D_6_1_1_15_1_0)
{
  TestPreparationBegin();
  TestCommandBegin("CANoe Standard Service", "Prepare the graph to see CF_Lvr_PNStat,CF_Lvr_PRelStat,CF_Tcu_PRelReq,G_SEL_DISP easily");
  {
    testStep(2, "", "Execute testValidateTesterConfirmation(\"Prepare the graph to see CF_Lvr_PNStat,CF_Lvr_PRelStat,CF_Tcu_PRelReq,G_SEL_DISP easily\", \"Prepare the graph to see CF_Lvr_PNStat,CF_Lvr_PRelStat,CF_Tcu_PRelReq,G_SEL_DISP easily\", 1)");
    testValidateTesterConfirmation("Prepare the graph to see CF_Lvr_PNStat,CF_Lvr_PRelStat,CF_Tcu_PRelReq,G_SEL_DISP easily", "Prepare the graph to see CF_Lvr_PNStat,CF_Lvr_PRelStat,CF_Tcu_PRelReq,G_SEL_DISP easily", 1LL);
  }
  // _ttg_!_6_1_1_15_2_1
  TestCommandEnd();
  if(_fct_DoStop(EVerdBOF_None, 0))
  {
    TestPreparationEnd();
    return;
  }
  {
    CreateCaplIFFunction("SBWControlPRAByIGONTCURequest", 0);
    AddIFParameterInt(0LL);
    CallInterfaceFunction("Set PRA to not P position at initial");
    if(_fct_DoStop(EVerdBOF_None, 0))
    {
      TestPreparationEnd();
      return;
    }
  }
  TestCommandBegin("Await Value Match", "check if SBW operate PRA to not P Position at initial");
  {
    dword eventTable[2];
    long ret, setfailed; setfailed = 0;
    if((int64)(5LL * 1000000000LL) < 0)
    {
      testStepErrorInTestSystem(0, "1", "Invalid wait time (< 0)");
    }
    else
    {
      eventTable[0] = testJoinSignal(HKMC_LH_SBW::dbNode::LVR::LVR11::CF_Lvr_PNStat, "_ttg_callback_awaitvaluematch_6_1_1_15_2_3_3", "CAN signal \'CF_Lvr_PNStat\'", 0);
      setfailed |= eventTable[0] < 0;
      eventTable[1] = testJoinSignal(HKMC_LH_SBW::dbNode::LVR::LVR11::CF_Lvr_PRelStat, "_ttg_callback_awaitvaluematch_6_1_1_15_2_3_4", "CAN signal \'CF_Lvr_PRelStat\'", 0);
      setfailed |= eventTable[1] < 0;
      if(setfailed != 0)
      {
        testStepErrorInTestSystem(0, "1", "Unable to set value condition(s)");
      }
      ret = testWaitForAllJoinedEventsNS((int64)(5LL * 1000000000LL));
      if(setfailed == 0)
      {
        if(ret > 0)
        {
          testStepPass(2, "1", "Waited for occurrence of 2 value condition(s).");
        }
        else
        {
          testStepFail(0, "1", "Waited for occurrence of 2 value condition(s).");
        }
        _fct_TiTableHeadExpectedEx("");
        _fct_ChckRep(0, HKMC_LH_SBW::dbNode::LVR::LVR11::CF_Lvr_PNStat, "CAN signal \'CF_Lvr_PNStat\'", "==", 2LL, "Not Park Status");
        _fct_TiCellResult(((0!=getSignalTime(HKMC_LH_SBW::dbNode::LVR::LVR11::CF_Lvr_PNStat)) && CheckSignalMatch(HKMC_LH_SBW::dbNode::LVR::LVR11::CF_Lvr_PNStat, 2LL, "=") == 1));
        _fct_ChckRep(0, HKMC_LH_SBW::dbNode::LVR::LVR11::CF_Lvr_PRelStat, "CAN signal \'CF_Lvr_PRelStat\'", "==", 1LL, "Parking released");
        _fct_TiCellResult(((0!=getSignalTime(HKMC_LH_SBW::dbNode::LVR::LVR11::CF_Lvr_PRelStat)) && CheckSignalMatch(HKMC_LH_SBW::dbNode::LVR::LVR11::CF_Lvr_PRelStat, 1LL, "=") == 1));
        _fct_TiTableEnd("", 0, 0);
      }
    }
  }
  // _ttg_!_6_1_1_15_2_3
  TestCommandEnd();
  if(_fct_DoStop(EVerdBOF_None, 0))
  {
    TestPreparationEnd();
    return;
  }
  TestCommandBegin("CAPL Inline", "capture CF_Lvr_PNStat&CF_Lvr_PRelStat");
  {
    _ttg_fct_caplinline_6_1_1_15_2_4();
  }
  // _ttg_!_6_1_1_15_2_4
  TestCommandEnd();
  if(_fct_DoStop(EVerdBOF_None, 0))
  {
    TestPreparationEnd();
    return;
  }
  TestPreparationEnd();
}
// _ttg_#_6_1_1_15_2
void _ttg_fct_preparation_6_1_1_16_2(int64 _ttg_var_G_SEL_DISP_value_of_D_6_1_1_16_1_0)
{
  TestPreparationBegin();
  TestCommandBegin("CANoe Standard Service", "Prepare the graph to see CF_Tcu_PRelReq,G_SEL_DISP,CF_Lvr_PNStat,CF_Lvr_PRelStat easily");
  {
    testStep(2, "", "Execute testValidateTesterConfirmation(\"Prepare the graph to see CF_Tcu_PRelReq,G_SEL_DISP,CF_Lvr_PNStat,CF_Lvr_PRelStat easily\", \"Prepare the graph to see CF_Tcu_PRelReq,G_SEL_DISP,CF_Lvr_PNStat,CF_Lvr_PRelStat easily\", 1)");
    testValidateTesterConfirmation("Prepare the graph to see CF_Tcu_PRelReq,G_SEL_DISP,CF_Lvr_PNStat,CF_Lvr_PRelStat easily", "Prepare the graph to see CF_Tcu_PRelReq,G_SEL_DISP,CF_Lvr_PNStat,CF_Lvr_PRelStat easily", 1LL);
  }
  // _ttg_!_6_1_1_16_2_1
  TestCommandEnd();
  if(_fct_DoStop(EVerdBOF_None, 0))
  {
    TestPreparationEnd();
    return;
  }
  TestPreparationEnd();
}
// _ttg_#_6_1_1_16_2
void _ttg_fct_completion_6_1_1_16_11(int64 _ttg_var_G_SEL_DISP_value_of_D_6_1_1_16_1_0)
{
  TestCompletionBegin();
  TestCommandBegin("CAPL Inline", "set signal G_SEL_DISP enable");
  {
    _ttg_fct_caplinline_6_1_1_16_11_1();
  }
  // _ttg_!_6_1_1_16_11_1
  TestCommandEnd();
  TestCompletionEnd();
}
// _ttg_#_6_1_1_16_11
void _ttg_fct_preparation_6_1_1_17_2(int64 _ttg_var_G_SEL_DISP_value_of_PRorN_6_1_1_17_1_0)
{
  TestPreparationBegin();
  TestCommandBegin("CANoe Standard Service", "Prepare the graph to see CF_Tcu_PRelReq,G_SEL_DISP,CF_Lvr_PNStat,CF_Lvr_PRelStat easily");
  {
    testStep(2, "", "Execute testValidateTesterConfirmation(\"Prepare the graph to see CF_Tcu_PRelReq,G_SEL_DISP,CF_Lvr_PNStat,CF_Lvr_PRelStat easily\", \"Prepare the graph to see CF_Tcu_PRelReq,G_SEL_DISP,CF_Lvr_PNStat,CF_Lvr_PRelStat easily\", 1)");
    testValidateTesterConfirmation("Prepare the graph to see CF_Tcu_PRelReq,G_SEL_DISP,CF_Lvr_PNStat,CF_Lvr_PRelStat easily", "Prepare the graph to see CF_Tcu_PRelReq,G_SEL_DISP,CF_Lvr_PNStat,CF_Lvr_PRelStat easily", 1LL);
  }
  // _ttg_!_6_1_1_17_2_1
  TestCommandEnd();
  if(_fct_DoStop(EVerdBOF_None, 0))
  {
    TestPreparationEnd();
    return;
  }
  TestCommandBegin("CAPL Inline", "set last gear as P R or N");
  {
    _ttg_fct_caplinline_6_1_1_17_2_3(_ttg_var_G_SEL_DISP_value_of_PRorN_6_1_1_17_1_0);
  }
  // _ttg_!_6_1_1_17_2_3
  TestCommandEnd();
  if(_fct_DoStop(EVerdBOF_None, 0))
  {
    TestPreparationEnd();
    return;
  }
  TestCommandBegin("Wait", "");
  {
    _fct_Wait("1", (int64)(1LL * 1000000000LL), 1000000000, "");
  }
  // _ttg_!_6_1_1_17_2_4
  TestCommandEnd();
  if(_fct_DoStop(EVerdBOF_None, 0))
  {
    TestPreparationEnd();
    return;
  }
  {
    CreateCaplIFFunction("SBWControlPRAByIGONTCURequest", 0);
    AddIFParameterInt(0LL);
    CallInterfaceFunction("Set PRA to not P position at initial");
    if(_fct_DoStop(EVerdBOF_None, 0))
    {
      TestPreparationEnd();
      return;
    }
  }
  TestCommandBegin("Await Value Match", "check if SBW operate PRA to not P Position");
  {
    dword eventTable[2];
    long ret, setfailed; setfailed = 0;
    if((int64)(5LL * 1000000000LL) < 0)
    {
      testStepErrorInTestSystem(0, "1", "Invalid wait time (< 0)");
    }
    else
    {
      eventTable[0] = testJoinSignal(HKMC_LH_SBW::dbNode::LVR::LVR11::CF_Lvr_PNStat, "_ttg_callback_awaitvaluematch_6_1_1_17_2_6_3", "CAN signal \'CF_Lvr_PNStat\'", 0);
      setfailed |= eventTable[0] < 0;
      eventTable[1] = testJoinSignal(HKMC_LH_SBW::dbNode::LVR::LVR11::CF_Lvr_PRelStat, "_ttg_callback_awaitvaluematch_6_1_1_17_2_6_4", "CAN signal \'CF_Lvr_PRelStat\'", 0);
      setfailed |= eventTable[1] < 0;
      if(setfailed != 0)
      {
        testStepErrorInTestSystem(0, "1", "Unable to set value condition(s)");
      }
      ret = testWaitForAllJoinedEventsNS((int64)(5LL * 1000000000LL));
      if(setfailed == 0)
      {
        if(ret > 0)
        {
          testStepPass(2, "1", "Waited for occurrence of 2 value condition(s).");
        }
        else
        {
          testStepFail(0, "1", "Waited for occurrence of 2 value condition(s).");
        }
        _fct_TiTableHeadExpectedEx("");
        _fct_ChckRep(0, HKMC_LH_SBW::dbNode::LVR::LVR11::CF_Lvr_PNStat, "CAN signal \'CF_Lvr_PNStat\'", "==", 2LL, "Not Park Status");
        _fct_TiCellResult(((0!=getSignalTime(HKMC_LH_SBW::dbNode::LVR::LVR11::CF_Lvr_PNStat)) && CheckSignalMatch(HKMC_LH_SBW::dbNode::LVR::LVR11::CF_Lvr_PNStat, 2LL, "=") == 1));
        _fct_ChckRep(0, HKMC_LH_SBW::dbNode::LVR::LVR11::CF_Lvr_PRelStat, "CAN signal \'CF_Lvr_PRelStat\'", "==", 1LL, "Parking released");
        _fct_TiCellResult(((0!=getSignalTime(HKMC_LH_SBW::dbNode::LVR::LVR11::CF_Lvr_PRelStat)) && CheckSignalMatch(HKMC_LH_SBW::dbNode::LVR::LVR11::CF_Lvr_PRelStat, 1LL, "=") == 1));
        _fct_TiTableEnd("", 0, 0);
      }
    }
  }
  // _ttg_!_6_1_1_17_2_6
  TestCommandEnd();
  if(_fct_DoStop(EVerdBOF_None, 0))
  {
    TestPreparationEnd();
    return;
  }
  TestCommandBegin("CAPL Inline", "capture CF_Lvr_PNStat&CF_Lvr_PRelStat");
  {
    _ttg_fct_caplinline_6_1_1_17_2_7();
  }
  // _ttg_!_6_1_1_17_2_7
  TestCommandEnd();
  if(_fct_DoStop(EVerdBOF_None, 0))
  {
    TestPreparationEnd();
    return;
  }
  TestCommandBegin("CAPL Inline", "set signal G_SEL_DISP time out");
  {
    _ttg_fct_caplinline_6_1_1_17_2_8();
  }
  // _ttg_!_6_1_1_17_2_8
  TestCommandEnd();
  if(_fct_DoStop(EVerdBOF_None, 0))
  {
    TestPreparationEnd();
    return;
  }
  TestCommandBegin("Await Value Match", "check if SBW operate PRA to P Position");
  {
    dword eventTable[2];
    long ret, setfailed; setfailed = 0;
    if((int64)(5LL * 1000000000LL) < 0)
    {
      testStepErrorInTestSystem(0, "1", "Invalid wait time (< 0)");
    }
    else
    {
      eventTable[0] = testJoinSignal(HKMC_LH_SBW::dbNode::LVR::LVR11::CF_Lvr_PNStat, "_ttg_callback_awaitvaluematch_6_1_1_17_2_9_3", "CAN signal \'CF_Lvr_PNStat\'", 0);
      setfailed |= eventTable[0] < 0;
      eventTable[1] = testJoinSignal(HKMC_LH_SBW::dbNode::LVR::LVR11::CF_Lvr_PRelStat, "_ttg_callback_awaitvaluematch_6_1_1_17_2_9_4", "CAN signal \'CF_Lvr_PRelStat\'", 0);
      setfailed |= eventTable[1] < 0;
      if(setfailed != 0)
      {
        testStepErrorInTestSystem(0, "1", "Unable to set value condition(s)");
      }
      ret = testWaitForAllJoinedEventsNS((int64)(5LL * 1000000000LL));
      if(setfailed == 0)
      {
        if(ret > 0)
        {
          testStepPass(2, "1", "Waited for occurrence of 2 value condition(s).");
        }
        else
        {
          testStepFail(0, "1", "Waited for occurrence of 2 value condition(s).");
        }
        _fct_TiTableHeadExpectedEx("");
        _fct_ChckRep(0, HKMC_LH_SBW::dbNode::LVR::LVR11::CF_Lvr_PNStat, "CAN signal \'CF_Lvr_PNStat\'", "==", 1LL, "Park Status");
        _fct_TiCellResult(((0!=getSignalTime(HKMC_LH_SBW::dbNode::LVR::LVR11::CF_Lvr_PNStat)) && CheckSignalMatch(HKMC_LH_SBW::dbNode::LVR::LVR11::CF_Lvr_PNStat, 1LL, "=") == 1));
        _fct_ChckRep(0, HKMC_LH_SBW::dbNode::LVR::LVR11::CF_Lvr_PRelStat, "CAN signal \'CF_Lvr_PRelStat\'", "==", 0LL, "Parking not released");
        _fct_TiCellResult(((0!=getSignalTime(HKMC_LH_SBW::dbNode::LVR::LVR11::CF_Lvr_PRelStat)) && CheckSignalMatch(HKMC_LH_SBW::dbNode::LVR::LVR11::CF_Lvr_PRelStat, 0LL, "=") == 1));
        _fct_TiTableEnd("", 0, 0);
      }
    }
  }
  // _ttg_!_6_1_1_17_2_9
  TestCommandEnd();
  if(_fct_DoStop(EVerdBOF_None, 0))
  {
    TestPreparationEnd();
    return;
  }
  TestCommandBegin("CAPL Inline", "capture CF_Lvr_PNStat&CF_Lvr_PRelStat");
  {
    _ttg_fct_caplinline_6_1_1_17_2_10();
  }
  // _ttg_!_6_1_1_17_2_10
  TestCommandEnd();
  if(_fct_DoStop(EVerdBOF_None, 0))
  {
    TestPreparationEnd();
    return;
  }
  {
    CreateCaplIFFunction("SBWControlPRAByIGONTCURequest", 0);
    AddIFParameterInt(0LL);
    CallInterfaceFunction("try to operate PRA to not P position");
    if(_fct_DoStop(EVerdBOF_None, 0))
    {
      TestPreparationEnd();
      return;
    }
  }
  TestCommandBegin("Await Value Match", "check if PRA keep at P Position");
  {
    dword eventTable[2];
    long ret, setfailed; setfailed = 0;
    if((int64)(5LL * 1000000000LL) < 0)
    {
      testStepErrorInTestSystem(0, "1", "Invalid wait time (< 0)");
    }
    else
    {
      eventTable[0] = testJoinSignal(HKMC_LH_SBW::dbNode::LVR::LVR11::CF_Lvr_PNStat, "_ttg_callback_awaitvaluematch_6_1_1_17_2_12_3", "CAN signal \'CF_Lvr_PNStat\'", 0);
      setfailed |= eventTable[0] < 0;
      eventTable[1] = testJoinSignal(HKMC_LH_SBW::dbNode::LVR::LVR11::CF_Lvr_PRelStat, "_ttg_callback_awaitvaluematch_6_1_1_17_2_12_4", "CAN signal \'CF_Lvr_PRelStat\'", 0);
      setfailed |= eventTable[1] < 0;
      if(setfailed != 0)
      {
        testStepErrorInTestSystem(0, "1", "Unable to set value condition(s)");
      }
      ret = testWaitForAllJoinedEventsNS((int64)(5LL * 1000000000LL));
      if(setfailed == 0)
      {
        if(ret > 0)
        {
          testStepPass(2, "1", "Waited for occurrence of 2 value condition(s).");
        }
        else
        {
          testStepFail(0, "1", "Waited for occurrence of 2 value condition(s).");
        }
        _fct_TiTableHeadExpectedEx("");
        _fct_ChckRep(0, HKMC_LH_SBW::dbNode::LVR::LVR11::CF_Lvr_PNStat, "CAN signal \'CF_Lvr_PNStat\'", "==", 1LL, "Park Status");
        _fct_TiCellResult(((0!=getSignalTime(HKMC_LH_SBW::dbNode::LVR::LVR11::CF_Lvr_PNStat)) && CheckSignalMatch(HKMC_LH_SBW::dbNode::LVR::LVR11::CF_Lvr_PNStat, 1LL, "=") == 1));
        _fct_ChckRep(0, HKMC_LH_SBW::dbNode::LVR::LVR11::CF_Lvr_PRelStat, "CAN signal \'CF_Lvr_PRelStat\'", "==", 0LL, "Parking not released");
        _fct_TiCellResult(((0!=getSignalTime(HKMC_LH_SBW::dbNode::LVR::LVR11::CF_Lvr_PRelStat)) && CheckSignalMatch(HKMC_LH_SBW::dbNode::LVR::LVR11::CF_Lvr_PRelStat, 0LL, "=") == 1));
        _fct_TiTableEnd("", 0, 0);
      }
    }
  }
  // _ttg_!_6_1_1_17_2_12
  TestCommandEnd();
  if(_fct_DoStop(EVerdBOF_None, 0))
  {
    TestPreparationEnd();
    return;
  }
  TestCommandBegin("CAPL Inline", "capture CF_Lvr_PNStat&CF_Lvr_PRelStat");
  {
    _ttg_fct_caplinline_6_1_1_17_2_13();
  }
  // _ttg_!_6_1_1_17_2_13
  TestCommandEnd();
  if(_fct_DoStop(EVerdBOF_None, 0))
  {
    TestPreparationEnd();
    return;
  }
  {
    CreateCaplIFFunction("setIgnStatus", 0);
    AddIFParameterInt(0LL);
    CallInterfaceFunction("set IGN off");
    if(_fct_DoStop(EVerdBOF_None, 0))
    {
      TestPreparationEnd();
      return;
    }
  }
  TestCommandBegin("Wait", "");
  {
    _fct_Wait("1", (int64)(2LL * 1000000000LL), 1000000000, "");
  }
  // _ttg_!_6_1_1_17_2_15
  TestCommandEnd();
  if(_fct_DoStop(EVerdBOF_None, 0))
  {
    TestPreparationEnd();
    return;
  }
  {
    CreateCaplIFFunction("setIgnStatus", 0);
    AddIFParameterInt(1LL);
    CallInterfaceFunction("set IGN on");
    if(_fct_DoStop(EVerdBOF_None, 0))
    {
      TestPreparationEnd();
      return;
    }
  }
  TestCommandBegin("Wait", "");
  {
    _fct_Wait("1", (int64)(2LL * 1000000000LL), 1000000000, "");
  }
  // _ttg_!_6_1_1_17_2_17
  TestCommandEnd();
  if(_fct_DoStop(EVerdBOF_None, 0))
  {
    TestPreparationEnd();
    return;
  }
  {
    CreateCaplIFFunction("SBWControlPRAByIGONTCURequest", 0);
    AddIFParameterInt(0LL);
    CallInterfaceFunction("try to operate PRA to not P position");
    if(_fct_DoStop(EVerdBOF_None, 0))
    {
      TestPreparationEnd();
      return;
    }
  }
  TestCommandBegin("Await Value Match", "check if SBW operate PRA to not P Position");
  {
    dword eventTable[2];
    long ret, setfailed; setfailed = 0;
    if((int64)(5LL * 1000000000LL) < 0)
    {
      testStepErrorInTestSystem(0, "1", "Invalid wait time (< 0)");
    }
    else
    {
      eventTable[0] = testJoinSignal(HKMC_LH_SBW::dbNode::LVR::LVR11::CF_Lvr_PNStat, "_ttg_callback_awaitvaluematch_6_1_1_17_2_19_3", "CAN signal \'CF_Lvr_PNStat\'", 0);
      setfailed |= eventTable[0] < 0;
      eventTable[1] = testJoinSignal(HKMC_LH_SBW::dbNode::LVR::LVR11::CF_Lvr_PRelStat, "_ttg_callback_awaitvaluematch_6_1_1_17_2_19_4", "CAN signal \'CF_Lvr_PRelStat\'", 0);
      setfailed |= eventTable[1] < 0;
      if(setfailed != 0)
      {
        testStepErrorInTestSystem(0, "1", "Unable to set value condition(s)");
      }
      ret = testWaitForAllJoinedEventsNS((int64)(5LL * 1000000000LL));
      if(setfailed == 0)
      {
        if(ret > 0)
        {
          testStepPass(2, "1", "Waited for occurrence of 2 value condition(s).");
        }
        else
        {
          testStepFail(0, "1", "Waited for occurrence of 2 value condition(s).");
        }
        _fct_TiTableHeadExpectedEx("");
        _fct_ChckRep(0, HKMC_LH_SBW::dbNode::LVR::LVR11::CF_Lvr_PNStat, "CAN signal \'CF_Lvr_PNStat\'", "==", 2LL, "Not Park Status");
        _fct_TiCellResult(((0!=getSignalTime(HKMC_LH_SBW::dbNode::LVR::LVR11::CF_Lvr_PNStat)) && CheckSignalMatch(HKMC_LH_SBW::dbNode::LVR::LVR11::CF_Lvr_PNStat, 2LL, "=") == 1));
        _fct_ChckRep(0, HKMC_LH_SBW::dbNode::LVR::LVR11::CF_Lvr_PRelStat, "CAN signal \'CF_Lvr_PRelStat\'", "==", 1LL, "Parking released");
        _fct_TiCellResult(((0!=getSignalTime(HKMC_LH_SBW::dbNode::LVR::LVR11::CF_Lvr_PRelStat)) && CheckSignalMatch(HKMC_LH_SBW::dbNode::LVR::LVR11::CF_Lvr_PRelStat, 1LL, "=") == 1));
        _fct_TiTableEnd("", 0, 0);
      }
    }
  }
  // _ttg_!_6_1_1_17_2_19
  TestCommandEnd();
  if(_fct_DoStop(EVerdBOF_None, 0))
  {
    TestPreparationEnd();
    return;
  }
  TestCommandBegin("CAPL Inline", "capture CF_Lvr_PNStat&CF_Lvr_PRelStat");
  {
    _ttg_fct_caplinline_6_1_1_17_2_20();
  }
  // _ttg_!_6_1_1_17_2_20
  TestCommandEnd();
  if(_fct_DoStop(EVerdBOF_None, 0))
  {
    TestPreparationEnd();
    return;
  }
  TestPreparationEnd();
}
// _ttg_#_6_1_1_17_2
void _ttg_fct_completion_6_1_1_17_3(int64 _ttg_var_G_SEL_DISP_value_of_PRorN_6_1_1_17_1_0)
{
  TestCompletionBegin();
  TestCommandBegin("CAPL Inline", "set signal G_SEL_DISP enable");
  {
    _ttg_fct_caplinline_6_1_1_17_3_1();
  }
  // _ttg_!_6_1_1_17_3_1
  TestCommandEnd();
  TestCompletionEnd();
}
// _ttg_#_6_1_1_17_3
void _ttg_fct_preparation_6_1_1_18_2(int64 _ttg_var_G_SEL_DISP_value_of_notN_6_1_1_18_1_0)
{
  TestPreparationBegin();
  TestCommandBegin("CANoe Standard Service", "Prepare the graph to see CF_Lvr_PNStat,CF_Lvr_PRelStat,CF_Tcu_PRelReq,G_SEL_DISP easily");
  {
    testStep(2, "", "Execute testValidateTesterConfirmation(\"Prepare the graph to see CF_Lvr_PNStat,CF_Lvr_PRelStat,CF_Tcu_PRelReq,G_SEL_DISP easily\", \"Prepare the graph to see CF_Lvr_PNStat,CF_Lvr_PRelStat,CF_Tcu_PRelReq,G_SEL_DISP easily\", 1)");
    testValidateTesterConfirmation("Prepare the graph to see CF_Lvr_PNStat,CF_Lvr_PRelStat,CF_Tcu_PRelReq,G_SEL_DISP easily", "Prepare the graph to see CF_Lvr_PNStat,CF_Lvr_PRelStat,CF_Tcu_PRelReq,G_SEL_DISP easily", 1LL);
  }
  // _ttg_!_6_1_1_18_2_1
  TestCommandEnd();
  if(_fct_DoStop(EVerdBOF_None, 0))
  {
    TestPreparationEnd();
    return;
  }
  {
    CreateCaplIFFunction("SBWControlPRAByIGONTCURequest", 0);
    AddIFParameterInt(1LL);
    CallInterfaceFunction("Set PRA to P position at initial");
    if(_fct_DoStop(EVerdBOF_None, 0))
    {
      TestPreparationEnd();
      return;
    }
  }
  TestCommandBegin("Await Value Match", "check if SBW operate PRA to P position at initial");
  {
    dword eventTable[2];
    long ret, setfailed; setfailed = 0;
    if((int64)(5LL * 1000000000LL) < 0)
    {
      testStepErrorInTestSystem(0, "1", "Invalid wait time (< 0)");
    }
    else
    {
      eventTable[0] = testJoinSignal(HKMC_LH_SBW::dbNode::LVR::LVR11::CF_Lvr_PNStat, "_ttg_callback_awaitvaluematch_6_1_1_18_2_3_3", "CAN signal \'CF_Lvr_PNStat\'", 0);
      setfailed |= eventTable[0] < 0;
      eventTable[1] = testJoinSignal(HKMC_LH_SBW::dbNode::LVR::LVR11::CF_Lvr_PRelStat, "_ttg_callback_awaitvaluematch_6_1_1_18_2_3_4", "CAN signal \'CF_Lvr_PRelStat\'", 0);
      setfailed |= eventTable[1] < 0;
      if(setfailed != 0)
      {
        testStepErrorInTestSystem(0, "1", "Unable to set value condition(s)");
      }
      ret = testWaitForAllJoinedEventsNS((int64)(5LL * 1000000000LL));
      if(setfailed == 0)
      {
        if(ret > 0)
        {
          testStepPass(2, "1", "Waited for occurrence of 2 value condition(s).");
        }
        else
        {
          testStepFail(0, "1", "Waited for occurrence of 2 value condition(s).");
        }
        _fct_TiTableHeadExpectedEx("");
        _fct_ChckRep(0, HKMC_LH_SBW::dbNode::LVR::LVR11::CF_Lvr_PNStat, "CAN signal \'CF_Lvr_PNStat\'", "==", 1LL, "Park Status");
        _fct_TiCellResult(((0!=getSignalTime(HKMC_LH_SBW::dbNode::LVR::LVR11::CF_Lvr_PNStat)) && CheckSignalMatch(HKMC_LH_SBW::dbNode::LVR::LVR11::CF_Lvr_PNStat, 1LL, "=") == 1));
        _fct_ChckRep(0, HKMC_LH_SBW::dbNode::LVR::LVR11::CF_Lvr_PRelStat, "CAN signal \'CF_Lvr_PRelStat\'", "==", 0LL, "Parking not released");
        _fct_TiCellResult(((0!=getSignalTime(HKMC_LH_SBW::dbNode::LVR::LVR11::CF_Lvr_PRelStat)) && CheckSignalMatch(HKMC_LH_SBW::dbNode::LVR::LVR11::CF_Lvr_PRelStat, 0LL, "=") == 1));
        _fct_TiTableEnd("", 0, 0);
      }
    }
  }
  // _ttg_!_6_1_1_18_2_3
  TestCommandEnd();
  if(_fct_DoStop(EVerdBOF_None, 0))
  {
    TestPreparationEnd();
    return;
  }
  TestCommandBegin("CAPL Inline", "capture CF_Lvr_PNStat&CF_Lvr_PRelStat");
  {
    _ttg_fct_caplinline_6_1_1_18_2_4();
  }
  // _ttg_!_6_1_1_18_2_4
  TestCommandEnd();
  if(_fct_DoStop(EVerdBOF_None, 0))
  {
    TestPreparationEnd();
    return;
  }
  TestPreparationEnd();
}
// _ttg_#_6_1_1_18_2
void _ttg_fct_completion_6_1_1_18_12(int64 _ttg_var_G_SEL_DISP_value_of_notN_6_1_1_18_1_0)
{
  TestCompletionBegin();
  {
    CreateCaplIFFunction("setIgnStatus", 0);
    AddIFParameterInt(1LL);
    CallInterfaceFunction("IGN ON");
  }
  TestCompletionEnd();
}
// _ttg_#_6_1_1_18_12
void _ttg_fct_preparation_6_1_1_19_2(int64 _ttg_var_G_SEL_DISP_value_of_notN_6_1_1_19_1_0)
{
  TestPreparationBegin();
  TestCommandBegin("CANoe Standard Service", "Prepare the graph to see CF_Tcu_PRelReq,CF_Lvr_PRelStat,CF_Lvr_PNStat,CF_Lvr_PosInf,CF_Lvr_BkeAct easily");
  {
    testStep(2, "", "Execute testValidateTesterConfirmation(\"Prepare the graph to see CF_Tcu_PRelReq,CF_Lvr_PRelStat,CF_Lvr_PNStat,CF_Lvr_PosInf,CF_Lvr_BkeAct easily\", \"Prepare the graph to see CF_Tcu_PRelReq,CF_Lvr_PRelStat,CF_Lvr_PNStat,CF_Lvr_PosInf,CF_Lvr_BkeAct easily\", 1)");
    testValidateTesterConfirmation("Prepare the graph to see CF_Tcu_PRelReq,CF_Lvr_PRelStat,CF_Lvr_PNStat,CF_Lvr_PosInf,CF_Lvr_BkeAct easily", "Prepare the graph to see CF_Tcu_PRelReq,CF_Lvr_PRelStat,CF_Lvr_PNStat,CF_Lvr_PosInf,CF_Lvr_BkeAct easily", 1LL);
  }
  // _ttg_!_6_1_1_19_2_1
  TestCommandEnd();
  if(_fct_DoStop(EVerdBOF_None, 0))
  {
    TestPreparationEnd();
    return;
  }
  {
    CreateCaplIFFunction("SBWControlPRAByIGONTCURequest", 0);
    AddIFParameterInt(1LL);
    CallInterfaceFunction("Set PRA to P position at initial");
    if(_fct_DoStop(EVerdBOF_None, 0))
    {
      TestPreparationEnd();
      return;
    }
  }
  TestCommandBegin("Await Value Match", "check if SBW operate PRA to P Position at initial");
  {
    dword eventTable[2];
    long ret, setfailed; setfailed = 0;
    if((int64)(5LL * 1000000000LL) < 0)
    {
      testStepErrorInTestSystem(0, "1", "Invalid wait time (< 0)");
    }
    else
    {
      eventTable[0] = testJoinSignal(HKMC_LH_SBW::dbNode::LVR::LVR11::CF_Lvr_PNStat, "_ttg_callback_awaitvaluematch_6_1_1_19_2_3_3", "CAN signal \'CF_Lvr_PNStat\'", 0);
      setfailed |= eventTable[0] < 0;
      eventTable[1] = testJoinSignal(HKMC_LH_SBW::dbNode::LVR::LVR11::CF_Lvr_PRelStat, "_ttg_callback_awaitvaluematch_6_1_1_19_2_3_4", "CAN signal \'CF_Lvr_PRelStat\'", 0);
      setfailed |= eventTable[1] < 0;
      if(setfailed != 0)
      {
        testStepErrorInTestSystem(0, "1", "Unable to set value condition(s)");
      }
      ret = testWaitForAllJoinedEventsNS((int64)(5LL * 1000000000LL));
      if(setfailed == 0)
      {
        if(ret > 0)
        {
          testStepPass(2, "1", "Waited for occurrence of 2 value condition(s).");
        }
        else
        {
          testStepFail(0, "1", "Waited for occurrence of 2 value condition(s).");
        }
        _fct_TiTableHeadExpectedEx("");
        _fct_ChckRep(0, HKMC_LH_SBW::dbNode::LVR::LVR11::CF_Lvr_PNStat, "CAN signal \'CF_Lvr_PNStat\'", "==", 1LL, "Park Status");
        _fct_TiCellResult(((0!=getSignalTime(HKMC_LH_SBW::dbNode::LVR::LVR11::CF_Lvr_PNStat)) && CheckSignalMatch(HKMC_LH_SBW::dbNode::LVR::LVR11::CF_Lvr_PNStat, 1LL, "=") == 1));
        _fct_ChckRep(0, HKMC_LH_SBW::dbNode::LVR::LVR11::CF_Lvr_PRelStat, "CAN signal \'CF_Lvr_PRelStat\'", "==", 0LL, "Parking not released");
        _fct_TiCellResult(((0!=getSignalTime(HKMC_LH_SBW::dbNode::LVR::LVR11::CF_Lvr_PRelStat)) && CheckSignalMatch(HKMC_LH_SBW::dbNode::LVR::LVR11::CF_Lvr_PRelStat, 0LL, "=") == 1));
        _fct_TiTableEnd("", 0, 0);
      }
    }
  }
  // _ttg_!_6_1_1_19_2_3
  TestCommandEnd();
  if(_fct_DoStop(EVerdBOF_None, 0))
  {
    TestPreparationEnd();
    return;
  }
  TestCommandBegin("CAPL Inline", "capture CF_Lvr_PNStat&CF_Lvr_PRelStat");
  {
    _ttg_fct_caplinline_6_1_1_19_2_4();
  }
  // _ttg_!_6_1_1_19_2_4
  TestCommandEnd();
  if(_fct_DoStop(EVerdBOF_None, 0))
  {
    TestPreparationEnd();
    return;
  }
  TestPreparationEnd();
}
// _ttg_#_6_1_1_19_2
void _ttg_fct_completion_6_1_1_19_10(int64 _ttg_var_G_SEL_DISP_value_of_notN_6_1_1_19_1_0)
{
  TestCompletionBegin();
  {
    CreateCaplIFFunction("setIgnStatus", 0);
    AddIFParameterInt(1LL);
    CallInterfaceFunction("setIgnStatus (ignStatus=1)");
  }
  TestCommandBegin("Wait", "");
  {
    _fct_Wait("1", (int64)(1LL * 1000000000LL), 1000000000, "");
  }
  // _ttg_!_6_1_1_19_10_2
  TestCommandEnd();
  TestCompletionEnd();
}
// _ttg_#_6_1_1_19_10
void _ttg_fct_preparation_6_1_1_20_2(int64 _ttg_var_G_SEL_DISP_value_of_notN_6_1_1_20_1_0)
{
  TestPreparationBegin();
  TestCommandBegin("CANoe Standard Service", "Prepare the graph to see CF_Lvr_PosInf,CF_Lvr_PosCpl,CF_Lvr_BkeAct,CF_Lvr_PRelStat,CF_Lvr_PNStat easily");
  {
    testStep(2, "", "Execute testValidateTesterConfirmation(\"Prepare the graph to see CF_Lvr_PosInf,CF_Lvr_PosCpl,CF_Lvr_BkeAct,CF_Lvr_PRelStat,CF_Lvr_PNStat easily\", \"Prepare the graph to see CF_Lvr_PosInf,CF_Lvr_PosCpl,CF_Lvr_BkeAct,CF_Lvr_PRelStat,CF_Lvr_PNStat easily\", 1)");
    testValidateTesterConfirmation("Prepare the graph to see CF_Lvr_PosInf,CF_Lvr_PosCpl,CF_Lvr_BkeAct,CF_Lvr_PRelStat,CF_Lvr_PNStat easily", "Prepare the graph to see CF_Lvr_PosInf,CF_Lvr_PosCpl,CF_Lvr_BkeAct,CF_Lvr_PRelStat,CF_Lvr_PNStat easily", 1LL);
  }
  // _ttg_!_6_1_1_20_2_1
  TestCommandEnd();
  if(_fct_DoStop(EVerdBOF_None, 0))
  {
    TestPreparationEnd();
    return;
  }
  {
    CreateCaplIFFunction("fromIGONToNParkIGOffMode", 0);
    AddIFParameterInt(_ttg_var_G_SEL_DISP_value_of_notN_6_1_1_20_1_0);
    CallInterfaceFunction("fromIGONToNParkIGOffMode (G_SEL_DISP_value_of_notN=G_SEL_DISP_value_of_notN)");
    if(_fct_DoStop(EVerdBOF_None, 0))
    {
      TestPreparationEnd();
      return;
    }
  }
  TestPreparationEnd();
}
// _ttg_#_6_1_1_20_2
void _ttg_fct_completion_6_1_1_20_8(int64 _ttg_var_G_SEL_DISP_value_of_notN_6_1_1_20_1_0)
{
  TestCompletionBegin();
  {
    CreateCaplIFFunction("setIgnStatus", 0);
    AddIFParameterInt(1LL);
    CallInterfaceFunction("set IGN on");
  }
  TestCommandBegin("Wait", "");
  {
    _fct_Wait("1", (int64)(1LL * 1000000000LL), 1000000000, "");
  }
  // _ttg_!_6_1_1_20_8_2
  TestCommandEnd();
  TestCompletionEnd();
}
// _ttg_#_6_1_1_20_8
void _ttg_fct_preparation_6_1_1_21_2(int64 _ttg_var_G_SEL_DISP_value_of_notN_6_1_1_21_1_0)
{
  TestPreparationBegin();
  TestCommandBegin("CANoe Standard Service", "Prepare the graph to see CF_Lvr_PNStat,CF_Lvr_PRelStat,CF_Lvr_PosInf,CF_Lvr_PosCpl,CF_Lvr_BkeAct easily");
  {
    testStep(2, "", "Execute testValidateTesterConfirmation(\"Prepare the graph to see CF_Lvr_PNStat,CF_Lvr_PRelStat,CF_Lvr_PosInf,CF_Lvr_PosCpl,CF_Lvr_BkeAct easily\", \"Prepare the graph to see CF_Lvr_PNStat,CF_Lvr_PRelStat,CF_Lvr_PosInf,CF_Lvr_PosCpl,CF_Lvr_BkeAct easily\", 1)");
    testValidateTesterConfirmation("Prepare the graph to see CF_Lvr_PNStat,CF_Lvr_PRelStat,CF_Lvr_PosInf,CF_Lvr_PosCpl,CF_Lvr_BkeAct easily", "Prepare the graph to see CF_Lvr_PNStat,CF_Lvr_PRelStat,CF_Lvr_PosInf,CF_Lvr_PosCpl,CF_Lvr_BkeAct easily", 1LL);
  }
  // _ttg_!_6_1_1_21_2_1
  TestCommandEnd();
  if(_fct_DoStop(EVerdBOF_None, 0))
  {
    TestPreparationEnd();
    return;
  }
  {
    CreateCaplIFFunction("fromIGONToNParkIGOffMode", 0);
    AddIFParameterInt(_ttg_var_G_SEL_DISP_value_of_notN_6_1_1_21_1_0);
    CallInterfaceFunction("fromIGONToNParkIGOffMode (G_SEL_DISP_value_of_notN=G_SEL_DISP_value_of_notN)");
    if(_fct_DoStop(EVerdBOF_None, 0))
    {
      TestPreparationEnd();
      return;
    }
  }
  TestCommandBegin("CANoe Standard Service", "check if SBW operate PRA to not P position");
  {
    testStep(2, "", "Execute testValidateTesterConfirmation(\"check if SBW operate PRA to not P position\", \"check PRA position\", 1)");
    testValidateTesterConfirmation("check if SBW operate PRA to not P position", "check PRA position", 1LL);
  }
  // _ttg_!_6_1_1_21_2_3
  TestCommandEnd();
  if(_fct_DoStop(EVerdBOF_None, 0))
  {
    TestPreparationEnd();
    return;
  }
  TestPreparationEnd();
}
// _ttg_#_6_1_1_21_2
void _ttg_fct_completion_6_1_1_21_9(int64 _ttg_var_G_SEL_DISP_value_of_notN_6_1_1_21_1_0)
{
  TestCompletionBegin();
  {
    CreateCaplIFFunction("setIgnStatus", 0);
    AddIFParameterInt(1LL);
    CallInterfaceFunction("set IGN on");
  }
  TestCommandBegin("Wait", "");
  {
    _fct_Wait("1", (int64)(1LL * 1000000000LL), 1000000000, "");
  }
  // _ttg_!_6_1_1_21_9_2
  TestCommandEnd();
  TestCompletionEnd();
}
// _ttg_#_6_1_1_21_9
void _ttg_fct_preparation_6_1_1_22_2(int64 _ttg_var_G_SEL_DISP_value_of_notN_6_1_1_22_1_0)
{
  TestPreparationBegin();
  TestCommandBegin("CANoe Standard Service", "Prepare the graph to see CF_Tcu_PRelReq,CF_Lvr_PRelStat,CF_Lvr_PNStat,CF_Lvr_PosInf,CF_Lvr_BkeAct easily");
  {
    testStep(2, "", "Execute testValidateTesterConfirmation(\"Prepare the graph to see CF_Tcu_PRelReq,CF_Lvr_PRelStat,CF_Lvr_PNStat,CF_Lvr_PosInf,CF_Lvr_BkeAct easily\", \"Prepare the graph to see CF_Tcu_PRelReq,CF_Lvr_PRelStat,CF_Lvr_PNStat,CF_Lvr_PosInf,CF_Lvr_BkeAct easily\", 1)");
    testValidateTesterConfirmation("Prepare the graph to see CF_Tcu_PRelReq,CF_Lvr_PRelStat,CF_Lvr_PNStat,CF_Lvr_PosInf,CF_Lvr_BkeAct easily", "Prepare the graph to see CF_Tcu_PRelReq,CF_Lvr_PRelStat,CF_Lvr_PNStat,CF_Lvr_PosInf,CF_Lvr_BkeAct easily", 1LL);
  }
  // _ttg_!_6_1_1_22_2_1
  TestCommandEnd();
  if(_fct_DoStop(EVerdBOF_None, 0))
  {
    TestPreparationEnd();
    return;
  }
  TestPreparationEnd();
}
// _ttg_#_6_1_1_22_2
void _ttg_fct_completion_6_1_1_22_13(int64 _ttg_var_G_SEL_DISP_value_of_notN_6_1_1_22_1_0)
{
  TestCompletionBegin();
  {
    CreateCaplIFFunction("setIgnStatus", 0);
    AddIFParameterInt(1LL);
    CallInterfaceFunction("set IGN on");
  }
  TestCommandBegin("Wait", "");
  {
    _fct_Wait("1", (int64)(1LL * 1000000000LL), 1000000000, "");
  }
  // _ttg_!_6_1_1_22_13_2
  TestCommandEnd();
  TestCompletionEnd();
}
// _ttg_#_6_1_1_22_13
void _ttg_fct_preparation_6_1_1_23_2(int64 _ttg_var_G_SEL_DISP_value_of_notN_6_1_1_23_1_0)
{
  TestPreparationBegin();
  TestCommandBegin("CANoe Standard Service", "Prepare the graph to see CF_Tcu_PRelReq,CF_Lvr_PRelStat,CF_Lvr_PNStat easily");
  {
    testStep(2, "", "Execute testValidateTesterConfirmation(\"Prepare the graph to see CF_Tcu_PRelReq,CF_Lvr_PRelStat,CF_Lvr_PNStat easily\", \"Prepare the graph to see CF_Tcu_PRelReq,CF_Lvr_PRelStat,CF_Lvr_PNStat easily\", 1)");
    testValidateTesterConfirmation("Prepare the graph to see CF_Tcu_PRelReq,CF_Lvr_PRelStat,CF_Lvr_PNStat easily", "Prepare the graph to see CF_Tcu_PRelReq,CF_Lvr_PRelStat,CF_Lvr_PNStat easily", 1LL);
  }
  // _ttg_!_6_1_1_23_2_1
  TestCommandEnd();
  if(_fct_DoStop(EVerdBOF_None, 0))
  {
    TestPreparationEnd();
    return;
  }
  TestPreparationEnd();
}
// _ttg_#_6_1_1_23_2
void _ttg_fct_completion_6_1_1_23_9(int64 _ttg_var_G_SEL_DISP_value_of_notN_6_1_1_23_1_0)
{
  TestCompletionBegin();
  {
    CreateCaplIFFunction("setDriverDoorStatus", 0);
    AddIFParameterInt(0LL);
    CallInterfaceFunction("set driver door close");
  }
  TestCommandBegin("CAPL Inline", "Restore CF_Gway_DrvKeyLockSw,CF_Gway_PassiveAccessLock,CF_Gway_RKECmd to its original value");
  {
    _ttg_fct_caplinline_6_1_1_23_9_2();
  }
  // _ttg_!_6_1_1_23_9_2
  TestCommandEnd();
  {
    CreateCaplIFFunction("setIgnStatus", 0);
    AddIFParameterInt(1LL);
    CallInterfaceFunction("IGN ON");
  }
  TestCompletionEnd();
}
// _ttg_#_6_1_1_23_9
void _ttg_fct_preparation_6_0_1_2()
{
  TestPreparationBegin();
  TestCommandBegin("CANoe Standard Service", "Prepare the graph to see CF_Lvr_PosInf,CF_Lvr_PosCpl,CF_Lvr_BkeAct easily");
  {
    testStep(2, "", "Execute testValidateTesterConfirmation(\"Prepare the graph to see CF_Lvr_PosInf,CF_Lvr_PosCpl, CF_Lvr_BkeAct easily (timebase=5s)\", \"Prepare the graph to see CF_Lvr_PosInf,CF_Lvr_PosCpl,CF_Lvr_BkeAct easily\", 1)");
    testValidateTesterConfirmation("Prepare the graph to see CF_Lvr_PosInf,CF_Lvr_PosCpl, CF_Lvr_BkeAct easily (timebase=5s)", "Prepare the graph to see CF_Lvr_PosInf,CF_Lvr_PosCpl,CF_Lvr_BkeAct easily", 1LL);
  }
  // _ttg_!_6_0_1_2_1
  TestCommandEnd();
  if(_fct_DoStop(EVerdBOF_None, 0))
  {
    TestPreparationEnd();
    return;
  }
  TestPreparationEnd();
}
// _ttg_#_6_0_1_2
void _ttg_fct_preparation_6_0_2_2_1()
{
  TestPreparationBegin();
  TestCommandBegin("CANoe Standard Service", "Prepare the graph to see CF_Lvr_PosInf,CF_Lvr_BkeAct easily");
  {
    testStep(2, "", "Execute testValidateTesterConfirmation(\"Prepare the graph to see CF_Lvr_PosInf,CF_Lvr_BkeAct easily\", \"Prepare the graph to see CF_Lvr_PosInf,CF_Lvr_BkeAct easily\", 1)");
    testValidateTesterConfirmation("Prepare the graph to see CF_Lvr_PosInf,CF_Lvr_BkeAct easily", "Prepare the graph to see CF_Lvr_PosInf,CF_Lvr_BkeAct easily", 1LL);
  }
  // _ttg_!_6_0_2_2_1_1
  TestCommandEnd();
  if(_fct_DoStop(EVerdBOF_None, 0))
  {
    TestPreparationEnd();
    return;
  }
  TestPreparationEnd();
}
// _ttg_#_6_0_2_2_1
void _ttg_fct_completion_6_0_8_4_7()
{
  TestCompletionBegin();
  {
    CreateCaplIFFunction("setIlluminationmode", 0);
    AddIFParameterInt(1LL);
    AddIFParameterInt(1LL);
    CallInterfaceFunction("Back to day mode");
  }
  TestCommandBegin("CANoe Standard Service", "@day mode:check if SBW will control PWM duty on 100%");
  {
    testStep(2, "", "Execute testValidateTesterConfirmation(\"@day mode:check if SBW will control PWM duty on 100%\", \"check indicator illumination\", 1)");
    testValidateTesterConfirmation("@day mode:check if SBW will control PWM duty on 100%", "check indicator illumination", 1LL);
  }
  // _ttg_!_6_0_8_4_7_2
  TestCommandEnd();
  TestCompletionEnd();
}
// _ttg_#_6_0_8_4_7
void _ttg_fct_preparation_6_0_9_2_1()
{
  TestPreparationBegin();
  TestCommandBegin("CANoe Standard Service", "Prepare the graph to see CF_Tcu_PRelReq,CF_Lvr_PosInf,CF_Lvr_BkeAct,CF_Lvr_PNStat,CF_Lvr_PRelStat easily");
  {
    testStep(2, "", "Execute testValidateTesterConfirmation(\"Prepare the graph to see CF_Tcu_PRelReq,CF_Lvr_PosInf,CF_Lvr_BkeAct,CF_Lvr_PNStat,CF_Lvr_PRelStat easily\", \"Prepare the graph to see CF_Tcu_PRelReq,CF_Lvr_PosInf,CF_Lvr_BkeAct,CF_Lvr_PNStat,CF_Lvr_PRelStat easily\", 1)");
    testValidateTesterConfirmation("Prepare the graph to see CF_Tcu_PRelReq,CF_Lvr_PosInf,CF_Lvr_BkeAct,CF_Lvr_PNStat,CF_Lvr_PRelStat easily", "Prepare the graph to see CF_Tcu_PRelReq,CF_Lvr_PosInf,CF_Lvr_BkeAct,CF_Lvr_PNStat,CF_Lvr_PRelStat easily", 1LL);
  }
  // _ttg_!_6_0_9_2_1_1
  TestCommandEnd();
  if(_fct_DoStop(EVerdBOF_None, 0))
  {
    TestPreparationEnd();
    return;
  }
  TestPreparationEnd();
}
// _ttg_#_6_0_9_2_1
void _ttg_fct_preparation_6_0_9_5_1()
{
  TestPreparationBegin();
  TestCommandBegin("CANoe Standard Service", "Prepare the graph to see CF_Lvr_PNStat,CF_Lvr_PRelStat,CF_Tcu_PRelReq,CF_Lvr_PosInf,CF_Lvr_BkeAct easily");
  {
    testStep(2, "", "Execute testValidateTesterConfirmation(\"Prepare the graph to see CF_Lvr_PNStat,CF_Lvr_PRelStat,CF_Tcu_PRelReq,CF_Lvr_PosInf,CF_Lvr_BkeAct easily\", \"Prepare the graph to see CF_Lvr_PNStat,CF_Lvr_PRelStat,CF_Tcu_PRelReq,CF_Lvr_PosInf,CF_Lvr_BkeAct easily\", 1)");
    testValidateTesterConfirmation("Prepare the graph to see CF_Lvr_PNStat,CF_Lvr_PRelStat,CF_Tcu_PRelReq,CF_Lvr_PosInf,CF_Lvr_BkeAct easily", "Prepare the graph to see CF_Lvr_PNStat,CF_Lvr_PRelStat,CF_Tcu_PRelReq,CF_Lvr_PosInf,CF_Lvr_BkeAct easily", 1LL);
  }
  // _ttg_!_6_0_9_5_1_1
  TestCommandEnd();
  if(_fct_DoStop(EVerdBOF_None, 0))
  {
    TestPreparationEnd();
    return;
  }
  TestPreparationEnd();
}
// _ttg_#_6_0_9_5_1
void _ttg_fct_completion_6_0_9_5_11()
{
  TestCompletionBegin();
  TestCommandBegin("CAPL Inline", "set signal G_SEL_DISP enable");
  {
    _ttg_fct_caplinline_6_0_9_5_11_1();
  }
  // _ttg_!_6_0_9_5_11_1
  TestCommandEnd();
  TestCompletionEnd();
}
// _ttg_#_6_0_9_5_11
void _ttg_fct_preparation_6_0_9_6_1()
{
  TestPreparationBegin();
  TestCommandBegin("CANoe Standard Service", "Prepare the graph to see CF_Lvr_PNStat,CF_Lvr_PRelStat,CF_Tcu_PRelReq easily");
  {
    testStep(2, "", "Execute testValidateTesterConfirmation(\"Prepare the graph to see CF_Lvr_PNStat,CF_Lvr_PRelStat,CF_Tcu_PRelReq easily\", \"Prepare the graph to see CF_Lvr_PNStat,CF_Lvr_PRelStat,CF_Tcu_PRelReq easily\", 1)");
    testValidateTesterConfirmation("Prepare the graph to see CF_Lvr_PNStat,CF_Lvr_PRelStat,CF_Tcu_PRelReq easily", "Prepare the graph to see CF_Lvr_PNStat,CF_Lvr_PRelStat,CF_Tcu_PRelReq easily", 1LL);
  }
  // _ttg_!_6_0_9_6_1_1
  TestCommandEnd();
  if(_fct_DoStop(EVerdBOF_None, 0))
  {
    TestPreparationEnd();
    return;
  }
  TestPreparationEnd();
}
// _ttg_#_6_0_9_6_1
void _ttg_fct_preparation_6_0_9_7_1()
{
  TestPreparationBegin();
  TestCommandBegin("CANoe Standard Service", "Prepare the graph to see CF_Lvr_PNStat,CF_Lvr_PRelStat,CF_Tcu_PRelReq easily");
  {
    testStep(2, "", "Execute testValidateTesterConfirmation(\"Prepare the graph to see CF_Lvr_PNStat,CF_Lvr_PRelStat,CF_Tcu_PRelReq easily\", \"Prepare the graph to see CF_Lvr_PNStat,CF_Lvr_PRelStat,CF_Tcu_PRelReq easily\", 1)");
    testValidateTesterConfirmation("Prepare the graph to see CF_Lvr_PNStat,CF_Lvr_PRelStat,CF_Tcu_PRelReq easily", "Prepare the graph to see CF_Lvr_PNStat,CF_Lvr_PRelStat,CF_Tcu_PRelReq easily", 1LL);
  }
  // _ttg_!_6_0_9_7_1_1
  TestCommandEnd();
  if(_fct_DoStop(EVerdBOF_None, 0))
  {
    TestPreparationEnd();
    return;
  }
  TestPreparationEnd();
}
// _ttg_#_6_0_9_7_1
void _ttg_fct_preparation_6_0_11_1_1()
{
  TestPreparationBegin();
  TestCommandBegin("CANoe Standard Service", "Prepare the graph to see CF_Tcu_PRelReq,CF_Lvr_PNStat,CF_Lvr_PRelStat,G_SEL_DISP,CF_Gway_AstDrSw,CF_Gway_DrvDrSw easily");
  {
    testStep(2, "", "Execute testValidateTesterConfirmation(\"Prepare the graph to see CF_Tcu_PRelReq,CF_Lvr_PNStat,CF_Lvr_PRelStat,G_SEL_DISP,CF_Gway_AstDrSw,CF_Gway_DrvDrSw easily\", \"Prepare the graph to see CF_Tcu_PRelReq,CF_Lvr_PNStat,CF_Lvr_PRelStat,G_SEL_DISP,CF_Gway_AstDrSw,CF_Gway_DrvDrSw easily\", 1)");
    testValidateTesterConfirmation("Prepare the graph to see CF_Tcu_PRelReq,CF_Lvr_PNStat,CF_Lvr_PRelStat,G_SEL_DISP,CF_Gway_AstDrSw,CF_Gway_DrvDrSw easily", "Prepare the graph to see CF_Tcu_PRelReq,CF_Lvr_PNStat,CF_Lvr_PRelStat,G_SEL_DISP,CF_Gway_AstDrSw,CF_Gway_DrvDrSw easily", 1LL);
  }
  // _ttg_!_6_0_11_1_1_1
  TestCommandEnd();
  if(_fct_DoStop(EVerdBOF_None, 0))
  {
    TestPreparationEnd();
    return;
  }
  {
    CreateCaplIFFunction("setEngineRunningWithAllDoorsClosed", 0);
    CallInterfaceFunction("setEngineRunningWithAllDoorsClosed ()");
    if(_fct_DoStop(EVerdBOF_None, 0))
    {
      TestPreparationEnd();
      return;
    }
  }
  TestPreparationEnd();
}
// _ttg_#_6_0_11_1_1
void _ttg_fct_completion_6_0_11_1_12()
{
  TestCompletionBegin();
  {
    CreateCaplIFFunction("setIgnStatus", 0);
    AddIFParameterInt(1LL);
    CallInterfaceFunction("set IGN on");
  }
  {
    CreateCaplIFFunction("setEngineRunningWithAllDoorsClosed", 0);
    CallInterfaceFunction("setEngineRunningWithAllDoorsClosed ()");
  }
  TestCommandBegin("Wait", "");
  {
    _fct_Wait("1", (int64)(1LL * 1000000000LL), 1000000000, "");
  }
  // _ttg_!_6_0_11_1_12_3
  TestCommandEnd();
  TestCompletionEnd();
}
// _ttg_#_6_0_11_1_12
void _ttg_fct_preparation_6_0_11_2_1()
{
  TestPreparationBegin();
  {
    CreateCaplIFFunction("setEngineRunningWithAllDoorsClosed", 0);
    CallInterfaceFunction("setEngineRunningWithAllDoorsClosed ()");
    if(_fct_DoStop(EVerdBOF_None, 0))
    {
      TestPreparationEnd();
      return;
    }
  }
  TestCommandBegin("CANoe Standard Service", "Prepare the graph to see CF_Tcu_PRelReq,CF_Lvr_PNStat,CF_Lvr_PRelStat,G_SEL_DISP easily");
  {
    testStep(2, "", "Execute testValidateTesterConfirmation(\"Prepare the graph to see CF_Tcu_PRelReq,CF_Lvr_PNStat,CF_Lvr_PRelStat,G_SEL_DISP easily\", \"Prepare the graph to see CF_Tcu_PRelReq,CF_Lvr_PNStat,CF_Lvr_PRelStat,G_SEL_DISP easily\", 1)");
    testValidateTesterConfirmation("Prepare the graph to see CF_Tcu_PRelReq,CF_Lvr_PNStat,CF_Lvr_PRelStat,G_SEL_DISP easily", "Prepare the graph to see CF_Tcu_PRelReq,CF_Lvr_PNStat,CF_Lvr_PRelStat,G_SEL_DISP easily", 1LL);
  }
  // _ttg_!_6_0_11_2_1_2
  TestCommandEnd();
  if(_fct_DoStop(EVerdBOF_None, 0))
  {
    TestPreparationEnd();
    return;
  }
  TestPreparationEnd();
}
// _ttg_#_6_0_11_2_1
void _ttg_fct_completion_6_0_11_2_13()
{
  TestCompletionBegin();
  {
    CreateCaplIFFunction("setIgnStatus", 0);
    AddIFParameterInt(1LL);
    CallInterfaceFunction("set IGN on");
  }
  TestCommandBegin("Wait", "");
  {
    _fct_Wait("1", (int64)(1LL * 1000000000LL), 1000000000, "");
  }
  // _ttg_!_6_0_11_2_13_2
  TestCommandEnd();
  TestCompletionEnd();
}
// _ttg_#_6_0_11_2_13
void _ttg_fct_preparation_6_0_13_2_1()
{
  TestPreparationBegin();
  TestCommandBegin("CANoe Standard Service", "Prepare the graph to see CF_Tcu_PRelReq,CF_Lvr_PRelStat,CF_Lvr_PNStat,CF_Lvr_PosInf,CF_Lvr_BkeAct easily");
  {
    testStep(2, "", "Execute testValidateTesterConfirmation(\"Prepare the graph to see CF_Tcu_PRelReq,CF_Lvr_PRelStat,CF_Lvr_PNStat,CF_Lvr_PosInf,CF_Lvr_BkeAct easily\", \"Prepare the graph to see CF_Tcu_PRelReq,CF_Lvr_PRelStat,CF_Lvr_PNStat,CF_Lvr_PosInf,CF_Lvr_BkeAct easily\", 1)");
    testValidateTesterConfirmation("Prepare the graph to see CF_Tcu_PRelReq,CF_Lvr_PRelStat,CF_Lvr_PNStat,CF_Lvr_PosInf,CF_Lvr_BkeAct easily", "Prepare the graph to see CF_Tcu_PRelReq,CF_Lvr_PRelStat,CF_Lvr_PNStat,CF_Lvr_PosInf,CF_Lvr_BkeAct easily", 1LL);
  }
  // _ttg_!_6_0_13_2_1_1
  TestCommandEnd();
  if(_fct_DoStop(EVerdBOF_None, 0))
  {
    TestPreparationEnd();
    return;
  }
  TestPreparationEnd();
}
// _ttg_#_6_0_13_2_1
void _ttg_fct_preparation_6_0_14_1()
{
  TestPreparationBegin();
  TestCommandBegin("CANoe Standard Service", "Prepare the graph to see CF_Tcu_GSel_BlinkReq,CF_Tcu_PRelReq,CF_Lvr_PRelStat,CF_Lvr_PNStat,CF_Lvr_BkeAct,CF_Lvr_PosInf easily");
  {
    testStep(2, "", "Execute testValidateTesterConfirmation(\"Prepare the graph to see CF_Tcu_GSel_BlinkReq,CF_Tcu_PRelReq,CF_Lvr_PRelStat,CF_Lvr_PNStat,CF_Lvr_BkeAct,CF_Lvr_PosInf easily\", \"Prepare the graph to see CF_Tcu_GSel_BlinkReq,CF_Tcu_PRelReq,CF_Lvr_PRelStat,CF_Lvr_PNStat,CF_Lvr_BkeAct,CF_Lvr_PosInf easily\", 1)");
    testValidateTesterConfirmation("Prepare the graph to see CF_Tcu_GSel_BlinkReq,CF_Tcu_PRelReq,CF_Lvr_PRelStat,CF_Lvr_PNStat,CF_Lvr_BkeAct,CF_Lvr_PosInf easily", "Prepare the graph to see CF_Tcu_GSel_BlinkReq,CF_Tcu_PRelReq,CF_Lvr_PRelStat,CF_Lvr_PNStat,CF_Lvr_BkeAct,CF_Lvr_PosInf easily", 1LL);
  }
  // _ttg_!_6_0_14_1_1
  TestCommandEnd();
  if(_fct_DoStop(EVerdBOF_None, 0))
  {
    TestPreparationEnd();
    return;
  }
  {
    CreateCaplIFFunction("SBWControlPRAByIGONTCURequest", 0);
    AddIFParameterInt(0LL);
    CallInterfaceFunction("Set PRA to not P position at initial");
    if(_fct_DoStop(EVerdBOF_None, 0))
    {
      TestPreparationEnd();
      return;
    }
  }
  TestCommandBegin("Await Value Match", "check if SBW operate PRA to not P Position at initial");
  {
    dword eventTable[2];
    long ret, setfailed; setfailed = 0;
    if((int64)(5LL * 1000000000LL) < 0)
    {
      testStepErrorInTestSystem(0, "1", "Invalid wait time (< 0)");
    }
    else
    {
      eventTable[0] = testJoinSignal(HKMC_LH_SBW::dbNode::LVR::LVR11::CF_Lvr_PNStat, "_ttg_callback_awaitvaluematch_6_0_14_1_3_3", "CAN signal \'CF_Lvr_PNStat\'", 0);
      setfailed |= eventTable[0] < 0;
      eventTable[1] = testJoinSignal(HKMC_LH_SBW::dbNode::LVR::LVR11::CF_Lvr_PRelStat, "_ttg_callback_awaitvaluematch_6_0_14_1_3_4", "CAN signal \'CF_Lvr_PRelStat\'", 0);
      setfailed |= eventTable[1] < 0;
      if(setfailed != 0)
      {
        testStepErrorInTestSystem(0, "1", "Unable to set value condition(s)");
      }
      ret = testWaitForAllJoinedEventsNS((int64)(5LL * 1000000000LL));
      if(setfailed == 0)
      {
        if(ret > 0)
        {
          testStepPass(2, "1", "Waited for occurrence of 2 value condition(s).");
        }
        else
        {
          testStepFail(0, "1", "Waited for occurrence of 2 value condition(s).");
        }
        _fct_TiTableHeadExpectedEx("");
        _fct_ChckRep(0, HKMC_LH_SBW::dbNode::LVR::LVR11::CF_Lvr_PNStat, "CAN signal \'CF_Lvr_PNStat\'", "==", 2LL, "Not Park Status");
        _fct_TiCellResult(((0!=getSignalTime(HKMC_LH_SBW::dbNode::LVR::LVR11::CF_Lvr_PNStat)) && CheckSignalMatch(HKMC_LH_SBW::dbNode::LVR::LVR11::CF_Lvr_PNStat, 2LL, "=") == 1));
        _fct_ChckRep(0, HKMC_LH_SBW::dbNode::LVR::LVR11::CF_Lvr_PRelStat, "CAN signal \'CF_Lvr_PRelStat\'", "==", 1LL, "Parking released");
        _fct_TiCellResult(((0!=getSignalTime(HKMC_LH_SBW::dbNode::LVR::LVR11::CF_Lvr_PRelStat)) && CheckSignalMatch(HKMC_LH_SBW::dbNode::LVR::LVR11::CF_Lvr_PRelStat, 1LL, "=") == 1));
        _fct_TiTableEnd("", 0, 0);
      }
    }
  }
  // _ttg_!_6_0_14_1_3
  TestCommandEnd();
  if(_fct_DoStop(EVerdBOF_None, 0))
  {
    TestPreparationEnd();
    return;
  }
  TestCommandBegin("CAPL Inline", "capture CF_Lvr_PNStat&CF_Lvr_PRelStat");
  {
    _ttg_fct_caplinline_6_0_14_1_4();
  }
  // _ttg_!_6_0_14_1_4
  TestCommandEnd();
  if(_fct_DoStop(EVerdBOF_None, 0))
  {
    TestPreparationEnd();
    return;
  }
  TestPreparationEnd();
}
// _ttg_#_6_0_14_1
void _ttg_fct_preparation_6_0_15_1_1()
{
  TestPreparationBegin();
  TestCommandBegin("CANoe Standard Service", "Prepare the graph to see CF_Tcu_PRelReq,CF_Lvr_PRelStat,CF_Lvr_PNStat,M12_SupInt::RefVoltage easily");
  {
    testStep(2, "", "Execute testValidateTesterConfirmation(\"Prepare the graph to see CF_Tcu_PRelReq,CF_Lvr_PRelStat,CF_Lvr_PNStat,M12_SupInt::RefVoltage easily\", \"Prepare the graph to see CF_Tcu_PRelReq,CF_Lvr_PRelStat,CF_Lvr_PNStat,M12_SupInt::RefVoltage easily\", 1)");
    testValidateTesterConfirmation("Prepare the graph to see CF_Tcu_PRelReq,CF_Lvr_PRelStat,CF_Lvr_PNStat,M12_SupInt::RefVoltage easily", "Prepare the graph to see CF_Tcu_PRelReq,CF_Lvr_PRelStat,CF_Lvr_PNStat,M12_SupInt::RefVoltage easily", 1LL);
  }
  // _ttg_!_6_0_15_1_1_1
  TestCommandEnd();
  if(_fct_DoStop(EVerdBOF_None, 0))
  {
    TestPreparationEnd();
    return;
  }
  {
    CreateCaplIFFunction("SBWControlPRAByIGONTCURequest", 0);
    AddIFParameterInt(0LL);
    CallInterfaceFunction("Set PRA to not P position at initial");
    if(_fct_DoStop(EVerdBOF_None, 0))
    {
      TestPreparationEnd();
      return;
    }
  }
  TestCommandBegin("Await Value Match", "check if SBW operate PRA to not P Position at initial");
  {
    dword eventTable[2];
    long ret, setfailed; setfailed = 0;
    if((int64)(5LL * 1000000000LL) < 0)
    {
      testStepErrorInTestSystem(0, "1", "Invalid wait time (< 0)");
    }
    else
    {
      eventTable[0] = testJoinSignal(HKMC_LH_SBW::dbNode::LVR::LVR11::CF_Lvr_PNStat, "_ttg_callback_awaitvaluematch_6_0_15_1_1_3_3", "CAN signal \'CF_Lvr_PNStat\'", 0);
      setfailed |= eventTable[0] < 0;
      eventTable[1] = testJoinSignal(HKMC_LH_SBW::dbNode::LVR::LVR11::CF_Lvr_PRelStat, "_ttg_callback_awaitvaluematch_6_0_15_1_1_3_4", "CAN signal \'CF_Lvr_PRelStat\'", 0);
      setfailed |= eventTable[1] < 0;
      if(setfailed != 0)
      {
        testStepErrorInTestSystem(0, "1", "Unable to set value condition(s)");
      }
      ret = testWaitForAllJoinedEventsNS((int64)(5LL * 1000000000LL));
      if(setfailed == 0)
      {
        if(ret > 0)
        {
          testStepPass(2, "1", "Waited for occurrence of 2 value condition(s).");
        }
        else
        {
          testStepFail(0, "1", "Waited for occurrence of 2 value condition(s).");
        }
        _fct_TiTableHeadExpectedEx("");
        _fct_ChckRep(0, HKMC_LH_SBW::dbNode::LVR::LVR11::CF_Lvr_PNStat, "CAN signal \'CF_Lvr_PNStat\'", "==", 2LL, "Not Park Status");
        _fct_TiCellResult(((0!=getSignalTime(HKMC_LH_SBW::dbNode::LVR::LVR11::CF_Lvr_PNStat)) && CheckSignalMatch(HKMC_LH_SBW::dbNode::LVR::LVR11::CF_Lvr_PNStat, 2LL, "=") == 1));
        _fct_ChckRep(0, HKMC_LH_SBW::dbNode::LVR::LVR11::CF_Lvr_PRelStat, "CAN signal \'CF_Lvr_PRelStat\'", "==", 1LL, "Parking released");
        _fct_TiCellResult(((0!=getSignalTime(HKMC_LH_SBW::dbNode::LVR::LVR11::CF_Lvr_PRelStat)) && CheckSignalMatch(HKMC_LH_SBW::dbNode::LVR::LVR11::CF_Lvr_PRelStat, 1LL, "=") == 1));
        _fct_TiTableEnd("", 0, 0);
      }
    }
  }
  // _ttg_!_6_0_15_1_1_3
  TestCommandEnd();
  if(_fct_DoStop(EVerdBOF_None, 0))
  {
    TestPreparationEnd();
    return;
  }
  TestCommandBegin("CAPL Inline", "capture CF_Lvr_PNStat&CF_Lvr_PRelStat");
  {
    _ttg_fct_caplinline_6_0_15_1_1_4();
  }
  // _ttg_!_6_0_15_1_1_4
  TestCommandEnd();
  if(_fct_DoStop(EVerdBOF_None, 0))
  {
    TestPreparationEnd();
    return;
  }
  TestPreparationEnd();
}
// _ttg_#_6_0_15_1_1
void _ttg_fct_completion_6_0_15_1_5()
{
  TestCompletionBegin();
  TestCommandBegin("CAPL Inline", "battery voltage restores to 12v");
  {
    _ttg_fct_caplinline_6_0_15_1_5_1();
  }
  // _ttg_!_6_0_15_1_5_1
  TestCommandEnd();
  TestCompletionEnd();
}
// _ttg_#_6_0_15_1_5
void _ttg_fct_preparation_6_0_15_2_1()
{
  TestPreparationBegin();
  {
    CreateCaplIFFunction("SBWControlPRAByIGONTCURequest", 0);
    AddIFParameterInt(0LL);
    CallInterfaceFunction("Set PRA to not P position at initial");
    if(_fct_DoStop(EVerdBOF_None, 0))
    {
      TestPreparationEnd();
      return;
    }
  }
  TestCommandBegin("Await Value Match", "check if SBW operate PRA to not P Position at initial");
  {
    dword eventTable[2];
    long ret, setfailed; setfailed = 0;
    if((int64)(5LL * 1000000000LL) < 0)
    {
      testStepErrorInTestSystem(0, "1", "Invalid wait time (< 0)");
    }
    else
    {
      eventTable[0] = testJoinSignal(HKMC_LH_SBW::dbNode::LVR::LVR11::CF_Lvr_PNStat, "_ttg_callback_awaitvaluematch_6_0_15_2_1_2_3", "CAN signal \'CF_Lvr_PNStat\'", 0);
      setfailed |= eventTable[0] < 0;
      eventTable[1] = testJoinSignal(HKMC_LH_SBW::dbNode::LVR::LVR11::CF_Lvr_PRelStat, "_ttg_callback_awaitvaluematch_6_0_15_2_1_2_4", "CAN signal \'CF_Lvr_PRelStat\'", 0);
      setfailed |= eventTable[1] < 0;
      if(setfailed != 0)
      {
        testStepErrorInTestSystem(0, "1", "Unable to set value condition(s)");
      }
      ret = testWaitForAllJoinedEventsNS((int64)(5LL * 1000000000LL));
      if(setfailed == 0)
      {
        if(ret > 0)
        {
          testStepPass(2, "1", "Waited for occurrence of 2 value condition(s).");
        }
        else
        {
          testStepFail(0, "1", "Waited for occurrence of 2 value condition(s).");
        }
        _fct_TiTableHeadExpectedEx("");
        _fct_ChckRep(0, HKMC_LH_SBW::dbNode::LVR::LVR11::CF_Lvr_PNStat, "CAN signal \'CF_Lvr_PNStat\'", "==", 2LL, "Not Park Status");
        _fct_TiCellResult(((0!=getSignalTime(HKMC_LH_SBW::dbNode::LVR::LVR11::CF_Lvr_PNStat)) && CheckSignalMatch(HKMC_LH_SBW::dbNode::LVR::LVR11::CF_Lvr_PNStat, 2LL, "=") == 1));
        _fct_ChckRep(0, HKMC_LH_SBW::dbNode::LVR::LVR11::CF_Lvr_PRelStat, "CAN signal \'CF_Lvr_PRelStat\'", "==", 1LL, "Parking released");
        _fct_TiCellResult(((0!=getSignalTime(HKMC_LH_SBW::dbNode::LVR::LVR11::CF_Lvr_PRelStat)) && CheckSignalMatch(HKMC_LH_SBW::dbNode::LVR::LVR11::CF_Lvr_PRelStat, 1LL, "=") == 1));
        _fct_TiTableEnd("", 0, 0);
      }
    }
  }
  // _ttg_!_6_0_15_2_1_2
  TestCommandEnd();
  if(_fct_DoStop(EVerdBOF_None, 0))
  {
    TestPreparationEnd();
    return;
  }
  TestCommandBegin("CAPL Inline", "capture CF_Lvr_PNStat&CF_Lvr_PRelStat");
  {
    _ttg_fct_caplinline_6_0_15_2_1_3();
  }
  // _ttg_!_6_0_15_2_1_3
  TestCommandEnd();
  if(_fct_DoStop(EVerdBOF_None, 0))
  {
    TestPreparationEnd();
    return;
  }
  TestCommandBegin("CAPL Inline", "LimpHome Mode ON:battery voltage is 8.3v");
  {
    _ttg_fct_caplinline_6_0_15_2_1_4();
  }
  // _ttg_!_6_0_15_2_1_4
  TestCommandEnd();
  if(_fct_DoStop(EVerdBOF_None, 0))
  {
    TestPreparationEnd();
    return;
  }
  {
    CreateCaplIFFunction("setIgnStatus", 0);
    AddIFParameterInt(0LL);
    CallInterfaceFunction("set IGN off");
    if(_fct_DoStop(EVerdBOF_None, 0))
    {
      TestPreparationEnd();
      return;
    }
  }
  TestCommandBegin("Wait", "");
  {
    _fct_Wait("1", (int64)(1LL * 1000000000LL), 1000000000, "");
  }
  // _ttg_!_6_0_15_2_1_6
  TestCommandEnd();
  if(_fct_DoStop(EVerdBOF_None, 0))
  {
    TestPreparationEnd();
    return;
  }
  TestPreparationEnd();
}
// _ttg_#_6_0_15_2_1
void _ttg_fct_completion_6_0_15_2_8()
{
  TestCompletionBegin();
  TestCommandBegin("CAPL Inline", "battery voltage restores to 12v");
  {
    _ttg_fct_caplinline_6_0_15_2_8_1();
  }
  // _ttg_!_6_0_15_2_8_1
  TestCommandEnd();
  {
    CreateCaplIFFunction("setIgnStatus", 0);
    AddIFParameterInt(0LL);
    CallInterfaceFunction("set IGN on");
  }
  TestCommandBegin("Wait", "");
  {
    _fct_Wait("1", (int64)(1LL * 1000000000LL), 1000000000, "");
  }
  // _ttg_!_6_0_15_2_8_3
  TestCommandEnd();
  TestCompletionEnd();
}
// _ttg_#_6_0_15_2_8
void _ttg_fct_preparation_6_0_16_1()
{
  TestPreparationBegin();
  TestCommandBegin("CANoe Standard Service", "Prepare the graph to see CF_Tcu_PRelReq,CF_Lvr_PRelStat,CF_Lvr_PNStat,M12_SupInt::RefVoltage easily");
  {
    testStep(2, "", "Execute testValidateTesterConfirmation(\"Prepare the graph to see CF_Tcu_PRelReq,CF_Lvr_PRelStat,CF_Lvr_PNStat,M12_SupInt::RefVoltage easily\", \"Prepare the graph to see CF_Tcu_PRelReq,CF_Lvr_PRelStat,CF_Lvr_PNStat,M12_SupInt::RefVoltage easily\", 1)");
    testValidateTesterConfirmation("Prepare the graph to see CF_Tcu_PRelReq,CF_Lvr_PRelStat,CF_Lvr_PNStat,M12_SupInt::RefVoltage easily", "Prepare the graph to see CF_Tcu_PRelReq,CF_Lvr_PRelStat,CF_Lvr_PNStat,M12_SupInt::RefVoltage easily", 1LL);
  }
  // _ttg_!_6_0_16_1_1
  TestCommandEnd();
  if(_fct_DoStop(EVerdBOF_None, 0))
  {
    TestPreparationEnd();
    return;
  }
  {
    CreateCaplIFFunction("SBWControlPRAByIGONTCURequest", 0);
    AddIFParameterInt(0LL);
    CallInterfaceFunction("Set PRA to not P position at initial");
    if(_fct_DoStop(EVerdBOF_None, 0))
    {
      TestPreparationEnd();
      return;
    }
  }
  TestCommandBegin("Await Value Match", "check if SBW operate PRA to not P Position at initial");
  {
    dword eventTable[2];
    long ret, setfailed; setfailed = 0;
    if((int64)(5LL * 1000000000LL) < 0)
    {
      testStepErrorInTestSystem(0, "1", "Invalid wait time (< 0)");
    }
    else
    {
      eventTable[0] = testJoinSignal(HKMC_LH_SBW::dbNode::LVR::LVR11::CF_Lvr_PNStat, "_ttg_callback_awaitvaluematch_6_0_16_1_3_3", "CAN signal \'CF_Lvr_PNStat\'", 0);
      setfailed |= eventTable[0] < 0;
      eventTable[1] = testJoinSignal(HKMC_LH_SBW::dbNode::LVR::LVR11::CF_Lvr_PRelStat, "_ttg_callback_awaitvaluematch_6_0_16_1_3_4", "CAN signal \'CF_Lvr_PRelStat\'", 0);
      setfailed |= eventTable[1] < 0;
      if(setfailed != 0)
      {
        testStepErrorInTestSystem(0, "1", "Unable to set value condition(s)");
      }
      ret = testWaitForAllJoinedEventsNS((int64)(5LL * 1000000000LL));
      if(setfailed == 0)
      {
        if(ret > 0)
        {
          testStepPass(2, "1", "Waited for occurrence of 2 value condition(s).");
        }
        else
        {
          testStepFail(0, "1", "Waited for occurrence of 2 value condition(s).");
        }
        _fct_TiTableHeadExpectedEx("");
        _fct_ChckRep(0, HKMC_LH_SBW::dbNode::LVR::LVR11::CF_Lvr_PNStat, "CAN signal \'CF_Lvr_PNStat\'", "==", 2LL, "Not Park Status");
        _fct_TiCellResult(((0!=getSignalTime(HKMC_LH_SBW::dbNode::LVR::LVR11::CF_Lvr_PNStat)) && CheckSignalMatch(HKMC_LH_SBW::dbNode::LVR::LVR11::CF_Lvr_PNStat, 2LL, "=") == 1));
        _fct_ChckRep(0, HKMC_LH_SBW::dbNode::LVR::LVR11::CF_Lvr_PRelStat, "CAN signal \'CF_Lvr_PRelStat\'", "==", 1LL, "Parking released");
        _fct_TiCellResult(((0!=getSignalTime(HKMC_LH_SBW::dbNode::LVR::LVR11::CF_Lvr_PRelStat)) && CheckSignalMatch(HKMC_LH_SBW::dbNode::LVR::LVR11::CF_Lvr_PRelStat, 1LL, "=") == 1));
        _fct_TiTableEnd("", 0, 0);
      }
    }
  }
  // _ttg_!_6_0_16_1_3
  TestCommandEnd();
  if(_fct_DoStop(EVerdBOF_None, 0))
  {
    TestPreparationEnd();
    return;
  }
  TestCommandBegin("CAPL Inline", "capture CF_Lvr_PNStat&CF_Lvr_PRelStat");
  {
    _ttg_fct_caplinline_6_0_16_1_4();
  }
  // _ttg_!_6_0_16_1_4
  TestCommandEnd();
  if(_fct_DoStop(EVerdBOF_None, 0))
  {
    TestPreparationEnd();
    return;
  }
  TestPreparationEnd();
}
// _ttg_#_6_0_16_1
void _ttg_fct_completion_6_0_16_16()
{
  TestCompletionBegin();
  TestCommandBegin("CAPL Inline", "Make battery voltage restore to 12V");
  {
    _ttg_fct_caplinline_6_0_16_16_1();
  }
  // _ttg_!_6_0_16_16_1
  TestCommandEnd();
  TestCompletionEnd();
}
// _ttg_#_6_0_16_16
dword _ttg_callback_awaitvaluematch_6_1_1_0_16_2(signal * varSymbol)
{
  return ((0!=getSignalTime(varSymbol)) && CheckSignalMatch(varSymbol, 1LL, "=") == 1);
  // _ttg_!_6_1_1_0_16
}
dword _ttg_callback_awaitvaluematch_6_1_1_0_16_3(signal * varSymbol)
{
  return ((0!=getSignalTime(varSymbol)) && CheckSignalMatch(varSymbol, 14LL, "=") == 1);
  // _ttg_!_6_1_1_0_16
}
dword _ttg_callback_awaitvaluematch_6_1_1_5_16_2(signal * varSymbol)
{
  return ((0!=getSignalTime(varSymbol)) && CheckSignalMatch(varSymbol, 1LL, "=") == 1);
  // _ttg_!_6_1_1_5_16
}
dword _ttg_callback_awaitvaluematch_6_1_1_5_16_3(signal * varSymbol)
{
  return ((0!=getSignalTime(varSymbol)) && CheckSignalMatch(varSymbol, 14LL, "=") == 1);
  // _ttg_!_6_1_1_5_16
}
dword _ttg_callback_awaitvaluematch_6_1_1_13_2_5_3(signal * varSymbol)
{
  return ((0!=getSignalTime(varSymbol)) && CheckSignalMatch(varSymbol, 2LL, "=") == 1);
  // _ttg_!_6_1_1_13_2_5
}
dword _ttg_callback_awaitvaluematch_6_1_1_13_2_5_4(signal * varSymbol)
{
  return ((0!=getSignalTime(varSymbol)) && CheckSignalMatch(varSymbol, 1LL, "=") == 1);
  // _ttg_!_6_1_1_13_2_5
}
dword _ttg_callback_awaitvaluematch_6_1_1_13_4_3(signal * varSymbol)
{
  return ((0!=getSignalTime(varSymbol)) && CheckSignalMatch(varSymbol, 1LL, "=") == 1);
  // _ttg_!_6_1_1_13_4
}
dword _ttg_callback_awaitvaluematch_6_1_1_13_4_4(signal * varSymbol)
{
  return ((0!=getSignalTime(varSymbol)) && CheckSignalMatch(varSymbol, 0LL, "=") == 1);
  // _ttg_!_6_1_1_13_4
}
dword _ttg_callback_awaitvaluematch_6_1_1_14_2_3_3(signal * varSymbol)
{
  return ((0!=getSignalTime(varSymbol)) && CheckSignalMatch(varSymbol, 1LL, "=") == 1);
  // _ttg_!_6_1_1_14_2_3
}
dword _ttg_callback_awaitvaluematch_6_1_1_14_2_3_4(signal * varSymbol)
{
  return ((0!=getSignalTime(varSymbol)) && CheckSignalMatch(varSymbol, 0LL, "=") == 1);
  // _ttg_!_6_1_1_14_2_3
}
dword _ttg_callback_awaitvaluematch_6_1_1_14_13_3(signal * varSymbol)
{
  return ((0!=getSignalTime(varSymbol)) && CheckSignalMatch(varSymbol, 2LL, "=") == 1);
  // _ttg_!_6_1_1_14_13
}
dword _ttg_callback_awaitvaluematch_6_1_1_14_13_4(signal * varSymbol)
{
  return ((0!=getSignalTime(varSymbol)) && CheckSignalMatch(varSymbol, 1LL, "=") == 1);
  // _ttg_!_6_1_1_14_13
}
dword _ttg_callback_awaitvaluematch_6_1_1_15_2_3_3(signal * varSymbol)
{
  return ((0!=getSignalTime(varSymbol)) && CheckSignalMatch(varSymbol, 2LL, "=") == 1);
  // _ttg_!_6_1_1_15_2_3
}
dword _ttg_callback_awaitvaluematch_6_1_1_15_2_3_4(signal * varSymbol)
{
  return ((0!=getSignalTime(varSymbol)) && CheckSignalMatch(varSymbol, 1LL, "=") == 1);
  // _ttg_!_6_1_1_15_2_3
}
dword _ttg_callback_awaitvaluematch_6_1_1_15_12_3(signal * varSymbol)
{
  return ((0!=getSignalTime(varSymbol)) && CheckSignalMatch(varSymbol, 1LL, "=") == 1);
  // _ttg_!_6_1_1_15_12
}
dword _ttg_callback_awaitvaluematch_6_1_1_15_12_4(signal * varSymbol)
{
  return ((0!=getSignalTime(varSymbol)) && CheckSignalMatch(varSymbol, 0LL, "=") == 1);
  // _ttg_!_6_1_1_15_12
}
dword _ttg_callback_awaitvaluematch_6_1_1_16_6_3(signal * varSymbol)
{
  return ((0!=getSignalTime(varSymbol)) && CheckSignalMatch(varSymbol, 1LL, "=") == 1);
  // _ttg_!_6_1_1_16_6
}
dword _ttg_callback_awaitvaluematch_6_1_1_16_6_4(signal * varSymbol)
{
  return ((0!=getSignalTime(varSymbol)) && CheckSignalMatch(varSymbol, 0LL, "=") == 1);
  // _ttg_!_6_1_1_16_6
}
dword _ttg_callback_awaitvaluematch_6_1_1_16_9_3(signal * varSymbol)
{
  return ((0!=getSignalTime(varSymbol)) && CheckSignalMatch(varSymbol, 2LL, "=") == 1);
  // _ttg_!_6_1_1_16_9
}
dword _ttg_callback_awaitvaluematch_6_1_1_16_9_4(signal * varSymbol)
{
  return ((0!=getSignalTime(varSymbol)) && CheckSignalMatch(varSymbol, 1LL, "=") == 1);
  // _ttg_!_6_1_1_16_9
}
dword _ttg_callback_awaitvaluematch_6_1_1_17_2_6_3(signal * varSymbol)
{
  return ((0!=getSignalTime(varSymbol)) && CheckSignalMatch(varSymbol, 2LL, "=") == 1);
  // _ttg_!_6_1_1_17_2_6
}
dword _ttg_callback_awaitvaluematch_6_1_1_17_2_6_4(signal * varSymbol)
{
  return ((0!=getSignalTime(varSymbol)) && CheckSignalMatch(varSymbol, 1LL, "=") == 1);
  // _ttg_!_6_1_1_17_2_6
}
dword _ttg_callback_awaitvaluematch_6_1_1_17_2_9_3(signal * varSymbol)
{
  return ((0!=getSignalTime(varSymbol)) && CheckSignalMatch(varSymbol, 1LL, "=") == 1);
  // _ttg_!_6_1_1_17_2_9
}
dword _ttg_callback_awaitvaluematch_6_1_1_17_2_9_4(signal * varSymbol)
{
  return ((0!=getSignalTime(varSymbol)) && CheckSignalMatch(varSymbol, 0LL, "=") == 1);
  // _ttg_!_6_1_1_17_2_9
}
dword _ttg_callback_awaitvaluematch_6_1_1_17_2_12_3(signal * varSymbol)
{
  return ((0!=getSignalTime(varSymbol)) && CheckSignalMatch(varSymbol, 1LL, "=") == 1);
  // _ttg_!_6_1_1_17_2_12
}
dword _ttg_callback_awaitvaluematch_6_1_1_17_2_12_4(signal * varSymbol)
{
  return ((0!=getSignalTime(varSymbol)) && CheckSignalMatch(varSymbol, 0LL, "=") == 1);
  // _ttg_!_6_1_1_17_2_12
}
dword _ttg_callback_awaitvaluematch_6_1_1_17_2_19_3(signal * varSymbol)
{
  return ((0!=getSignalTime(varSymbol)) && CheckSignalMatch(varSymbol, 2LL, "=") == 1);
  // _ttg_!_6_1_1_17_2_19
}
dword _ttg_callback_awaitvaluematch_6_1_1_17_2_19_4(signal * varSymbol)
{
  return ((0!=getSignalTime(varSymbol)) && CheckSignalMatch(varSymbol, 1LL, "=") == 1);
  // _ttg_!_6_1_1_17_2_19
}
dword _ttg_callback_awaitvaluematch_6_1_1_18_2_3_3(signal * varSymbol)
{
  return ((0!=getSignalTime(varSymbol)) && CheckSignalMatch(varSymbol, 1LL, "=") == 1);
  // _ttg_!_6_1_1_18_2_3
}
dword _ttg_callback_awaitvaluematch_6_1_1_18_2_3_4(signal * varSymbol)
{
  return ((0!=getSignalTime(varSymbol)) && CheckSignalMatch(varSymbol, 0LL, "=") == 1);
  // _ttg_!_6_1_1_18_2_3
}
dword _ttg_callback_awaitvaluematch_6_1_1_18_7_3(signal * varSymbol)
{
  return ((0!=getSignalTime(varSymbol)) && CheckSignalMatch(varSymbol, 2LL, "=") == 1);
  // _ttg_!_6_1_1_18_7
}
dword _ttg_callback_awaitvaluematch_6_1_1_18_7_4(signal * varSymbol)
{
  return ((0!=getSignalTime(varSymbol)) && CheckSignalMatch(varSymbol, 1LL, "=") == 1);
  // _ttg_!_6_1_1_18_7
}
dword _ttg_callback_awaitvaluematch_6_1_1_18_10_3(signal * varSymbol)
{
  return ((0!=getSignalTime(varSymbol)) && CheckSignalMatch(varSymbol, 1LL, "=") == 1);
  // _ttg_!_6_1_1_18_10
}
dword _ttg_callback_awaitvaluematch_6_1_1_18_10_4(signal * varSymbol)
{
  return ((0!=getSignalTime(varSymbol)) && CheckSignalMatch(varSymbol, 0LL, "=") == 1);
  // _ttg_!_6_1_1_18_10
}
dword _ttg_callback_awaitvaluematch_6_1_1_19_2_3_3(signal * varSymbol)
{
  return ((0!=getSignalTime(varSymbol)) && CheckSignalMatch(varSymbol, 1LL, "=") == 1);
  // _ttg_!_6_1_1_19_2_3
}
dword _ttg_callback_awaitvaluematch_6_1_1_19_2_3_4(signal * varSymbol)
{
  return ((0!=getSignalTime(varSymbol)) && CheckSignalMatch(varSymbol, 0LL, "=") == 1);
  // _ttg_!_6_1_1_19_2_3
}
dword _ttg_callback_awaitvaluematch_6_1_1_19_4_3(signal * varSymbol)
{
  return ((0!=getSignalTime(varSymbol)) && CheckSignalMatch(varSymbol, 2LL, "=") == 1);
  // _ttg_!_6_1_1_19_4
}
dword _ttg_callback_awaitvaluematch_6_1_1_19_4_4(signal * varSymbol)
{
  return ((0!=getSignalTime(varSymbol)) && CheckSignalMatch(varSymbol, 1LL, "=") == 1);
  // _ttg_!_6_1_1_19_4
}
dword _ttg_callback_awaitvaluematch_6_1_1_19_7_3(signal * varSymbol)
{
  return ((0!=getSignalTime(varSymbol)) && CheckSignalMatch(varSymbol, 1LL, "=") == 1);
  // _ttg_!_6_1_1_19_7
}
dword _ttg_callback_awaitvaluematch_6_1_1_19_7_4(signal * varSymbol)
{
  return ((0!=getSignalTime(varSymbol)) && CheckSignalMatch(varSymbol, 0LL, "=") == 1);
  // _ttg_!_6_1_1_19_7
}
dword _ttg_callback_awaitvaluematch_6_1_1_22_4_3(signal * varSymbol)
{
  return ((0!=getSignalTime(varSymbol)) && CheckSignalMatch(varSymbol, 1LL, "=") == 1);
  // _ttg_!_6_1_1_22_4
}
dword _ttg_callback_awaitvaluematch_6_1_1_22_4_4(signal * varSymbol)
{
  return ((0!=getSignalTime(varSymbol)) && CheckSignalMatch(varSymbol, 0LL, "=") == 1);
  // _ttg_!_6_1_1_22_4
}
dword _ttg_callback_awaitvaluematch_6_1_1_22_7_3(signal * varSymbol)
{
  return ((0!=getSignalTime(varSymbol)) && CheckSignalMatch(varSymbol, 2LL, "=") == 1);
  // _ttg_!_6_1_1_22_7
}
dword _ttg_callback_awaitvaluematch_6_1_1_22_7_4(signal * varSymbol)
{
  return ((0!=getSignalTime(varSymbol)) && CheckSignalMatch(varSymbol, 1LL, "=") == 1);
  // _ttg_!_6_1_1_22_7
}
dword _ttg_callback_awaitvaluematch_6_1_1_22_10_3(signal * varSymbol)
{
  return ((0!=getSignalTime(varSymbol)) && CheckSignalMatch(varSymbol, 1LL, "=") == 1);
  // _ttg_!_6_1_1_22_10
}
dword _ttg_callback_awaitvaluematch_6_1_1_22_10_4(signal * varSymbol)
{
  return ((0!=getSignalTime(varSymbol)) && CheckSignalMatch(varSymbol, 0LL, "=") == 1);
  // _ttg_!_6_1_1_22_10
}
dword _ttg_callback_awaitvaluematch_6_1_1_23_4_3(signal * varSymbol)
{
  return ((0!=getSignalTime(varSymbol)) && CheckSignalMatch(varSymbol, 1LL, "=") == 1);
  // _ttg_!_6_1_1_23_4
}
dword _ttg_callback_awaitvaluematch_6_1_1_23_4_4(signal * varSymbol)
{
  return ((0!=getSignalTime(varSymbol)) && CheckSignalMatch(varSymbol, 0LL, "=") == 1);
  // _ttg_!_6_1_1_23_4
}
dword _ttg_callback_awaitvaluematch_6_0_9_2_3_3(signal * varSymbol)
{
  return ((0!=getSignalTime(varSymbol)) && CheckSignalMatch(varSymbol, 2LL, "=") == 1);
  // _ttg_!_6_0_9_2_3
}
dword _ttg_callback_awaitvaluematch_6_0_9_2_3_4(signal * varSymbol)
{
  return ((0!=getSignalTime(varSymbol)) && CheckSignalMatch(varSymbol, 1LL, "=") == 1);
  // _ttg_!_6_0_9_2_3
}
dword _ttg_callback_awaitvaluematch_6_0_9_2_9_3(signal * varSymbol)
{
  return ((0!=getSignalTime(varSymbol)) && CheckSignalMatch(varSymbol, 1LL, "=") == 1);
  // _ttg_!_6_0_9_2_9
}
dword _ttg_callback_awaitvaluematch_6_0_9_2_9_4(signal * varSymbol)
{
  return ((0!=getSignalTime(varSymbol)) && CheckSignalMatch(varSymbol, 0LL, "=") == 1);
  // _ttg_!_6_0_9_2_9
}
dword _ttg_callback_awaitvaluematch_6_0_9_5_3_3(signal * varSymbol)
{
  return ((0!=getSignalTime(varSymbol)) && CheckSignalMatch(varSymbol, 2LL, "=") == 1);
  // _ttg_!_6_0_9_5_3
}
dword _ttg_callback_awaitvaluematch_6_0_9_5_3_4(signal * varSymbol)
{
  return ((0!=getSignalTime(varSymbol)) && CheckSignalMatch(varSymbol, 1LL, "=") == 1);
  // _ttg_!_6_0_9_5_3
}
dword _ttg_callback_awaitvaluematch_6_0_9_5_9_3(signal * varSymbol)
{
  return ((0!=getSignalTime(varSymbol)) && CheckSignalMatch(varSymbol, 1LL, "=") == 1);
  // _ttg_!_6_0_9_5_9
}
dword _ttg_callback_awaitvaluematch_6_0_9_5_9_4(signal * varSymbol)
{
  return ((0!=getSignalTime(varSymbol)) && CheckSignalMatch(varSymbol, 0LL, "=") == 1);
  // _ttg_!_6_0_9_5_9
}
dword _ttg_callback_awaitvaluematch_6_0_9_6_3_3(signal * varSymbol)
{
  return ((0!=getSignalTime(varSymbol)) && CheckSignalMatch(varSymbol, 1LL, "=") == 1);
  // _ttg_!_6_0_9_6_3
}
dword _ttg_callback_awaitvaluematch_6_0_9_6_3_4(signal * varSymbol)
{
  return ((0!=getSignalTime(varSymbol)) && CheckSignalMatch(varSymbol, 0LL, "=") == 1);
  // _ttg_!_6_0_9_6_3
}
dword _ttg_callback_awaitvaluematch_6_0_9_6_8_3(signal * varSymbol)
{
  return ((0!=getSignalTime(varSymbol)) && CheckSignalMatch(varSymbol, 1LL, "=") == 1);
  // _ttg_!_6_0_9_6_8
}
dword _ttg_callback_awaitvaluematch_6_0_9_6_8_4(signal * varSymbol)
{
  return ((0!=getSignalTime(varSymbol)) && CheckSignalMatch(varSymbol, 0LL, "=") == 1);
  // _ttg_!_6_0_9_6_8
}
dword _ttg_callback_awaitvaluematch_6_0_9_7_3_3(signal * varSymbol)
{
  return ((0!=getSignalTime(varSymbol)) && CheckSignalMatch(varSymbol, 2LL, "=") == 1);
  // _ttg_!_6_0_9_7_3
}
dword _ttg_callback_awaitvaluematch_6_0_9_7_3_4(signal * varSymbol)
{
  return ((0!=getSignalTime(varSymbol)) && CheckSignalMatch(varSymbol, 1LL, "=") == 1);
  // _ttg_!_6_0_9_7_3
}
dword _ttg_callback_awaitvaluematch_6_0_11_1_3_3(signal * varSymbol)
{
  return ((0!=getSignalTime(varSymbol)) && CheckSignalMatch(varSymbol, 1LL, "=") == 1);
  // _ttg_!_6_0_11_1_3
}
dword _ttg_callback_awaitvaluematch_6_0_11_1_3_4(signal * varSymbol)
{
  return ((0!=getSignalTime(varSymbol)) && CheckSignalMatch(varSymbol, 0LL, "=") == 1);
  // _ttg_!_6_0_11_1_3
}
dword _ttg_callback_awaitvaluematch_6_0_11_1_6_3(signal * varSymbol)
{
  return ((0!=getSignalTime(varSymbol)) && CheckSignalMatch(varSymbol, 2LL, "=") == 1);
  // _ttg_!_6_0_11_1_6
}
dword _ttg_callback_awaitvaluematch_6_0_11_1_6_4(signal * varSymbol)
{
  return ((0!=getSignalTime(varSymbol)) && CheckSignalMatch(varSymbol, 1LL, "=") == 1);
  // _ttg_!_6_0_11_1_6
}
dword _ttg_callback_awaitvaluematch_6_0_11_1_10_3(signal * varSymbol)
{
  return ((0!=getSignalTime(varSymbol)) && CheckSignalMatch(varSymbol, 1LL, "=") == 1);
  // _ttg_!_6_0_11_1_10
}
dword _ttg_callback_awaitvaluematch_6_0_11_1_10_4(signal * varSymbol)
{
  return ((0!=getSignalTime(varSymbol)) && CheckSignalMatch(varSymbol, 0LL, "=") == 1);
  // _ttg_!_6_0_11_1_10
}
dword _ttg_callback_awaitvaluematch_6_0_11_2_3_3(signal * varSymbol)
{
  return ((0!=getSignalTime(varSymbol)) && CheckSignalMatch(varSymbol, 1LL, "=") == 1);
  // _ttg_!_6_0_11_2_3
}
dword _ttg_callback_awaitvaluematch_6_0_11_2_3_4(signal * varSymbol)
{
  return ((0!=getSignalTime(varSymbol)) && CheckSignalMatch(varSymbol, 0LL, "=") == 1);
  // _ttg_!_6_0_11_2_3
}
dword _ttg_callback_awaitvaluematch_6_0_11_2_6_3(signal * varSymbol)
{
  return ((0!=getSignalTime(varSymbol)) && CheckSignalMatch(varSymbol, 2LL, "=") == 1);
  // _ttg_!_6_0_11_2_6
}
dword _ttg_callback_awaitvaluematch_6_0_11_2_6_4(signal * varSymbol)
{
  return ((0!=getSignalTime(varSymbol)) && CheckSignalMatch(varSymbol, 1LL, "=") == 1);
  // _ttg_!_6_0_11_2_6
}
dword _ttg_callback_awaitvaluematch_6_0_11_2_11_3(signal * varSymbol)
{
  return ((0!=getSignalTime(varSymbol)) && CheckSignalMatch(varSymbol, 1LL, "=") == 1);
  // _ttg_!_6_0_11_2_11
}
dword _ttg_callback_awaitvaluematch_6_0_11_2_11_4(signal * varSymbol)
{
  return ((0!=getSignalTime(varSymbol)) && CheckSignalMatch(varSymbol, 0LL, "=") == 1);
  // _ttg_!_6_0_11_2_11
}
dword _ttg_callback_awaitvaluematch_6_0_13_2_3_3(signal * varSymbol)
{
  return ((0!=getSignalTime(varSymbol)) && CheckSignalMatch(varSymbol, 1LL, "=") == 1);
  // _ttg_!_6_0_13_2_3
}
dword _ttg_callback_awaitvaluematch_6_0_13_2_3_4(signal * varSymbol)
{
  return ((0!=getSignalTime(varSymbol)) && CheckSignalMatch(varSymbol, 0LL, "=") == 1);
  // _ttg_!_6_0_13_2_3
}
dword _ttg_callback_awaitvaluematch_6_0_13_2_4_3(signal * varSymbol)
{
  return ((0!=getSignalTime(varSymbol)) && CheckSignalMatch(varSymbol, 1LL, "=") == 1);
  // _ttg_!_6_0_13_2_4
}
dword _ttg_callback_awaitvaluematch_6_0_13_2_4_4(signal * varSymbol)
{
  return ((0!=getSignalTime(varSymbol)) && CheckSignalMatch(varSymbol, 0LL, "=") == 1);
  // _ttg_!_6_0_13_2_4
}
dword _ttg_callback_awaitvaluematch_6_0_14_1_3_3(signal * varSymbol)
{
  return ((0!=getSignalTime(varSymbol)) && CheckSignalMatch(varSymbol, 2LL, "=") == 1);
  // _ttg_!_6_0_14_1_3
}
dword _ttg_callback_awaitvaluematch_6_0_14_1_3_4(signal * varSymbol)
{
  return ((0!=getSignalTime(varSymbol)) && CheckSignalMatch(varSymbol, 1LL, "=") == 1);
  // _ttg_!_6_0_14_1_3
}
dword _ttg_callback_awaitvaluematch_6_0_14_4_3(signal * varSymbol)
{
  return ((0!=getSignalTime(varSymbol)) && CheckSignalMatch(varSymbol, 1LL, "=") == 1);
  // _ttg_!_6_0_14_4
}
dword _ttg_callback_awaitvaluematch_6_0_14_4_4(signal * varSymbol)
{
  return ((0!=getSignalTime(varSymbol)) && CheckSignalMatch(varSymbol, 0LL, "=") == 1);
  // _ttg_!_6_0_14_4
}
dword _ttg_callback_awaitvaluematch_6_0_14_9_3(signal * varSymbol)
{
  return ((0!=getSignalTime(varSymbol)) && CheckSignalMatch(varSymbol, 2LL, "=") == 1);
  // _ttg_!_6_0_14_9
}
dword _ttg_callback_awaitvaluematch_6_0_14_9_4(signal * varSymbol)
{
  return ((0!=getSignalTime(varSymbol)) && CheckSignalMatch(varSymbol, 1LL, "=") == 1);
  // _ttg_!_6_0_14_9
}
dword _ttg_callback_awaitvaluematch_6_0_14_14_3(signal * varSymbol)
{
  return ((0!=getSignalTime(varSymbol)) && CheckSignalMatch(varSymbol, 1LL, "=") == 1);
  // _ttg_!_6_0_14_14
}
dword _ttg_callback_awaitvaluematch_6_0_14_14_4(signal * varSymbol)
{
  return ((0!=getSignalTime(varSymbol)) && CheckSignalMatch(varSymbol, 0LL, "=") == 1);
  // _ttg_!_6_0_14_14
}
dword _ttg_callback_awaitvaluematch_6_0_15_1_1_3_3(signal * varSymbol)
{
  return ((0!=getSignalTime(varSymbol)) && CheckSignalMatch(varSymbol, 2LL, "=") == 1);
  // _ttg_!_6_0_15_1_1_3
}
dword _ttg_callback_awaitvaluematch_6_0_15_1_1_3_4(signal * varSymbol)
{
  return ((0!=getSignalTime(varSymbol)) && CheckSignalMatch(varSymbol, 1LL, "=") == 1);
  // _ttg_!_6_0_15_1_1_3
}
dword _ttg_callback_awaitvaluematch_6_0_15_1_3_3(signal * varSymbol)
{
  return ((0!=getSignalTime(varSymbol)) && CheckSignalMatch(varSymbol, 1LL, "=") == 1);
  // _ttg_!_6_0_15_1_3
}
dword _ttg_callback_awaitvaluematch_6_0_15_1_3_4(signal * varSymbol)
{
  return ((0!=getSignalTime(varSymbol)) && CheckSignalMatch(varSymbol, 0LL, "=") == 1);
  // _ttg_!_6_0_15_1_3
}
dword _ttg_callback_awaitvaluematch_6_0_15_2_1_2_3(signal * varSymbol)
{
  return ((0!=getSignalTime(varSymbol)) && CheckSignalMatch(varSymbol, 2LL, "=") == 1);
  // _ttg_!_6_0_15_2_1_2
}
dword _ttg_callback_awaitvaluematch_6_0_15_2_1_2_4(signal * varSymbol)
{
  return ((0!=getSignalTime(varSymbol)) && CheckSignalMatch(varSymbol, 1LL, "=") == 1);
  // _ttg_!_6_0_15_2_1_2
}
dword _ttg_callback_awaitvaluematch_6_0_15_2_3_3(signal * varSymbol)
{
  return ((0!=getSignalTime(varSymbol)) && CheckSignalMatch(varSymbol, 1LL, "=") == 1);
  // _ttg_!_6_0_15_2_3
}
dword _ttg_callback_awaitvaluematch_6_0_15_2_3_4(signal * varSymbol)
{
  return ((0!=getSignalTime(varSymbol)) && CheckSignalMatch(varSymbol, 0LL, "=") == 1);
  // _ttg_!_6_0_15_2_3
}
dword _ttg_callback_awaitvaluematch_6_0_15_2_6_3(signal * varSymbol)
{
  return ((0!=getSignalTime(varSymbol)) && CheckSignalMatch(varSymbol, 2LL, "=") == 1);
  // _ttg_!_6_0_15_2_6
}
dword _ttg_callback_awaitvaluematch_6_0_15_2_6_4(signal * varSymbol)
{
  return ((0!=getSignalTime(varSymbol)) && CheckSignalMatch(varSymbol, 1LL, "=") == 1);
  // _ttg_!_6_0_15_2_6
}
dword _ttg_callback_awaitvaluematch_6_0_16_1_3_3(signal * varSymbol)
{
  return ((0!=getSignalTime(varSymbol)) && CheckSignalMatch(varSymbol, 2LL, "=") == 1);
  // _ttg_!_6_0_16_1_3
}
dword _ttg_callback_awaitvaluematch_6_0_16_1_3_4(signal * varSymbol)
{
  return ((0!=getSignalTime(varSymbol)) && CheckSignalMatch(varSymbol, 1LL, "=") == 1);
  // _ttg_!_6_0_16_1_3
}
dword _ttg_callback_awaitvaluematch_6_0_16_5_3(signal * varSymbol)
{
  return ((0!=getSignalTime(varSymbol)) && CheckSignalMatch(varSymbol, 2LL, "=") == 1);
  // _ttg_!_6_0_16_5
}
dword _ttg_callback_awaitvaluematch_6_0_16_5_4(signal * varSymbol)
{
  return ((0!=getSignalTime(varSymbol)) && CheckSignalMatch(varSymbol, 1LL, "=") == 1);
  // _ttg_!_6_0_16_5
}
dword _ttg_callback_awaitvaluematch_6_0_16_10_3(signal * varSymbol)
{
  return ((0!=getSignalTime(varSymbol)) && CheckSignalMatch(varSymbol, 2LL, "=") == 1);
  // _ttg_!_6_0_16_10
}
dword _ttg_callback_awaitvaluematch_6_0_16_10_4(signal * varSymbol)
{
  return ((0!=getSignalTime(varSymbol)) && CheckSignalMatch(varSymbol, 1LL, "=") == 1);
  // _ttg_!_6_0_16_10
}
dword _ttg_callback_awaitvaluematch_6_0_16_14_3(signal * varSymbol)
{
  return ((0!=getSignalTime(varSymbol)) && CheckSignalMatch(varSymbol, 1LL, "=") == 1);
  // _ttg_!_6_0_16_14
}
dword _ttg_callback_awaitvaluematch_6_0_16_14_4(signal * varSymbol)
{
  return ((0!=getSignalTime(varSymbol)) && CheckSignalMatch(varSymbol, 0LL, "=") == 1);
  // _ttg_!_6_0_16_14
}
void _ttg_fct_caplinline_6_1_1_0_17()
{
  {
    testWaitForTimeout(500);
testReportAddWindowCapture("Graphics","","12.7.1.1.a Door Open Auto P Mode:If either door is open(Level B), vehicle stop, gear D or R and brake on to off, then SBW shall send P signal.","12.7.1.1.a CF_Lvr_PosInf,CF_Lvr_PosCpl.png");
  }
}
// _ttg_#_6_1_1_0_17
void _ttg_fct_caplinline_6_1_1_1_14()
{
  double errorcode;
  errorcode = _ttg_var_errorcode_6_1_1_1_2_0;
  {
    errorcode = $CF_Lvr_ShfErrInf;
  }
  _ttg_var_errorcode_6_1_1_1_2_0 = errorcode;
}
// _ttg_#_6_1_1_1_14
void _ttg_fct_caplinline_6_1_1_1_17()
{
  {
    testWaitForTimeout(500);
testReportAddWindowCapture("Graphics","","12.7.1.1.b Door Open Auto P Mode:If either door is open (Level A), vehicle stop, gear P or N and detecting position D or R, then SBW shall send warning message (CF_Lvr_ShtErrinf -> bit4)","12.7.1.1.b CF_Lvr_ShfErrinf.png");
  }
}
// _ttg_#_6_1_1_1_17
void _ttg_fct_caplinline_6_1_1_3_15()
{
  double errorcode;
  errorcode = _ttg_var_errorcode_6_1_1_3_2_0;
  {
    errorcode = $CF_Lvr_ShfErrInf;
  }
  _ttg_var_errorcode_6_1_1_3_2_0 = errorcode;
}
// _ttg_#_6_1_1_3_15
void _ttg_fct_caplinline_6_1_1_3_18()
{
  {
    testWaitForTimeout(500);
testReportAddWindowCapture("Graphics","","12.7.1.1.d. Door Open Auto P Mode:If either door is open (Level A), vehicle stop, gear D and detecting position R, then SBW shall send warning message (CF_Lvr_ShtErrinf -> bit4)","12.7.1.1.d CF_Lvr_ShfErrinf.png");
  }
}
// _ttg_#_6_1_1_3_18
void _ttg_fct_caplinline_6_1_1_4_14()
{
  double errorcode;
  errorcode = _ttg_var_errorcode_6_1_1_4_2_0;
  {
    errorcode = $CF_Lvr_ShfErrInf;
  }
  _ttg_var_errorcode_6_1_1_4_2_0 = errorcode;
}
// _ttg_#_6_1_1_4_14
void _ttg_fct_caplinline_6_1_1_4_17()
{
  {
    testWaitForTimeout(500);
testReportAddWindowCapture("Graphics","","12.7.1.1.e Door Open Auto P Mode:If either door is open (Level A), vehicle stop, gear R and detecting position D, then SBW shall send warning message (CF_Lvr_ShtErrinf -> bit4)","12.7.1.1.e CF_Lvr_ShfErrinf.png");
  }
}
// _ttg_#_6_1_1_4_17
void _ttg_fct_caplinline_6_1_1_5_4()
{
  {
    $CF_Gway_DrvSeatBeltSw=0;
testWaitForTimeout(1000);
  }
}
// _ttg_#_6_1_1_5_4
void _ttg_fct_caplinline_6_1_1_5_17()
{
  {
    testWaitForTimeout(500);
testReportAddWindowCapture("Graphics","","12.7.1.2.a Driver Seat Belt OFF Auto P:If driver seat belt is off, vehicle stop, gear D or R and brake on to off, then SBW send P signal.","12.7.1.2.a CF_Lvr_PosInf,CF_Lvr_PosCpl.png");
  }
}
// _ttg_#_6_1_1_5_17
void _ttg_fct_caplinline_6_1_1_6_5()
{
  {
    $CF_Gway_DrvSeatBeltSw = 0;
testWaitForTimeout(1000);
  }
}
// _ttg_#_6_1_1_6_5
void _ttg_fct_caplinline_6_1_1_6_14()
{
  double errorcode;
  errorcode = _ttg_var_errorcode_6_1_1_6_2_0;
  {
    errorcode = $CF_Lvr_ShfErrInf;
  }
  _ttg_var_errorcode_6_1_1_6_2_0 = errorcode;
}
// _ttg_#_6_1_1_6_14
void _ttg_fct_caplinline_6_1_1_6_17()
{
  {
    testWaitForTimeout(500);
testReportAddWindowCapture("Graphics","","12.7.1.2.b Driver Seat Belt OFF Auto P:If driver seat belt is off, vehicle stop, gear P or N and detecting position D or R, then SBW shall send warning message (CF_Lvr_ShtErrinf -> bit5)","12.7.1.2.b CF_Lvr_ShfErrinf.png");
  }
}
// _ttg_#_6_1_1_6_17
void _ttg_fct_caplinline_6_1_1_7_4()
{
  {
    $CF_Gway_DrvSeatBeltSw = 0;
testWaitForTimeout(1000);
  }
}
// _ttg_#_6_1_1_7_4
void _ttg_fct_caplinline_6_1_1_8_5()
{
  {
    $CF_Gway_DrvSeatBeltSw = 0;
testWaitForTimeout(1000);
  }
}
// _ttg_#_6_1_1_8_5
void _ttg_fct_caplinline_6_1_1_8_14()
{
  double errorcode;
  errorcode = _ttg_var_errorcode_6_1_1_8_2_0;
  {
    errorcode = $CF_Lvr_ShfErrInf;
  }
  _ttg_var_errorcode_6_1_1_8_2_0 = errorcode;
}
// _ttg_#_6_1_1_8_14
void _ttg_fct_caplinline_6_1_1_8_17()
{
  {
    testWaitForTimeout(500);
testReportAddWindowCapture("Graphics","","12.7.1.2.d Driver Seat Belt OFF Auto P:If driver seat belt is off, vehicle stop, gear D and detecting position R, then SBW shall send warning message (CF_Lvr_ShtErrinf -> bit5)","12.7.1.2.d CF_Lvr_ShfErrinf.png");
  }
}
// _ttg_#_6_1_1_8_17
void _ttg_fct_caplinline_6_1_1_9_5()
{
  {
    $CF_Gway_DrvSeatBeltSw = 0;
testWaitForTimeout(1000);
  }
}
// _ttg_#_6_1_1_9_5
void _ttg_fct_caplinline_6_1_1_9_14()
{
  double errorcode;
  errorcode = _ttg_var_errorcode_6_1_1_9_2_0;
  {
    errorcode = getSignal(CF_Lvr_ShfErrInf);
  }
  _ttg_var_errorcode_6_1_1_9_2_0 = errorcode;
}
// _ttg_#_6_1_1_9_14
void _ttg_fct_caplinline_6_1_1_9_17()
{
  {
    testWaitForTimeout(500);
testReportAddWindowCapture("Graphics","","12.7.1.2.e Driver Seat Belt OFF Auto P:If driver seat belt is off, vehicle stop, gear R and detecting position D, then SBW shall send warning message (CF_Lvr_ShtErrinf -> bit5)","12.7.1.2.e CF_Lvr_ShfErrinf.png");
  }
}
// _ttg_#_6_1_1_9_17
void _ttg_fct_caplinline_6_1_1_11_4()
{
  {
    if (testWaitForSignalMatch(CF_Lvr_PosInf,8,5000)==1)
   testStepPass("Auto N status","Auto N occurred:CF_Lvr_PosInf=Nr ");
else
   testStepFail("Auto N status","Auto N didn't happen");
testWaitForTimeout(500);
testReportAddWindowCapture("Graphics","","12.7.1.3.b CF_Lvr_PosInf during Auto N","12.7.1.3.b autoN.png");
  }
}
// _ttg_#_6_1_1_11_4
void _ttg_fct_caplinline_6_1_1_11_7()
{
  {
    if (testWaitForSignalMatch(CF_Lvr_PosInf,7,1000)==1) 
   testStepPass("CF_Lvr_PosInf status","CF_Lvr_PosInf=D ");
else
   testStepFail("CF_Lvr_PosInf","CF_Lvr_PosInf = %1.0f !=D",$CF_Lvr_PosInf);
testWaitForTimeout(500);
testReportAddWindowCapture("Graphics","","12.7.1.3.b CF_Lvr_PosInf after brake off","12.7.1.3.b CF_Lvr_PosInf.png");
  }
}
// _ttg_#_6_1_1_11_7
void _ttg_fct_caplinline_6_1_1_12_3()
{
  {
    int result;
result=testWaitForSignalOutsideRange(CF_Lvr_PosInf,9,9,10000);
if ( result== 0)
   testStepPass("CF_Lvr_PosInf status","CF_Lvr_PosInf has no change, keep Nd.");
else {
   if (result==1) 
      testStepFail("CF_Lvr_PosInf status","CF_Lvr_PosInf has change, CF_Lvr_PosInf = %1.0f.",$CF_Lvr_PosInf);
   else
      testStepFail("CF_Lvr_PosInf status","Something wrong happened in network.");
}
testWaitForTimeout(500);
testReportAddWindowCapture("Graphics","","12.7.1.3.d CF_Lvr_PosInf after brake on","12.7.1.3.d CF_Lvr_PosInf.png");
  }
}
// _ttg_#_6_1_1_12_3
void _ttg_fct_caplinline_6_1_1_12_6()
{
  {
    int result;
result=testWaitForSignalOutsideRange(CF_Lvr_PosInf,9,9,1000);
if ( result== 0)
   testStepPass("CF_Lvr_PosInf status","CF_Lvr_PosInf has no change, keep Nd.");
else {
   if (result==1) 
      testStepFail("CF_Lvr_PosInf status","CF_Lvr_PosInf has change, CF_Lvr_PosInf = %1.0f.",$CF_Lvr_PosInf);
   else
      testStepFail("CF_Lvr_PosInf status","Something wrong happened in network.");
}
testWaitForTimeout(500);
testReportAddWindowCapture("Graphics","","12.7.1.3.d CF_Lvr_PosInf after brake off","12.7.1.3.d signal after brake off.png");
  }
}
// _ttg_#_6_1_1_12_6
void _ttg_fct_caplinline_6_1_1_13_5()
{
  {
    testWaitForTimeout(500);
testReportAddWindowCapture("Graphics","","15.3.1.a IG ON Mode: If PRA positon is not P and Gear changes to NOT N position, SBW shall operate PRA to P Position.","15.3.1.a CF_Lvr_PNStat&CF_Lvr_PRelStat at final.png");
  }
}
// _ttg_#_6_1_1_13_5
void _ttg_fct_caplinline_6_1_1_13_6_1()
{
  {
    testEnableMsg("TCU11");
  }
}
// _ttg_#_6_1_1_13_6_1
void _ttg_fct_caplinline_6_1_1_14_2_4()
{
  {
    testWaitForTimeout(500);
testReportAddWindowCapture("Graphics","","Set PRA to P position at initial","15.3.1.3 Set PRA to P position at initial.png");
  }
}
// _ttg_#_6_1_1_14_2_4
void _ttg_fct_caplinline_6_1_1_14_5(int64 G_SEL_DISP_value_of_D)
{
  {
    $G_SEL_DISP = G_SEL_DISP_value_of_D;
testWaitForTimeout(500);
testStep("G_SEL_DISP status","G_SEL_DISP = %1.0f",$G_SEL_DISP);
  }
}
// _ttg_#_6_1_1_14_5
void _ttg_fct_caplinline_6_1_1_14_6()
{
  {
    testDisableMsg("TCU11");
  }
}
// _ttg_#_6_1_1_14_6
void _ttg_fct_caplinline_6_1_1_14_12()
{
  {
    testEnableMsg("TCU11");
  }
}
// _ttg_#_6_1_1_14_12
void _ttg_fct_caplinline_6_1_1_14_14()
{
  {
    testWaitForTimeout(500);
testReportAddWindowCapture("Graphics","","15.3.1.3 Recovery TCU OFF at Vehicle Driving","15.3.1.3 Recovery TCU OFF at Vehicle Driving.png");
  }
}
// _ttg_#_6_1_1_14_14
void _ttg_fct_caplinline_6_1_1_15_2_4()
{
  {
    testWaitForTimeout(500);
testReportAddWindowCapture("Graphics","","Set PRA to not P position at initial","15.3.1.4 Set PRA to not P position at initial.png");
  }
}
// _ttg_#_6_1_1_15_2_4
void _ttg_fct_caplinline_6_1_1_15_4(int64 G_SEL_DISP_value_of_D)
{
  {
    $G_SEL_DISP = G_SEL_DISP_value_of_D;
testWaitForTimeout(100);
testStep("G_SEL_DISP status","G_SEL_DISP = D =%1.0f",$G_SEL_DISP);
  }
}
// _ttg_#_6_1_1_15_4
void _ttg_fct_caplinline_6_1_1_15_6()
{
  {
    testDisableMsg("TCU11");
  }
}
// _ttg_#_6_1_1_15_6
void _ttg_fct_caplinline_6_1_1_15_11()
{
  {
    testEnableMsg("TCU11");
  }
}
// _ttg_#_6_1_1_15_11
void _ttg_fct_caplinline_6_1_1_15_13()
{
  {
    testWaitForTimeout(500);
testReportAddWindowCapture("Graphics","","15.3.1.4 Recovery TCU OFF at Vehicle Stop","15.3.1.4 Recovery TCU OFF at Vehicle Stop.png");
  }
}
// _ttg_#_6_1_1_15_13
void _ttg_fct_caplinline_6_1_1_16_3(int64 G_SEL_DISP_value_of_D)
{
  {
    $G_SEL_DISP = G_SEL_DISP_value_of_D;
testWaitForTimeout(500);
testStep("G_SEL_DISP status","G_SEL_DISP = %1.0f",$G_SEL_DISP);
  }
}
// _ttg_#_6_1_1_16_3
void _ttg_fct_caplinline_6_1_1_16_7()
{
  {
    testWaitForTimeout(500);
testReportAddWindowCapture("Graphics","","Set PRA to P position at initial","15.3.1.b CF_Lvr_PNStat&CF_Lvr_PRelStat at initial.png");
  }
}
// _ttg_#_6_1_1_16_7
void _ttg_fct_caplinline_6_1_1_16_8()
{
  {
    testDisableMsg("TCU11");
  }
}
// _ttg_#_6_1_1_16_8
void _ttg_fct_caplinline_6_1_1_16_10()
{
  {
    testWaitForTimeout(500);
testReportAddWindowCapture("Graphics","","15.3.1.1.a TCU OFF: When last gear is D, SBW shall operate PRA to Not P position","15.3.1.1.a CF_Lvr_PNStat&CF_Lvr_PRelStat at final.png");
  }
}
// _ttg_#_6_1_1_16_10
void _ttg_fct_caplinline_6_1_1_16_11_1()
{
  {
    testEnableMsg("TCU11");
  }
}
// _ttg_#_6_1_1_16_11_1
void _ttg_fct_caplinline_6_1_1_17_2_3(int64 G_SEL_DISP_value_of_PRorN)
{
  {
    $G_SEL_DISP = G_SEL_DISP_value_of_PRorN;
testWaitForTimeout(500);
testStep("G_SEL_DISP status","G_SEL_DISP = %1.0f",$G_SEL_DISP);
  }
}
// _ttg_#_6_1_1_17_2_3
void _ttg_fct_caplinline_6_1_1_17_2_7()
{
  {
    testWaitForTimeout(500);
testReportAddWindowCapture("Graphics","","Set PRA to not P position at initial","15.3.1.1.b-c Set PRA to not P position at initial.png");
  }
}
// _ttg_#_6_1_1_17_2_7
void _ttg_fct_caplinline_6_1_1_17_2_8()
{
  {
    testDisableMsg("TCU11");
  }
}
// _ttg_#_6_1_1_17_2_8
void _ttg_fct_caplinline_6_1_1_17_2_10()
{
  {
    testWaitForTimeout(500);
testReportAddWindowCapture("Graphics","","15.3.1.1.b When last gear is P,R or N SBW shall keep PRA in P position","15.3.1.1.b When last gear is P,R or N SBW shall keep PRA in P position.png");
  }
}
// _ttg_#_6_1_1_17_2_10
void _ttg_fct_caplinline_6_1_1_17_2_13()
{
  {
    testWaitForTimeout(500);
testReportAddWindowCapture("Graphics","","15.3.1.1.c After PRA is operated from Not P Position to P position, SBW should not operate PRA again","15.3.1.1.c After PRA is operated from Not P Position to P position, SBW should not operate PRA again.png");
  }
}
// _ttg_#_6_1_1_17_2_13
void _ttg_fct_caplinline_6_1_1_17_2_20()
{
  {
    testWaitForTimeout(500);
testReportAddWindowCapture("Graphics","","SBW should not operate PRA again while keep in TCU OFF condition unless IGN OFF to ON again","15.3.1.1.c SBW should not operate PRA again while keep in TCU OFF condition unless IGN OFF to ON again.png");
  }
}
// _ttg_#_6_1_1_17_2_20
void _ttg_fct_caplinline_6_1_1_17_3_1()
{
  {
    testEnableMsg("TCU11");
  }
}
// _ttg_#_6_1_1_17_3_1
void _ttg_fct_caplinline_6_1_1_18_2_4()
{
  {
    testWaitForTimeout(500);
testReportAddWindowCapture("Graphics","","Set PRA to P position at initial","15.3.2 Set PRA to P position at initial.png");
  }
}
// _ttg_#_6_1_1_18_2_4
void _ttg_fct_caplinline_6_1_1_18_8()
{
  {
    testWaitForTimeout(500);
testReportAddWindowCapture("Graphics","","15.3.2 When the last gear is D, R or P SBW shall keep PRA to Not P Position","15.3.2 When the last gear is D, R or P SBW shall keep PRA to Not P Position.png");
  }
}
// _ttg_#_6_1_1_18_8
void _ttg_fct_caplinline_6_1_1_18_11()
{
  {
    testWaitForTimeout(500);
testReportAddWindowCapture("Graphics","","15.3.2 After the vehicle speed is less than 1km/h,then SBW shall keep PRA for P Position","15.3.2 After the vehicle speed is less than 1km_h,then SBW shall keep PRA for P Position.png");
  }
}
// _ttg_#_6_1_1_18_11
void _ttg_fct_caplinline_6_1_1_19_2_4()
{
  {
    testWaitForTimeout(500);
testReportAddWindowCapture("Graphics","","Set PRA to P position at initial","15.3.4 Set PRA to P position at initial.png");
  }
}
// _ttg_#_6_1_1_19_2_4
void _ttg_fct_caplinline_6_1_1_19_5()
{
  {
    testWaitForTimeout(500);
testReportAddWindowCapture("Graphics","","Set PRA to not P position after entering N park mode","15.3.4 Set PRA to not P position after entering N park mode.png");
  }
}
// _ttg_#_6_1_1_19_5
void _ttg_fct_caplinline_6_1_1_19_8()
{
  {
    testWaitForTimeout(500);
testReportAddWindowCapture("Graphics","","Set PRA to P position after valid P press at N park mode","15.3.4 Set PRA to P position after valid P press at N park mode.png");
  }
}
// _ttg_#_6_1_1_19_8
void _ttg_fct_caplinline_6_1_1_20_4()
{
  {
    testReportAddWindowCapture("Graphics","","PRA posiiton after valid P-Release at NParkIGOFF","capture PRA posiiton after valid P-release at NParkIGOFF");
  }
}
// _ttg_#_6_1_1_20_4
void _ttg_fct_caplinline_6_1_1_20_7()
{
  {
    testReportAddWindowCapture("Graphics","","PRA posiiton after valid P at NParkIGOFF","capture PRA posiiton after valid P at NParkIGOFF");
  }
}
// _ttg_#_6_1_1_20_7
void _ttg_fct_caplinline_6_1_1_21_8()
{
  {
    testReportAddWindowCapture("Graphics","","13.4.2.5 CF_Lvr_PNStat","13.4.2.5 CF_Lvr_PNStat.png");
  }
}
// _ttg_#_6_1_1_21_8
void _ttg_fct_caplinline_6_1_1_22_5()
{
  {
    testWaitForTimeout(500);
testReportAddWindowCapture("Graphics","","Set PRA to P position at initial","15.3.4 Set PRA to P position at initial.png");
  }
}
// _ttg_#_6_1_1_22_5
void _ttg_fct_caplinline_6_1_1_22_8()
{
  {
    testWaitForTimeout(500);
testReportAddWindowCapture("Graphics","","Set PRA to not P position after entering N park mode","15.3.4 Set PRA to not P position after entering N park mode.png");
  }
}
// _ttg_#_6_1_1_22_8
void _ttg_fct_caplinline_6_1_1_22_11()
{
  {
    testWaitForTimeout(500);
testReportAddWindowCapture("Graphics","","Set PRA to P position after valid P press at N park mode","15.3.4 Set PRA to P position after valid P press at N park mode.png");
  }
}
// _ttg_#_6_1_1_22_11
void _ttg_fct_caplinline_6_1_1_23_9_2()
{
  {
    $CF_Gway_DrvKeyLockSw = 0; 
$CF_Gway_PassiveAccessLock = 0;
$CF_Gway_RKECmd = 0;
  }
}
// _ttg_#_6_1_1_23_9_2
void _ttg_fct_caplinline_6_0_0_3()
{
  {
    sysvar::VTS::M12_VT7001.SetInterconnectionMode(5);//Interconnection settings mode:sup1+supint
sysvar::VTS::M12_SupInt.SetRefVoltageMode(1);
@sysvar::VTS::M12_Out2::Active = 1;
@sysvar::VTS::M12_SupInt::RefVoltage = 12;
testWaitForTimeout(500);
sysvar::VTS::M12_Sup1.SetRefVoltageMode(1);
//sysvar::VTS::M12_Sup1.SetRefVoltageMode(mode, 1);
@sysvar::VTS::M12_Sup1::RefVoltage = 1;//1v vs 12v
sysvar::VTS::M12_Sup1.SetMaxCurrentMode(1);
// sysvar::VTS::M12_Sup1.SetMaxCurrentMode(mode, 1);
@sysvar::VTS::M12_Sup1::MaxCurrent = 2.5;//1A vs 12A
sysvar::VTS::M12_Out1.ResetMinMax();
sysvar::VTS::M12_Out1.SetMinCurrentMeasurementRange(4);
@sysvar::VTS::M12_Out1::Active = 1;
testWaitForTimeout(500);
if (testWaitForSignalInRange(sysvar::VTS::M12_Out2::AvgVoltage,11.8,12.2,500)!=1)
   testStepFail("VBAT1 voltage status","Voltage maybe out of range,VBAT1 = %4.2fV",@VTS::M12_Out2::AvgVoltage);
else
   testStepPass("VBAT1 voltage status","Voltage is in the range of [11.8V~12.2V],VBAT1 = %4.2fV",@VTS::M12_Out2::AvgVoltage);
if (testWaitForSignalInRange(sysvar::VTS::M12_Out2::AvgCurrent,0.002,0.2,500)!=1)
   testStepFail("VBAT1 current status","Current maybe out of range,VBAT1 current = %6.3fmA",@VTS::M12_Out2::AvgCurrent*1000);
else
   testStepPass("VBAT1 current status","Current is in the range of [2mA~200mA],VBAT1 current = %6.3fmA",@VTS::M12_Out2::AvgCurrent*1000);

  }
}
// _ttg_#_6_0_0_3
void _ttg_fct_caplinline_6_0_7_3_3()
{
  {
    $ENG_STAT = 3;//set engine running
testWaitForTimeout(1000);
  }
}
// _ttg_#_6_0_7_3_3
void _ttg_fct_caplinline_6_0_8_1_6()
{
  {
    int i=0;
testValidateTesterConfirmation("check backlight","Ready to increase CF_Gway_RheostatLevel step by step,check backlight in the following",1);
for (i=1;i<22;i++) {
   $CF_Gway_RheostatLevel = i;
   testWaitForTimeout(1000);
}
  }
}
// _ttg_#_6_0_8_1_6
void _ttg_fct_caplinline_6_0_9_2_4()
{
  {
    testWaitForTimeout(500);
testReportAddWindowCapture("Graphics","","Set PRA to not P position at initial.","15.3.1.b CF_Lvr_PNStat&CF_Lvr_PRelStat at initial.png");
  }
}
// _ttg_#_6_0_9_2_4
void _ttg_fct_caplinline_6_0_9_2_10()
{
  {
    testWaitForTimeout(500);
testReportAddWindowCapture("Graphics","","15.3.1.b IG ON Mode: If P Switch pressed ON while IGN ON and vehicle stop, SBW shall operate PRA to P position.","15.3.1.b CF_Lvr_PNStat&CF_Lvr_PRelStat at final.png");
  }
}
// _ttg_#_6_0_9_2_10
void _ttg_fct_caplinline_6_0_9_5_4()
{
  {
    testWaitForTimeout(500);
testReportAddWindowCapture("Graphics","","Set PRA to not P position at initial","15.3.1.1.d Set PRA to not P position at initial.png");
  }
}
// _ttg_#_6_0_9_5_4
void _ttg_fct_caplinline_6_0_9_5_5()
{
  {
    testDisableMsg("TCU11");
  }
}
// _ttg_#_6_0_9_5_5
void _ttg_fct_caplinline_6_0_9_5_10()
{
  {
    testWaitForTimeout(500);
testReportAddWindowCapture("Graphics","","15.3.1.1.d When P switch is pressed when vehicle is stopped,SBW shall operate PRA to P position","15.3.1.1.d When P switch is pressed when vehicle is stopped,SBW shall operate PRA to P position.png");
  }
}
// _ttg_#_6_0_9_5_10
void _ttg_fct_caplinline_6_0_9_5_11_1()
{
  {
    testEnableMsg("TCU11");
  }
}
// _ttg_#_6_0_9_5_11_1
void _ttg_fct_caplinline_6_0_9_6_4()
{
  {
    testWaitForTimeout(800);
testReportAddWindowCapture("Graphics","","15.3.1.2.c Set PRA to P position at initial","15.3.1.2.c Set PRA to P position at initial.png");
  }
}
// _ttg_#_6_0_9_6_4
void _ttg_fct_caplinline_6_0_9_6_9()
{
  {
    testWaitForTimeout(500);
testReportAddWindowCapture("Graphics","","15.3.1.2.c During the activating to Not P position by receiving CF_Tcu_PrelReq = 0x1 from TCU,if receiving the CF_Tcu_PrelReq = 0x0 from TCU,then SBW shall operate PRA to P position immediately","15.3.1.2.c SBW shall operate PRA to P position immediately.png");
  }
}
// _ttg_#_6_0_9_6_9
void _ttg_fct_caplinline_6_0_9_7_4()
{
  {
    testWaitForTimeout(500);
testReportAddWindowCapture("Graphics","","Set PRA to not P position at initial","15.3.1.2.d Set PRA to not P position at initial.png");
  }
}
// _ttg_#_6_0_9_7_4
void _ttg_fct_caplinline_6_0_9_7_9()
{
  {
    testWaitForTimeout(500);
testReportAddWindowCapture("Graphics","","Otherwise SBW shall ignore TCU request, without any PRA operation","15.3.1.2.d Otherwise SBW shall ignore TCU request, without any PRA operation.png");
  }
}
// _ttg_#_6_0_9_7_9
void _ttg_fct_caplinline_6_0_11_1_4()
{
  {
    testWaitForTimeout(500);
testReportAddWindowCapture("Graphics","","Set PRA to P position at initial","15.3.3.a Set PRA to P position at initial.png");
  }
}
// _ttg_#_6_0_11_1_4
void _ttg_fct_caplinline_6_0_11_1_7()
{
  {
    testWaitForTimeout(500);
testReportAddWindowCapture("Graphics","","SBW shall initially keep PRA to Not P position after enter Gear N IG OFF Mode","15.3.3.a SBW shall initially keep PRA to Not P position after enter Gear N IG OFF Mode.png");
  }
}
// _ttg_#_6_0_11_1_7
void _ttg_fct_caplinline_6_0_11_1_9()
{
  {
    switch (random(2)) {
   case 0:
      $CF_Gway_AstDrSw = 1;
      testStep("open door(Level B)", "CF_Gway_AstDrSw = open");
   break;
   case 1:
      $CF_Gway_DrvDrSw = 1;
      testStep("open door(Level B)", "CF_Gway_DrvDrSw = open");
   break;
}
  }
}
// _ttg_#_6_0_11_1_9
void _ttg_fct_caplinline_6_0_11_1_11()
{
  {
    testWaitForTimeout(500);
testReportAddWindowCapture("Graphics","","If the door is open (DRV or AST),SBW shall keep PRA to P position at Gear N IG OFF Mode","15.3.3.a If the door is open (DRV or AST),SBW shall keep PRA to P position at Gear N IG OFF Mode.png");
  }
}
// _ttg_#_6_0_11_1_11
void _ttg_fct_caplinline_6_0_11_2_4()
{
  {
    testWaitForTimeout(500);
testReportAddWindowCapture("Graphics","","Set PRA to P position at initial","15.3.3.b Set PRA to P position at initial.png");
  }
}
// _ttg_#_6_0_11_2_4
void _ttg_fct_caplinline_6_0_11_2_7()
{
  {
    testWaitForTimeout(500);
testReportAddWindowCapture("Graphics","","SBW shall initially keep PRA to Not P position after enter Gear N IG OFF Mode","15.3.3.a SBW shall initially keep PRA to Not P position after enter Gear N IG OFF Mode.png");
  }
}
// _ttg_#_6_0_11_2_7
void _ttg_fct_caplinline_6_0_11_2_12()
{
  {
    testWaitForTimeout(500);
testReportAddWindowCapture("Graphics","","while Gear N IG OFF Mode,SBW shall operate PRA to P position","15.3.3.b while Gear N IG OFF Mode,SBW shall operate PRA to P position.png");
  }
}
// _ttg_#_6_0_11_2_12
void _ttg_fct_caplinline_6_0_14_1_4()
{
  {
    testWaitForTimeout(500);
testReportAddWindowCapture("Graphics","","Set PRA to not P position at initial","15.3.6 Set PRA to not P position at initial.png");
  }
}
// _ttg_#_6_0_14_1_4
void _ttg_fct_caplinline_6_0_14_3()
{
  {
    $CF_Tcu_GSel_BlinkReq = 1;
testWaitForTimeout(100);
$CF_Tcu_GSel_BlinkReq = 0; //TCU Eol Complete value is 1 to 0 edge
  }
}
// _ttg_#_6_0_14_3
void _ttg_fct_caplinline_6_0_14_5()
{
  {
    testWaitForTimeout(500);
testReportAddWindowCapture("Graphics","","Set PRA to P position after TCU Eol Complete value from 1 to 0","15.3.6 Set PRA to P position after TCU Eol Complete value from 1 to 0.png");
  }
}
// _ttg_#_6_0_14_5
void _ttg_fct_caplinline_6_0_14_7()
{
  {
    $CF_Tcu_GSel_BlinkReq = 1;
testWaitForTimeout(100);
  }
}
// _ttg_#_6_0_14_7
void _ttg_fct_caplinline_6_0_14_10()
{
  {
    testWaitForTimeout(500);
testReportAddWindowCapture("Graphics","","If TCU Eol Complete value is 1, and IGN ON&& P switch==OFF && Unlock switch 5times within 2sec","15.3.6.4 If TCU Eol Complete value is 1, and IGN ON&& P switch==OFF && Unlock switch 5times within 2sec,set PRA to not P position.png");
  }
}
// _ttg_#_6_0_14_10
void _ttg_fct_caplinline_6_0_14_12()
{
  {
    $CF_Tcu_GSel_BlinkReq = 0;
testWaitForTimeout(100);
  }
}
// _ttg_#_6_0_14_12
void _ttg_fct_caplinline_6_0_14_15()
{
  {
    testWaitForTimeout(500);
testReportAddWindowCapture("Graphics","","If the TCU Eol Complete value is 0 and Pressed P switch, SBW shall operate PRA to P position.","15.3.6.3 If the TCU Eol Complete value is 0 and Pressed P switch, SBW shall operate PRA to P position.png");
  }
}
// _ttg_#_6_0_14_15
void _ttg_fct_caplinline_6_0_15_1_1_4()
{
  {
    testWaitForTimeout(500);
testReportAddWindowCapture("Graphics","","Set PRA to not P position at initial","15.3.7 Set PRA to not P position at initial.png");
  }
}
// _ttg_#_6_0_15_1_1_4
void _ttg_fct_caplinline_6_0_15_1_2()
{
  {
    @sysvar::VTS::M12_SupInt::RefVoltage = 8.3;
testWaitForTimeout(1000);
testStep("battary status","battery voltage is set to 8.25v for entering limphome mode .");
  }
}
// _ttg_#_6_0_15_1_2
void _ttg_fct_caplinline_6_0_15_1_4()
{
  {
    testWaitForTimeout(500);
testReportAddWindowCapture("Graphics","","IGN ON and PRA is not P position within low voltage range (8v-8.5v), then SBW shall operate PRA to P position.","15.3.7.c IGN ON and PRA is not P position within low voltage range (8v-8.5v), then SBW shall operate PRA to P position.png");
  }
}
// _ttg_#_6_0_15_1_4
void _ttg_fct_caplinline_6_0_15_1_5_1()
{
  {
    @sysvar::VTS::M12_SupInt::RefVoltage = 12;
testWaitForTimeout(1000);
testStep("battary status","battery voltage restores to 12v.");
  }
}
// _ttg_#_6_0_15_1_5_1
void _ttg_fct_caplinline_6_0_15_2_1_3()
{
  {
    testWaitForTimeout(500);
testReportAddWindowCapture("Graphics","","Set PRA to not P position at initial","15.3.7.a Set PRA to not P position at initial.png");
  }
}
// _ttg_#_6_0_15_2_1_3
void _ttg_fct_caplinline_6_0_15_2_1_4()
{
  {
    @sysvar::VTS::M12_SupInt::RefVoltage = 8.3;
testWaitForTimeout(1000);
testStep("battary status","battery voltage is set to 8.25v for entering limphome mode .");
  }
}
// _ttg_#_6_0_15_2_1_4
void _ttg_fct_caplinline_6_0_15_2_4()
{
  {
    testWaitForTimeout(500);
testReportAddWindowCapture("Graphics","","IGN OFF and Determine a low voltage range (8v – 8.5v) and execute an operation command of P to PRA depending on the input of valid P switch press.","15.3.7.a IGN OFF and Determine a low voltage range (8v – 8.5v) and execute an operation command of P to PRA depending on the input of valid P switch press.png");
  }
}
// _ttg_#_6_0_15_2_4
void _ttg_fct_caplinline_6_0_15_2_7()
{
  {
    testWaitForTimeout(500);
testReportAddWindowCapture("Graphics","","IGN OFF and Determine a low voltage range (8v – 8.5v) and execute an operation command of not P to PRA depending on the input of valid P-release switch press.","15.3.7.a execute an operation command of not P to PRA depending on the input of valid P-release switch press.png");
  }
}
// _ttg_#_6_0_15_2_7
void _ttg_fct_caplinline_6_0_15_2_8_1()
{
  {
    @sysvar::VTS::M12_SupInt::RefVoltage = 12;
testWaitForTimeout(1000);
  }
}
// _ttg_#_6_0_15_2_8_1
void _ttg_fct_caplinline_6_0_16_1_4()
{
  {
    testWaitForTimeout(500);
testReportAddWindowCapture("Graphics","","Set PRA to not P position at initial","15.3.8 Set PRA to not P position at initial.png");
  }
}
// _ttg_#_6_0_16_1_4
void _ttg_fct_caplinline_6_0_16_2()
{
  {
    @sysvar::VTS::M12_SupInt::RefVoltage = 7.8;
testWaitForTimeout(1000);
  }
}
// _ttg_#_6_0_16_2
void _ttg_fct_caplinline_6_0_16_6()
{
  {
    testWaitForTimeout(500);
testReportAddWindowCapture("Graphics","","check if PRA keep at Not P position @7.8V","15.3.8 check if PRA keep at Not P position @7.8V.png");
  }
}
// _ttg_#_6_0_16_6
void _ttg_fct_caplinline_6_0_16_7()
{
  {
    @sysvar::VTS::M12_SupInt::RefVoltage = 8.3;
testWaitForTimeout(1000);
  }
}
// _ttg_#_6_0_16_7
void _ttg_fct_caplinline_6_0_16_11()
{
  {
    testWaitForTimeout(500);
testReportAddWindowCapture("Graphics","","check if PRA keep at Not P position @8.3V","15.3.8 check if PRA keep at Not P position @8.3V.png");
  }
}
// _ttg_#_6_0_16_11
void _ttg_fct_caplinline_6_0_16_12()
{
  {
    @sysvar::VTS::M12_SupInt::RefVoltage = 8.7;
testWaitForTimeout(1000);
  }
}
// _ttg_#_6_0_16_12
void _ttg_fct_caplinline_6_0_16_15()
{
  {
    testWaitForTimeout(500);
testReportAddWindowCapture("Graphics","","check if SBW operate PRA to P position @8.7V","15.3.8 check if SBW operate PRA to P position @8.7V.png");
  }
}
// _ttg_#_6_0_16_15
void _ttg_fct_caplinline_6_0_16_16_1()
{
  {
    @sysvar::VTS::M12_SupInt::RefVoltage = 12;
testWaitForTimeout(1000);
  }
}
// _ttg_#_6_0_16_16_1
void _ttg_fct_caplinline_6_0_20_4()
{
  {
    @sysvar::VTS::M12_SupInt::RefVoltage = 0;
@sysvar::VTS::M12_Sup1::RefVoltage = 0;
@sysvar::VTS::M12_Sup1::MaxCurrent = 0;
testWaitForTimeout(200);
@sysvar::VTS::M12_Out2::Active = 0;
@sysvar::VTS::M12_Out1::Active = 0;

  }
}
// _ttg_#_6_0_20_4
// Test preparation:Power supply initialization
testsequence _ttg_ts_ts_6_0_0()
{
  TestCommandBegin("CAPL Inline", "Initialize VT system,make VT internal power supply voltage output equals 12V");
  {
    _ttg_fct_caplinline_6_0_0_3();
  }
  // _ttg_!_6_0_0_3
  TestCommandEnd();
  if(_fct_DoStop(EVerdBOF_TS, 0))
  {
    return;
  }
  {
    CreateCaplIFFunction("loginRequestService", 0);
    CallInterfaceFunction("loginRequestService ()");
    if(_fct_DoStop(EVerdBOF_TS, 0))
    {
      return;
    }
  }
  {
    CreateCaplIFFunction("enterTestMode", 0);
    CallInterfaceFunction("enterTestMode ()");
    if(_fct_DoStop(EVerdBOF_TS, 0))
    {
      return;
    }
  }
  {
    CreateCaplIFFunction("readVersion", 0);
    CallInterfaceFunction("readVersion ()");
    if(_fct_DoStop(EVerdBOF_TS, 0))
    {
      return;
    }
  }
  TestCommandBegin("CANoe Standard Service", "enter stand-by Mode (M6)");
  {
    testStep(2, "", "Execute testValidateTesterConfirmation(\"enter stand-by Mode (M6)\", \"enter stand-by Mode (M6)\", 1)");
    testValidateTesterConfirmation("enter stand-by Mode (M6)", "enter stand-by Mode (M6)", 1LL);
  }
  // _ttg_!_6_0_0_7
  TestCommandEnd();
  if(_fct_DoStop(EVerdBOF_TS, 0))
  {
    return;
  }
  {
    CreateCaplIFFunction("setIgnStatus", 0);
    AddIFParameterInt(1LL);
    CallInterfaceFunction("setIgnStatus (ignStatus=1)");
    if(_fct_DoStop(EVerdBOF_TS, 0))
    {
      return;
    }
  }
  TestCommandBegin("CANoe Standard Service", "enter IG ON Mode (M2)");
  {
    testStep(2, "", "Execute testValidateTesterConfirmation(\"enter IG ON Mode (M2)\", \"enter IG ON Mode (M2)\", 1)");
    testValidateTesterConfirmation("enter IG ON Mode (M2)", "enter IG ON Mode (M2)", 1LL);
  }
  // _ttg_!_6_0_0_9
  TestCommandEnd();
  if(_fct_DoStop(EVerdBOF_TS, 0))
  {
    return;
  }
}
// _ttg_#_6_0_0
// 11.5.1 P switch handling
testsequence _ttg_ts_ts_6_0_1()
{
  {
    // Preparation
    _ttg_fct_preparation_6_0_1_2();
    if(_fct_DoStop(EVerdBOF_TS, 1))
    {
      return;
    }
  }
  {
    CreateCaplIFFunction("parkSwitchPress", 0);
    AddIFParameterInt(1LL);
    AddIFParameterChar("11.5.1 make a valid P Switch Press.png");
    CallInterfaceFunction("make a valid P Switch Press");
    if(_fct_DoStop(EVerdBOF_TS, 1))
    {
      return;
    }
  }
}
// _ttg_#_6_0_1
// 12.6 Unlock Switch Handling
testsequence _ttg_ts_ts_6_0_4()
{
  {
    CreateCaplIFFunction("unlockSwitchHandling", 1);
    CallInterfaceFunction("12.6 Unlock Switch Handling");
    if(_fct_DoStop(EVerdBOF_TS, 1))
    {
      return;
    }
  }
}
// _ttg_#_6_0_4
// 15.3.6 TCU Eol Complete
testsequence _ttg_ts_ts_6_0_14()
{
  {
    // Preparation
    _ttg_fct_preparation_6_0_14_1();
    if(_fct_DoStop(EVerdBOF_TS, 1))
    {
      return;
    }
  }
  TestCommandBegin("Report", "");
  {
    testStep(2, "", "If the “TCU Eol Complete” value is 1 to 0 edge, SBW shall operate PRA to P position.");
  }
  // _ttg_!_6_0_14_2
  TestCommandEnd();
  if(_fct_DoStop(EVerdBOF_TS, 1))
  {
    return;
  }
  TestCommandBegin("CAPL Inline", "set TCU Eol Complete value from 1 to 0");
  {
    _ttg_fct_caplinline_6_0_14_3();
  }
  // _ttg_!_6_0_14_3
  TestCommandEnd();
  if(_fct_DoStop(EVerdBOF_TS, 1))
  {
    return;
  }
  TestCommandBegin("Await Value Match", "check if SBW operate PRA to P Position");
  {
    dword eventTable[2];
    long ret, setfailed; setfailed = 0;
    if((int64)(5LL * 1000000000LL) < 0)
    {
      testStepErrorInTestSystem(0, "1", "Invalid wait time (< 0)");
    }
    else
    {
      eventTable[0] = testJoinSignal(HKMC_LH_SBW::dbNode::LVR::LVR11::CF_Lvr_PNStat, "_ttg_callback_awaitvaluematch_6_0_14_4_3", "CAN signal \'CF_Lvr_PNStat\'", 0);
      setfailed |= eventTable[0] < 0;
      eventTable[1] = testJoinSignal(HKMC_LH_SBW::dbNode::LVR::LVR11::CF_Lvr_PRelStat, "_ttg_callback_awaitvaluematch_6_0_14_4_4", "CAN signal \'CF_Lvr_PRelStat\'", 0);
      setfailed |= eventTable[1] < 0;
      if(setfailed != 0)
      {
        testStepErrorInTestSystem(0, "1", "Unable to set value condition(s)");
      }
      ret = testWaitForAllJoinedEventsNS((int64)(5LL * 1000000000LL));
      if(setfailed == 0)
      {
        if(ret > 0)
        {
          testStepPass(2, "1", "Waited for occurrence of 2 value condition(s).");
        }
        else
        {
          testStepFail(0, "1", "Waited for occurrence of 2 value condition(s).");
        }
        _fct_TiTableHeadExpectedEx("");
        _fct_ChckRep(0, HKMC_LH_SBW::dbNode::LVR::LVR11::CF_Lvr_PNStat, "CAN signal \'CF_Lvr_PNStat\'", "==", 1LL, "Park Status");
        _fct_TiCellResult(((0!=getSignalTime(HKMC_LH_SBW::dbNode::LVR::LVR11::CF_Lvr_PNStat)) && CheckSignalMatch(HKMC_LH_SBW::dbNode::LVR::LVR11::CF_Lvr_PNStat, 1LL, "=") == 1));
        _fct_ChckRep(0, HKMC_LH_SBW::dbNode::LVR::LVR11::CF_Lvr_PRelStat, "CAN signal \'CF_Lvr_PRelStat\'", "==", 0LL, "Parking not released");
        _fct_TiCellResult(((0!=getSignalTime(HKMC_LH_SBW::dbNode::LVR::LVR11::CF_Lvr_PRelStat)) && CheckSignalMatch(HKMC_LH_SBW::dbNode::LVR::LVR11::CF_Lvr_PRelStat, 0LL, "=") == 1));
        _fct_TiTableEnd("", 0, 0);
      }
    }
  }
  // _ttg_!_6_0_14_4
  TestCommandEnd();
  if(_fct_DoStop(EVerdBOF_TS, 1))
  {
    return;
  }
  TestCommandBegin("CAPL Inline", "capture CF_Lvr_PNStat&CF_Lvr_PRelStat");
  {
    _ttg_fct_caplinline_6_0_14_5();
  }
  // _ttg_!_6_0_14_5
  TestCommandEnd();
  if(_fct_DoStop(EVerdBOF_TS, 1))
  {
    return;
  }
  TestCommandBegin("Report", "");
  {
    testStep(2, "", "If “TCU Eol Complete” value is 1, and IGN ON&& P switch==OFF && Unlock switch 5 times within 2sec.");
  }
  // _ttg_!_6_0_14_6
  TestCommandEnd();
  if(_fct_DoStop(EVerdBOF_TS, 1))
  {
    return;
  }
  TestCommandBegin("CAPL Inline", "set TCU Eol Complete value 1");
  {
    _ttg_fct_caplinline_6_0_14_7();
  }
  // _ttg_!_6_0_14_7
  TestCommandEnd();
  if(_fct_DoStop(EVerdBOF_TS, 1))
  {
    return;
  }
  TestCommandBegin("CANoe Standard Service", "P switch==OFF && Unlock switch 5times within 2sec,check if SBW operate PRA to Not P position");
  {
    testStep(2, "", "Execute testValidateTesterConfirmation(\"P switch==OFF && Unlock switch 5times within 2sec,check if SBW operate PRA to Not P position\", \"P switch==OFF && Unlock switch 5times within 2sec,check if SBW operate PRA to Not P position\", 1)");
    testValidateTesterConfirmation("P switch==OFF && Unlock switch 5times within 2sec,check if SBW operate PRA to Not P position", "P switch==OFF && Unlock switch 5times within 2sec,check if SBW operate PRA to Not P position", 1LL);
  }
  // _ttg_!_6_0_14_8
  TestCommandEnd();
  if(_fct_DoStop(EVerdBOF_TS, 1))
  {
    return;
  }
  TestCommandBegin("Await Value Match", "P switch==OFF && Unlock switch 5times within 2sec,check if SBW operate PRA to Not P position");
  {
    dword eventTable[2];
    long ret, setfailed; setfailed = 0;
    if((int64)(5LL * 1000000000LL) < 0)
    {
      testStepErrorInTestSystem(0, "1", "Invalid wait time (< 0)");
    }
    else
    {
      eventTable[0] = testJoinSignal(HKMC_LH_SBW::dbNode::LVR::LVR11::CF_Lvr_PNStat, "_ttg_callback_awaitvaluematch_6_0_14_9_3", "CAN signal \'CF_Lvr_PNStat\'", 0);
      setfailed |= eventTable[0] < 0;
      eventTable[1] = testJoinSignal(HKMC_LH_SBW::dbNode::LVR::LVR11::CF_Lvr_PRelStat, "_ttg_callback_awaitvaluematch_6_0_14_9_4", "CAN signal \'CF_Lvr_PRelStat\'", 0);
      setfailed |= eventTable[1] < 0;
      if(setfailed != 0)
      {
        testStepErrorInTestSystem(0, "1", "Unable to set value condition(s)");
      }
      ret = testWaitForAllJoinedEventsNS((int64)(5LL * 1000000000LL));
      if(setfailed == 0)
      {
        if(ret > 0)
        {
          testStepPass(2, "1", "Waited for occurrence of 2 value condition(s).");
        }
        else
        {
          testStepFail(0, "1", "Waited for occurrence of 2 value condition(s).");
        }
        _fct_TiTableHeadExpectedEx("");
        _fct_ChckRep(0, HKMC_LH_SBW::dbNode::LVR::LVR11::CF_Lvr_PNStat, "CAN signal \'CF_Lvr_PNStat\'", "==", 2LL, "Not Park Status");
        _fct_TiCellResult(((0!=getSignalTime(HKMC_LH_SBW::dbNode::LVR::LVR11::CF_Lvr_PNStat)) && CheckSignalMatch(HKMC_LH_SBW::dbNode::LVR::LVR11::CF_Lvr_PNStat, 2LL, "=") == 1));
        _fct_ChckRep(0, HKMC_LH_SBW::dbNode::LVR::LVR11::CF_Lvr_PRelStat, "CAN signal \'CF_Lvr_PRelStat\'", "==", 1LL, "Parking released");
        _fct_TiCellResult(((0!=getSignalTime(HKMC_LH_SBW::dbNode::LVR::LVR11::CF_Lvr_PRelStat)) && CheckSignalMatch(HKMC_LH_SBW::dbNode::LVR::LVR11::CF_Lvr_PRelStat, 1LL, "=") == 1));
        _fct_TiTableEnd("", 0, 0);
      }
    }
  }
  // _ttg_!_6_0_14_9
  TestCommandEnd();
  if(_fct_DoStop(EVerdBOF_TS, 1))
  {
    return;
  }
  TestCommandBegin("CAPL Inline", "capture CF_Lvr_PNStat&CF_Lvr_PRelStat");
  {
    _ttg_fct_caplinline_6_0_14_10();
  }
  // _ttg_!_6_0_14_10
  TestCommandEnd();
  if(_fct_DoStop(EVerdBOF_TS, 1))
  {
    return;
  }
  TestCommandBegin("Report", "");
  {
    testStep(2, "", "If the “TCU Eol Complete” value is 0 and Pressed P switch, SBW shall operate PRA to P position.");
  }
  // _ttg_!_6_0_14_11
  TestCommandEnd();
  if(_fct_DoStop(EVerdBOF_TS, 1))
  {
    return;
  }
  TestCommandBegin("CAPL Inline", "TCU Eol Complete value is 0");
  {
    _ttg_fct_caplinline_6_0_14_12();
  }
  // _ttg_!_6_0_14_12
  TestCommandEnd();
  if(_fct_DoStop(EVerdBOF_TS, 1))
  {
    return;
  }
  {
    CreateCaplIFFunction("parkSwitchPress", 0);
    AddIFParameterInt(1LL);
    AddIFParameterChar("15.3.6 make a valid park switch press.png");
    CallInterfaceFunction("make a valid park switch press");
    if(_fct_DoStop(EVerdBOF_TS, 1))
    {
      return;
    }
  }
  TestCommandBegin("Await Value Match", "check if SBW operate PRA to P Position");
  {
    dword eventTable[2];
    long ret, setfailed; setfailed = 0;
    if((int64)(5LL * 1000000000LL) < 0)
    {
      testStepErrorInTestSystem(0, "1", "Invalid wait time (< 0)");
    }
    else
    {
      eventTable[0] = testJoinSignal(HKMC_LH_SBW::dbNode::LVR::LVR11::CF_Lvr_PNStat, "_ttg_callback_awaitvaluematch_6_0_14_14_3", "CAN signal \'CF_Lvr_PNStat\'", 0);
      setfailed |= eventTable[0] < 0;
      eventTable[1] = testJoinSignal(HKMC_LH_SBW::dbNode::LVR::LVR11::CF_Lvr_PRelStat, "_ttg_callback_awaitvaluematch_6_0_14_14_4", "CAN signal \'CF_Lvr_PRelStat\'", 0);
      setfailed |= eventTable[1] < 0;
      if(setfailed != 0)
      {
        testStepErrorInTestSystem(0, "1", "Unable to set value condition(s)");
      }
      ret = testWaitForAllJoinedEventsNS((int64)(5LL * 1000000000LL));
      if(setfailed == 0)
      {
        if(ret > 0)
        {
          testStepPass(2, "1", "Waited for occurrence of 2 value condition(s).");
        }
        else
        {
          testStepFail(0, "1", "Waited for occurrence of 2 value condition(s).");
        }
        _fct_TiTableHeadExpectedEx("");
        _fct_ChckRep(0, HKMC_LH_SBW::dbNode::LVR::LVR11::CF_Lvr_PNStat, "CAN signal \'CF_Lvr_PNStat\'", "==", 1LL, "Park Status");
        _fct_TiCellResult(((0!=getSignalTime(HKMC_LH_SBW::dbNode::LVR::LVR11::CF_Lvr_PNStat)) && CheckSignalMatch(HKMC_LH_SBW::dbNode::LVR::LVR11::CF_Lvr_PNStat, 1LL, "=") == 1));
        _fct_ChckRep(0, HKMC_LH_SBW::dbNode::LVR::LVR11::CF_Lvr_PRelStat, "CAN signal \'CF_Lvr_PRelStat\'", "==", 0LL, "Parking not released");
        _fct_TiCellResult(((0!=getSignalTime(HKMC_LH_SBW::dbNode::LVR::LVR11::CF_Lvr_PRelStat)) && CheckSignalMatch(HKMC_LH_SBW::dbNode::LVR::LVR11::CF_Lvr_PRelStat, 0LL, "=") == 1));
        _fct_TiTableEnd("", 0, 0);
      }
    }
  }
  // _ttg_!_6_0_14_14
  TestCommandEnd();
  if(_fct_DoStop(EVerdBOF_TS, 1))
  {
    return;
  }
  TestCommandBegin("CAPL Inline", "capture CF_Lvr_PNStat&CF_Lvr_PRelStat");
  {
    _ttg_fct_caplinline_6_0_14_15();
  }
  // _ttg_!_6_0_14_15
  TestCommandEnd();
  if(_fct_DoStop(EVerdBOF_TS, 1))
  {
    return;
  }
}
// _ttg_#_6_0_14
// 15.3.8 PRA Disable Voltage
testsequence _ttg_ts_ts_6_0_16()
{
  {
    // Preparation
    _ttg_fct_preparation_6_0_16_1();
    if(_fct_DoStop(EVerdBOF_TS, 1))
    {
      _ttg_fct_completion_6_0_16_16();
      return;
    }
  }
  TestCommandBegin("CAPL Inline", "Make battery voltage less than 8V, equals to 7.8V");
  {
    _ttg_fct_caplinline_6_0_16_2();
  }
  // _ttg_!_6_0_16_2
  TestCommandEnd();
  if(_fct_DoStop(EVerdBOF_TS, 1))
  {
    _ttg_fct_completion_6_0_16_16();
    return;
  }
  {
    CreateCaplIFFunction("SBWControlPRAByIGONTCURequest", 0);
    AddIFParameterInt(1LL);
    CallInterfaceFunction("Try to operate PRA to P position");
    if(_fct_DoStop(EVerdBOF_TS, 1))
    {
      _ttg_fct_completion_6_0_16_16();
      return;
    }
  }
  TestCommandBegin("Wait", "");
  {
    _fct_Wait("1", (int64)(4LL * 1000000000LL), 1000000000, "");
  }
  // _ttg_!_6_0_16_4
  TestCommandEnd();
  if(_fct_DoStop(EVerdBOF_TS, 1))
  {
    _ttg_fct_completion_6_0_16_16();
    return;
  }
  TestCommandBegin("Await Value Match", "check if PRA keep at Not P position @7.8V");
  {
    dword eventTable[2];
    long ret, setfailed; setfailed = 0;
    if((int64)(5LL * 1000000000LL) < 0)
    {
      testStepErrorInTestSystem(0, "1", "Invalid wait time (< 0)");
    }
    else
    {
      eventTable[0] = testJoinSignal(HKMC_LH_SBW::dbNode::LVR::LVR11::CF_Lvr_PNStat, "_ttg_callback_awaitvaluematch_6_0_16_5_3", "CAN signal \'CF_Lvr_PNStat\'", 0);
      setfailed |= eventTable[0] < 0;
      eventTable[1] = testJoinSignal(HKMC_LH_SBW::dbNode::LVR::LVR11::CF_Lvr_PRelStat, "_ttg_callback_awaitvaluematch_6_0_16_5_4", "CAN signal \'CF_Lvr_PRelStat\'", 0);
      setfailed |= eventTable[1] < 0;
      if(setfailed != 0)
      {
        testStepErrorInTestSystem(0, "1", "Unable to set value condition(s)");
      }
      ret = testWaitForAllJoinedEventsNS((int64)(5LL * 1000000000LL));
      if(setfailed == 0)
      {
        if(ret > 0)
        {
          testStepPass(2, "1", "Waited for occurrence of 2 value condition(s).");
        }
        else
        {
          testStepFail(0, "1", "Waited for occurrence of 2 value condition(s).");
        }
        _fct_TiTableHeadExpectedEx("");
        _fct_ChckRep(0, HKMC_LH_SBW::dbNode::LVR::LVR11::CF_Lvr_PNStat, "CAN signal \'CF_Lvr_PNStat\'", "==", 2LL, "Not Park Status");
        _fct_TiCellResult(((0!=getSignalTime(HKMC_LH_SBW::dbNode::LVR::LVR11::CF_Lvr_PNStat)) && CheckSignalMatch(HKMC_LH_SBW::dbNode::LVR::LVR11::CF_Lvr_PNStat, 2LL, "=") == 1));
        _fct_ChckRep(0, HKMC_LH_SBW::dbNode::LVR::LVR11::CF_Lvr_PRelStat, "CAN signal \'CF_Lvr_PRelStat\'", "==", 1LL, "Parking released");
        _fct_TiCellResult(((0!=getSignalTime(HKMC_LH_SBW::dbNode::LVR::LVR11::CF_Lvr_PRelStat)) && CheckSignalMatch(HKMC_LH_SBW::dbNode::LVR::LVR11::CF_Lvr_PRelStat, 1LL, "=") == 1));
        _fct_TiTableEnd("", 0, 0);
      }
    }
  }
  // _ttg_!_6_0_16_5
  TestCommandEnd();
  if(_fct_DoStop(EVerdBOF_TS, 1))
  {
    _ttg_fct_completion_6_0_16_16();
    return;
  }
  TestCommandBegin("CAPL Inline", "capture CF_Lvr_PNStat&CF_Lvr_PRelStat");
  {
    _ttg_fct_caplinline_6_0_16_6();
  }
  // _ttg_!_6_0_16_6
  TestCommandEnd();
  if(_fct_DoStop(EVerdBOF_TS, 1))
  {
    _ttg_fct_completion_6_0_16_16();
    return;
  }
  TestCommandBegin("CAPL Inline", "Make battery voltage restore to 8.3V");
  {
    _ttg_fct_caplinline_6_0_16_7();
  }
  // _ttg_!_6_0_16_7
  TestCommandEnd();
  if(_fct_DoStop(EVerdBOF_TS, 1))
  {
    _ttg_fct_completion_6_0_16_16();
    return;
  }
  {
    CreateCaplIFFunction("SBWControlPRAByIGONTCURequest", 0);
    AddIFParameterInt(1LL);
    CallInterfaceFunction("Try to operate PRA to P position");
    if(_fct_DoStop(EVerdBOF_TS, 1))
    {
      _ttg_fct_completion_6_0_16_16();
      return;
    }
  }
  TestCommandBegin("Wait", "");
  {
    _fct_Wait("1", (int64)(4LL * 1000000000LL), 1000000000, "");
  }
  // _ttg_!_6_0_16_9
  TestCommandEnd();
  if(_fct_DoStop(EVerdBOF_TS, 1))
  {
    _ttg_fct_completion_6_0_16_16();
    return;
  }
  TestCommandBegin("Await Value Match", "check if PRA keep at Not P position @8.3V");
  {
    dword eventTable[2];
    long ret, setfailed; setfailed = 0;
    if((int64)(5LL * 1000000000LL) < 0)
    {
      testStepErrorInTestSystem(0, "1", "Invalid wait time (< 0)");
    }
    else
    {
      eventTable[0] = testJoinSignal(HKMC_LH_SBW::dbNode::LVR::LVR11::CF_Lvr_PNStat, "_ttg_callback_awaitvaluematch_6_0_16_10_3", "CAN signal \'CF_Lvr_PNStat\'", 0);
      setfailed |= eventTable[0] < 0;
      eventTable[1] = testJoinSignal(HKMC_LH_SBW::dbNode::LVR::LVR11::CF_Lvr_PRelStat, "_ttg_callback_awaitvaluematch_6_0_16_10_4", "CAN signal \'CF_Lvr_PRelStat\'", 0);
      setfailed |= eventTable[1] < 0;
      if(setfailed != 0)
      {
        testStepErrorInTestSystem(0, "1", "Unable to set value condition(s)");
      }
      ret = testWaitForAllJoinedEventsNS((int64)(5LL * 1000000000LL));
      if(setfailed == 0)
      {
        if(ret > 0)
        {
          testStepPass(2, "1", "Waited for occurrence of 2 value condition(s).");
        }
        else
        {
          testStepFail(0, "1", "Waited for occurrence of 2 value condition(s).");
        }
        _fct_TiTableHeadExpectedEx("");
        _fct_ChckRep(0, HKMC_LH_SBW::dbNode::LVR::LVR11::CF_Lvr_PNStat, "CAN signal \'CF_Lvr_PNStat\'", "==", 2LL, "Not Park Status");
        _fct_TiCellResult(((0!=getSignalTime(HKMC_LH_SBW::dbNode::LVR::LVR11::CF_Lvr_PNStat)) && CheckSignalMatch(HKMC_LH_SBW::dbNode::LVR::LVR11::CF_Lvr_PNStat, 2LL, "=") == 1));
        _fct_ChckRep(0, HKMC_LH_SBW::dbNode::LVR::LVR11::CF_Lvr_PRelStat, "CAN signal \'CF_Lvr_PRelStat\'", "==", 1LL, "Parking released");
        _fct_TiCellResult(((0!=getSignalTime(HKMC_LH_SBW::dbNode::LVR::LVR11::CF_Lvr_PRelStat)) && CheckSignalMatch(HKMC_LH_SBW::dbNode::LVR::LVR11::CF_Lvr_PRelStat, 1LL, "=") == 1));
        _fct_TiTableEnd("", 0, 0);
      }
    }
  }
  // _ttg_!_6_0_16_10
  TestCommandEnd();
  if(_fct_DoStop(EVerdBOF_TS, 1))
  {
    _ttg_fct_completion_6_0_16_16();
    return;
  }
  TestCommandBegin("CAPL Inline", "capture CF_Lvr_PNStat&CF_Lvr_PRelStat");
  {
    _ttg_fct_caplinline_6_0_16_11();
  }
  // _ttg_!_6_0_16_11
  TestCommandEnd();
  if(_fct_DoStop(EVerdBOF_TS, 1))
  {
    _ttg_fct_completion_6_0_16_16();
    return;
  }
  TestCommandBegin("CAPL Inline", "Make battery voltage restore to 8.7V");
  {
    _ttg_fct_caplinline_6_0_16_12();
  }
  // _ttg_!_6_0_16_12
  TestCommandEnd();
  if(_fct_DoStop(EVerdBOF_TS, 1))
  {
    _ttg_fct_completion_6_0_16_16();
    return;
  }
  {
    CreateCaplIFFunction("SBWControlPRAByIGONTCURequest", 0);
    AddIFParameterInt(1LL);
    CallInterfaceFunction("Try to operate PRA to P position");
    if(_fct_DoStop(EVerdBOF_TS, 1))
    {
      _ttg_fct_completion_6_0_16_16();
      return;
    }
  }
  TestCommandBegin("Await Value Match", "check if SBW operate PRA to P Position");
  {
    dword eventTable[2];
    long ret, setfailed; setfailed = 0;
    if((int64)(5LL * 1000000000LL) < 0)
    {
      testStepErrorInTestSystem(0, "1", "Invalid wait time (< 0)");
    }
    else
    {
      eventTable[0] = testJoinSignal(HKMC_LH_SBW::dbNode::LVR::LVR11::CF_Lvr_PNStat, "_ttg_callback_awaitvaluematch_6_0_16_14_3", "CAN signal \'CF_Lvr_PNStat\'", 0);
      setfailed |= eventTable[0] < 0;
      eventTable[1] = testJoinSignal(HKMC_LH_SBW::dbNode::LVR::LVR11::CF_Lvr_PRelStat, "_ttg_callback_awaitvaluematch_6_0_16_14_4", "CAN signal \'CF_Lvr_PRelStat\'", 0);
      setfailed |= eventTable[1] < 0;
      if(setfailed != 0)
      {
        testStepErrorInTestSystem(0, "1", "Unable to set value condition(s)");
      }
      ret = testWaitForAllJoinedEventsNS((int64)(5LL * 1000000000LL));
      if(setfailed == 0)
      {
        if(ret > 0)
        {
          testStepPass(2, "1", "Waited for occurrence of 2 value condition(s).");
        }
        else
        {
          testStepFail(0, "1", "Waited for occurrence of 2 value condition(s).");
        }
        _fct_TiTableHeadExpectedEx("");
        _fct_ChckRep(0, HKMC_LH_SBW::dbNode::LVR::LVR11::CF_Lvr_PNStat, "CAN signal \'CF_Lvr_PNStat\'", "==", 1LL, "Park Status");
        _fct_TiCellResult(((0!=getSignalTime(HKMC_LH_SBW::dbNode::LVR::LVR11::CF_Lvr_PNStat)) && CheckSignalMatch(HKMC_LH_SBW::dbNode::LVR::LVR11::CF_Lvr_PNStat, 1LL, "=") == 1));
        _fct_ChckRep(0, HKMC_LH_SBW::dbNode::LVR::LVR11::CF_Lvr_PRelStat, "CAN signal \'CF_Lvr_PRelStat\'", "==", 0LL, "Parking not released");
        _fct_TiCellResult(((0!=getSignalTime(HKMC_LH_SBW::dbNode::LVR::LVR11::CF_Lvr_PRelStat)) && CheckSignalMatch(HKMC_LH_SBW::dbNode::LVR::LVR11::CF_Lvr_PRelStat, 0LL, "=") == 1));
        _fct_TiTableEnd("", 0, 0);
      }
    }
  }
  // _ttg_!_6_0_16_14
  TestCommandEnd();
  if(_fct_DoStop(EVerdBOF_TS, 1))
  {
    _ttg_fct_completion_6_0_16_16();
    return;
  }
  TestCommandBegin("CAPL Inline", "capture CF_Lvr_PNStat&CF_Lvr_PRelStat");
  {
    _ttg_fct_caplinline_6_0_16_15();
  }
  // _ttg_!_6_0_16_15
  TestCommandEnd();
  if(_fct_DoStop(EVerdBOF_TS, 1))
  {
    _ttg_fct_completion_6_0_16_16();
    return;
  }
  {
    // Completion
    _ttg_fct_completion_6_0_16_16();
  }
}
// _ttg_#_6_0_16
// try
testsequence _ttg_ts_ts_6_0_17()
{
  {
    CreateCaplIFFunction("SBWControlPRAByIGONTCURequest", 0);
    AddIFParameterInt(1LL);
    CallInterfaceFunction("SBWControlPRAByIGONTCURequest (PRAPosStatus=1)");
    if(_fct_DoStop(EVerdBOF_TS, 1))
    {
      return;
    }
  }
}
// _ttg_#_6_0_17
testsequence _ttg_ts_ts_6_0_18()
{
  {
    CreateCaplIFFunction("SBWControlPRAByIGONTCURequest", 0);
    AddIFParameterInt(0LL);
    CallInterfaceFunction("SBWControlPRAByIGONTCURequest (PRAPosStatus=0)");
    if(_fct_DoStop(EVerdBOF_TS, 1))
    {
      return;
    }
  }
}
// _ttg_#_6_0_18
// Test completion:shutdown the power
testsequence _ttg_ts_ts_6_0_20()
{
  {
    CreateCaplIFFunction("setIgnStatus", 0);
    AddIFParameterInt(0LL);
    CallInterfaceFunction("set IGN off");
    if(_fct_DoStop(EVerdBOF_TS, 1))
    {
      return;
    }
  }
  TestCommandBegin("Wait", "");
  {
    _fct_Wait("1", (int64)(200LL * 1000000LL), 1000000, "");
  }
  // _ttg_!_6_0_20_2
  TestCommandEnd();
  if(_fct_DoStop(EVerdBOF_TS, 1))
  {
    return;
  }
  TestCommandBegin("Reset", "");
  {
    TestResetNodeSignalValues(HKMC_LH_SBW::dbNode::CGW);
    TestResetNodeSignalValues(HKMC_LH_SBW::dbNode::EMS);
    TestResetNodeSignalValues(HKMC_LH_SBW::dbNode::ESC);
    TestResetNodeSignalValues(HKMC_LH_SBW::dbNode::TCU);
  }
  // _ttg_!_6_0_20_3
  TestCommandEnd();
  if(_fct_DoStop(EVerdBOF_TS, 1))
  {
    return;
  }
  TestCommandBegin("CAPL Inline", "Power supply shutdown and reset");
  {
    _ttg_fct_caplinline_6_0_20_4();
  }
  // _ttg_!_6_0_20_4
  TestCommandEnd();
  if(_fct_DoStop(EVerdBOF_TS, 1))
  {
    return;
  }
}
// _ttg_#_6_0_20
// try ig on
testsequence _ttg_ts_ts_6_0_21()
{
  {
    CreateCaplIFFunction("setIgnStatus", 0);
    AddIFParameterInt(1LL);
    CallInterfaceFunction("setIgnStatus (ignStatus=1)");
    if(_fct_DoStop(EVerdBOF_TS, 1))
    {
      return;
    }
  }
}
// _ttg_#_6_0_21
// try DTC
testsequence _ttg_ts_ts_6_0_22()
{
  {
    CreateCaplIFFunction("clearDTC", 0);
    CallInterfaceFunction("clearDTC ()");
    if(_fct_DoStop(EVerdBOF_TS, 1))
    {
      return;
    }
  }
  {
    CreateCaplIFFunction("readDTC", 0);
    AddIFParameterInt(0x8201LL);
    CallInterfaceFunction("readDTC (dtcNeedToBeChecked=0x8201)");
    if(_fct_DoStop(EVerdBOF_TS, 1))
    {
      return;
    }
  }
}
// _ttg_#_6_0_22
